[part 2 of 2]
AUTOSAR XML (schema 4-3-0)
package /ComponentTypes/HkmcComponent/HkmcVehicleOutputAdap/DataTypes
  144 x impl type:
    ADAS_ActToiSta: category=VALUE, base-type=DataType/uint8, compu {0=Cx0_ADAS_ATS_De_activate_TOI (De-activate TOI), 1=Cx1_ADAS_ATS_Activate_TOI (Activate TOI), 2=Cx2_ADAS_ATS_Reserved, 3=Cx3_ADAS_ATS_Error_indicator (Error indicator)}
    ADAS_CMD_AlvCnt10Val: category=VALUE, base-type=DataType/uint8
    ADAS_CMD_AlvCnt30Val: category=VALUE, base-type=DataType/uint8
    ADAS_CMD_Crc10Val: category=VALUE, base-type=DataType/uint16
    ADAS_CMD_Crc30Val: category=VALUE, base-type=DataType/uint16
    ADAS_Damping_Gain:
      category=VALUE
      base-type=DataType/uint8
      compu {0=Cx00_Reserved, 1=Cx01_Reserved, 2=Cx02_Reserved, 3=Cx03_3_200_ (3 ~ 200%), 4=Cx04_3_200_ (3 ~ 200%), 5=Cx05_3_200_ (3 ~ 200%), 6=Cx06_3_200_ (3 ~ 200%), 7=Cx07_3_200_ (3 ~ 200%), 8=Cx08_3_200_ (3 ~ 200%), 9=Cx09_3_200_ (3 ~ 200%), 10=Cx0A_3_200_ (3 ~ 200%), 11=Cx0B_3_200_ (3 ~ 200%), 12=Cx0C_3_200_ (3 ~ 200%), 13=Cx0D_3_200_ (3 ~ 200%), 14=Cx0E_3_200_ (3 ~ 200%), 15=Cx0F_3_200_ (3 ~ 200%), 16=Cx10_3_200_ (3 ~ 200%), 17=Cx11_3_200_ (3 ~ 200%), 18=Cx12_3_200_ (3 ~ 200%), 19=Cx13_3_200_ (3 ~ 200%), 20=Cx14_3_200_ (3 ~ 200%), 21=Cx15_3_200_ (3 ~ 200%), 22=Cx16_3_200_ (3 ~ 200%), 23=Cx17_3_200_ (3 ~ 200%), 24=Cx18_3_200_ (3 ~ 200%), 25=Cx19_3_200_ (3 ~ 200%), 26=Cx1A_3_200_ (3 ~ 200%), 27=Cx1B_3_200_ (3 ~ 200%), 28=Cx1C_3_200_ (3 ~ 200%), 29=Cx1D_3_200_ (3 ~ 200%), 30=Cx1E_3_200_ (3 ~ 200%), 31=Cx1F_3_200_ (3 ~ 200%), 32=Cx20_3_200_ (3 ~ 200%), 33=Cx21_3_200_ (3 ~ 200%), 34=Cx22_3_200_ (3 ~ 200%), 35=Cx23_3_200_ (3 ~ 200%), 36=Cx24_3_200_ (3 ~ 200%), 37=Cx25_3_200_ (3 ~ 200%), 38=Cx26_3_200_ (3 ~ 200%), 39=Cx27_3_200_ (3 ~ 200%), 40=Cx28_3_200_ (3 ~ 200%), 41=Cx29_3_200_ (3 ~ 200%), 42=Cx2A_3_200_ (3 ~ 200%), 43=Cx2B_3_200_ (3 ~ 200%), 44=Cx2C_3_200_ (3 ~ 200%), 45=Cx2D_3_200_ (3 ~ 200%), 46=Cx2E_3_200_ (3 ~ 200%), 47=Cx2F_3_200_ (3 ~ 200%), 48=Cx30_3_200_ (3 ~ 200%), 49=Cx31_3_200_ (3 ~ 200%), 50=Cx32_3_200_ (3 ~ 200%), 51=Cx33_3_200_ (3 ~ 200%), 52=Cx34_3_200_ (3 ~ 200%), 53=Cx35_3_200_ (3 ~ 200%), 54=Cx36_3_200_ (3 ~ 200%), 55=Cx37_3_200_ (3 ~ 200%), 56=Cx38_3_200_ (3 ~ 200%), 57=Cx39_3_200_ (3 ~ 200%), 58=Cx3A_3_200_ (3 ~ 200%), 59=Cx3B_3_200_ (3 ~ 200%), 60=Cx3C_3_200_ (3 ~ 200%), 61=Cx3D_3_200_ (3 ~ 200%), 62=Cx3E_3_200_ (3 ~ 200%), 63=Cx3F_3_200_ (3 ~ 200%), 64=Cx40_3_200_ (3 ~ 200%), 65=Cx41_3_200_ (3 ~ 200%), 66=Cx42_3_200_ (3 ~ 200%), 67=Cx43_3_200_ (3 ~ 200%), 68=Cx44_3_200_ (3 ~ 200%), 69=Cx45_3_200_ (3 ~ 200%), 70=Cx46_3_200_ (3 ~ 200%), 71=Cx47_3_200_ (3 ~ 200%), 72=Cx48_3_200_ (3 ~ 200%), 73=Cx49_3_200_ (3 ~ 200%), 74=Cx4A_3_200_ (3 ~ 200%), 75=Cx4B_3_200_ (3 ~ 200%), 76=Cx4C_3_200_ (3 ~ 200%), 77=Cx4D_3_200_ (3 ~ 200%), 78=Cx4E_3_200_ (3 ~ 200%), 79=Cx4F_3_200_ (3 ~ 200%), 80=Cx50_3_200_ (3 ~ 200%), 81=Cx51_3_200_ (3 ~ 200%), 82=Cx52_3_200_ (3 ~ 200%), 83=Cx53_3_200_ (3 ~ 200%), 84=Cx54_3_200_ (3 ~ 200%), 85=Cx55_3_200_ (3 ~ 200%), 86=Cx56_3_200_ (3 ~ 200%), 87=Cx57_3_200_ (3 ~ 200%), 88=Cx58_3_200_ (3 ~ 200%), 89=Cx59_3_200_ (3 ~ 200%), 90=Cx5A_3_200_ (3 ~ 200%), 91=Cx5B_3_200_ (3 ~ 200%), 92=Cx5C_3_200_ (3 ~ 200%), 93=Cx5D_3_200_ (3 ~ 200%), 94=Cx5E_3_200_ (3 ~ 200%), 95=Cx5F_3_200_ (3 ~ 200%), 96=Cx60_3_200_ (3 ~ 200%), 97=Cx61_3_200_ (3 ~ 200%), 98=Cx62_3_200_ (3 ~ 200%), 99=Cx63_3_200_ (3 ~ 200%), 100=Cx64_3_200_ (3 ~ 200%), 101=Cx65_3_200_ (3 ~ 200%), 102=Cx66_3_200_ (3 ~ 200%), 103=Cx67_3_200_ (3 ~ 200%), 104=Cx68_3_200_ (3 ~ 200%), 105=Cx69_3_200_ (3 ~ 200%), 106=Cx6A_3_200_ (3 ~ 200%), 107=Cx6B_3_200_ (3 ~ 200%), 108=Cx6C_3_200_ (3 ~ 200%), 109=Cx6D_3_200_ (3 ~ 200%), 110=Cx6E_3_200_ (3 ~ 200%), 111=Cx6F_3_200_ (3 ~ 200%), 112=Cx70_3_200_ (3 ~ 200%), 113=Cx71_3_200_ (3 ~ 200%), 114=Cx72_3_200_ (3 ~ 200%), 115=Cx73_3_200_ (3 ~ 200%), 116=Cx74_3_200_ (3 ~ 200%), 117=Cx75_3_200_ (3 ~ 200%), 118=Cx76_3_200_ (3 ~ 200%), 119=Cx77_3_200_ (3 ~ 200%), 120=Cx78_3_200_ (3 ~ 200%), 121=Cx79_3_200_ (3 ~ 200%), 122=Cx7A_3_200_ (3 ~ 200%), 123=Cx7B_3_200_ (3 ~ 200%), 124=Cx7C_3_200_ (3 ~ 200%), 125=Cx7D_3_200_ (3 ~ 200%), 126=Cx7E_3_200_ (3 ~ 200%), 127=Cx7F_3_200_ (3 ~ 200%), 128=Cx80_3_200_ (3 ~ 200%), 129=Cx81_3_200_ (3 ~ 200%), 130=Cx82_3_200_ (3 ~ 200%), 131=Cx83_3_200_ (3 ~ 200%), 132=Cx84_3_200_ (3 ~ 200%), 133=Cx85_3_200_ (3 ~ 200%), 134=Cx86_3_200_ (3 ~ 200%), 135=Cx87_3_200_ (3 ~ 200%), 136=Cx88_3_200_ (3 ~ 200%), 137=Cx89_3_200_ (3 ~ 200%), 138=Cx8A_3_200_ (3 ~ 200%), 139=Cx8B_3_200_ (3 ~ 200%), 140=Cx8C_3_200_ (3 ~ 200%), 141=Cx8D_3_200_ (3 ~ 200%), 142=Cx8E_3_200_ (3 ~ 200%), 143=Cx8F_3_200_ (3 ~ 200%), 144=Cx90_3_200_ (3 ~ 200%), 145=Cx91_3_200_ (3 ~ 200%), 146=Cx92_3_200_ (3 ~ 200%), 147=Cx93_3_200_ (3 ~ 200%), 148=Cx94_3_200_ (3 ~ 200%), 149=Cx95_3_200_ (3 ~ 200%), 150=Cx96_3_200_ (3 ~ 200%), 151=Cx97_3_200_ (3 ~ 200%), 152=Cx98_3_200_ (3 ~ 200%), 153=Cx99_3_200_ (3 ~ 200%), 154=Cx9A_3_200_ (3 ~ 200%), 155=Cx9B_3_200_ (3 ~ 200%), 156=Cx9C_3_200_ (3 ~ 200%), 157=Cx9D_3_200_ (3 ~ 200%), 158=Cx9E_3_200_ (3 ~ 200%), 159=Cx9F_3_200_ (3 ~ 200%), 160=CxA0_3_200_ (3 ~ 200%), 161=CxA1_3_200_ (3 ~ 200%), 162=CxA2_3_200_ (3 ~ 200%), 163=CxA3_3_200_ (3 ~ 200%), 164=CxA4_3_200_ (3 ~ 200%), 165=CxA5_3_200_ (3 ~ 200%), 166=CxA6_3_200_ (3 ~ 200%), 167=CxA7_3_200_ (3 ~ 200%), 168=CxA8_3_200_ (3 ~ 200%), 169=CxA9_3_200_ (3 ~ 200%), 170=CxAA_3_200_ (3 ~ 200%), 171=CxAB_3_200_ (3 ~ 200%), 172=CxAC_3_200_ (3 ~ 200%), 173=CxAD_3_200_ (3 ~ 200%), 174=CxAE_3_200_ (3 ~ 200%), 175=CxAF_3_200_ (3 ~ 200%), 176=CxB0_3_200_ (3 ~ 200%), 177=CxB1_3_200_ (3 ~ 200%), 178=CxB2_3_200_ (3 ~ 200%), 179=CxB3_3_200_ (3 ~ 200%), 180=CxB4_3_200_ (3 ~ 200%), 181=CxB5_3_200_ (3 ~ 200%), 182=CxB6_3_200_ (3 ~ 200%), 183=CxB7_3_200_ (3 ~ 200%), 184=CxB8_3_200_ (3 ~ 200%), 185=CxB9_3_200_ (3 ~ 200%), 186=CxBA_3_200_ (3 ~ 200%), 187=CxBB_3_200_ (3 ~ 200%), 188=CxBC_3_200_ (3 ~ 200%), 189=CxBD_3_200_ (3 ~ 200%), 190=CxBE_3_200_ (3 ~ 200%), 191=CxBF_3_200_ (3 ~ 200%), 192=CxC0_3_200_ (3 ~ 200%), 193=CxC1_3_200_ (3 ~ 200%), 194=CxC2_3_200_ (3 ~ 200%), 195=CxC3_3_200_ (3 ~ 200%), 196=CxC4_3_200_ (3 ~ 200%), 197=CxC5_3_200_ (3 ~ 200%), 198=CxC6_3_200_ (3 ~ 200%), 199=CxC7_3_200_ (3 ~ 200%), 200=CxC8_3_200_ (3 ~ 200%), 201=CxC9_Reserved, 202=CxCA_Reserved, 203=CxCB_Reserved, 204=CxCC_Reserved, 205=CxCD_Reserved, 206=CxCE_Reserved, 207=CxCF_Reserved, 208=CxD0_Reserved, 209=CxD1_Reserved, 210=CxD2_Reserved, 211=CxD3_Reserved, 212=CxD4_Reserved, 213=CxD5_Reserved, 214=CxD6_Reserved, 215=CxD7_Reserved, 216=CxD8_Reserved, 217=CxD9_Reserved, 218=CxDA_Reserved, 219=CxDB_Reserved, 220=CxDC_Reserved, 221=CxDD_Reserved, 222=CxDE_Reserved, 223=CxDF_Reserved, 224=CxE0_Reserved, 225=CxE1_Reserved, 226=CxE2_Reserved, 227=CxE3_Reserved, 228=CxE4_Reserved, 229=CxE5_Reserved, 230=CxE6_Reserved, 231=CxE7_Reserved, 232=CxE8_Reserved, 233=CxE9_Reserved, 234=CxEA_Reserved, 235=CxEB_Reserved, 236=CxEC_Reserved, 237=CxED_Reserved, 238=CxEE_Reserved, 239=CxEF_Reserved, 240=CxF0_Reserved, 241=CxF1_Reserved, 242=CxF2_Reserved, 243=CxF3_Reserved, 244=CxF4_Reserved, 245=CxF5_Reserved, 246=CxF6_Reserved, 247=CxF7_Reserved, 248=CxF8_Reserved, 249=CxF9_Reserved, 250=CxFA_Reserved, 251=CxFB_Reserved, 252=CxFC_Reserved, 253=CxFD_Reserved, 254=CxFE_Reserved, 255=CxFF_Reserved}
    ADAS_StrTqReqVal: category=VALUE, base-type=DataType/uint16
    ADAS_ToiFltSta: category=VALUE, base-type=DataType/uint8, compu {0=Cx0_ADAS_TFS_No_Fault (No Fault), 1=Cx1_ADAS_TFS_Fault, 2=Cx2_ADAS_TFS_Reserved, 3=Cx3_ADAS_TFS_Error_indicatorr (Error indicatorr)}
    CF_DAW_Opt_USM_NEW: category=VALUE, base-type=DataType/uint8, compu {0=Cx0_None_DAW_Option_Default_ (None DAW Option(Default)), 1=Cx1_DAW_OU_System_OFF (System OFF), 2=Cx2_DAW_OU_System_ON (System ON), 3=Cx3_DAW_OU_Invalid}
    CF_DAW_Status:
      category=VALUE
      base-type=DataType/uint8
      compu {0=Cx0_DAW_S_System_OFF (System OFF), 1=Cx1_DAW_S_Attention_Level_1 (Attention Level 1), 2=Cx2_DAW_S_Attention_Level_2 (Attention Level 2), 3=Cx3_DAW_S_Attention_Level_3 (Attention Level 3), 4=Cx4_DAW_S_Attention_Level_4 (Attention Level 4), 5=Cx5_DAW_S_Attention_Level_5 (Attention Level 5), 6=Cx6_DAW_S_Reserved, 7=Cx7_DAW_S_Reserved, 8=Cx8_DAW_S_Reserved, 9=Cx9_DAW_S_Reserved, 10=CxA_DAW_S_Reserved, 11=CxB_DAW_S_Reserved, 12=CxC_DAW_S_Reserved, 13=CxD_DAW_S_Reserved, 14=CxE_DAW_S_System_Standby (System Standby), 15=CxF_DAW_S_System_Fail (System Fail)}
    CF_DAW_TimeReset: category=VALUE, base-type=DataType/boolean, compu {0=Cx0_DAW_T_No_Signal (No Signal), 1=Cx1_DAW_T_Time_Reset (Time Reset)}
    CF_DAW_Warn: category=VALUE, base-type=DataType/uint8, compu {0=Cx0_DAW_W_No_Warning (No Warning), 1=Cx1_DAW_W_Rest_Recommend_Warning (Rest Recommend Warning), 2=Cx2_DAW_W_Hands_Off_TMS_Call_Request (Hands-Off TMS Call Request), 3=Cx3_DAW_W_Reserved}
    CF_HBA_Lamp: category=VALUE, base-type=DataType/boolean, compu {0=Cx0_HBA_Indicator_Lamp_Off (HBA Indicator Lamp Off), 1=Cx1_HBA_Indicator_Lamp_On (HBA Indicator Lamp On)}
    CF_HBA_Opt: category=VALUE, base-type=DataType/boolean, compu {0=Cx0_Opt_None_HBA_Option_Default_ (None HBA Option (Default)), 1=Cx1_Opt_HBA_System_Enable (HBA System Enable)}
    CF_HBA_Opt_USM: category=VALUE, base-type=DataType/uint8, compu {0=Cx0_OptU_None_HBA_Option (None HBA Option (Default)), 1=Cx1_OptU_HBA_Function_Off (HBA Function Off), 2=Cx2_OptU_HBA_Function_On (HBA Function On), 3=Cx3_OptU_Invalid (Invalid (Fail))}
    CF_HBA_SysState: category=VALUE, base-type=DataType/uint8
    CF_ISLW_Addinfo_Display: category=VALUE, base-type=DataType/uint8, compu {0=Cx0_ISLW_AD_None_Display_Default_ (None Display (Default)), 1=Cx1_ISLW_AD_LHD_No_Passing_Zone_Display (LHD No Passing Zone Display), 2=Cx2_ISLW_AD_RHD_No_Passing_Zone_Display (RHD No Passing Zone Display), 3=Cx3_ISLW_AD_Invalid}
    CF_ISLW_ConInfo_Sta_Con1:
      category=VALUE
      base-type=DataType/uint8
      compu {0=Cx0_ISLW_CSC1_None_Default_ (None (Default)), 1=Cx1_ISLW_CSC1_Rain, 2=Cx2_ISLW_CSC1_Snow, 3=Cx3_ISLW_CSC1_Snow_Rain (Snow / Rain), 4=Cx4_ISLW_CSC1_Trailer, 5=Cx5_ISLW_CSC1_Reserved, 6=Cx6_ISLW_CSC1_Reserved, 7=Cx7_ISLW_CSC1_Reserved, 8=Cx8_ISLW_CSC1_Reserved, 9=Cx9_ISLW_CSC1_Reserved, 10=CxA_ISLW_CSC1_Reserved, 11=CxB_ISLW_CSC1_Reserved, 12=CxC_ISLW_CSC1_Reserved, 13=CxD_ISLW_CSC1_Reserved, 14=CxE_ISLW_CSC1_Generic, 15=CxF_ISLW_CSC1_Reserved}
    CF_ISLW_ConInfo_Sta_Con2:
      category=VALUE
      base-type=DataType/uint8
      compu {0=Cx0_ISLW_CSC2_None_Default_ (None (Default)), 1=Cx1_ISLW_CSC2_Rain, 2=Cx2_ISLW_CSC2_Snow, 3=Cx3_ISLW_CSC2_Snow_Rain (Snow / Rain), 4=Cx4_ISLW_CSC2_Trailer, 5=Cx5_ISLW_CSC2_Reserved, 6=Cx6_ISLW_CSC2_Reserved, 7=Cx7_ISLW_CSC2_Reserved, 8=Cx8_ISLW_CSC2_Reserved, 9=Cx9_ISLW_CSC2_Reserved, 10=CxA_ISLW_CSC2_Reserved, 11=CxB_ISLW_CSC2_Reserved, 12=CxC_ISLW_CSC2_Reserved, 13=CxD_ISLW_CSC2_Reserved, 14=CxE_ISLW_CSC2_Generic, 15=CxF_ISLW_CSC2_Reserved}
    CF_ISLW_OvrlapSign_Dis: category=VALUE, base-type=DataType/uint8, compu {0=Cx0_ISLW_OSD_None_Default_ (None (Default)), 1=Cx1_ISLW_OSD_Overlap_Sign (Overlap Sign), 2=Cx2_ISLW_OSD_Reserved, 3=Cx3_ISLW_OSD_Reserved}
    CF_ISLW_Spd_Dis_CLU_Con1:
      category=VALUE
      base-type=DataType/uint8
      compu {0=Cx00_ISLW_SDC1_No_Recognition_Default_ (No Recognition (Default)), 1=Cx01_1_252_PH_1_HEX_KPH_or_MPH (1~252 (PH)=1*(HEX) [KPH or MPH), 2=Cx02_1_252_PH_1_HEX_KPH_or_MPH (1~252 (PH)=1*(HEX) [KPH or MPH), 3=Cx03_1_252_PH_1_HEX_KPH_or_MPH (1~252 (PH)=1*(HEX) [KPH or MPH), 4=Cx04_1_252_PH_1_HEX_KPH_or_MPH (1~252 (PH)=1*(HEX) [KPH or MPH), 5=Cx05_1_252_PH_1_HEX_KPH_or_MPH (1~252 (PH)=1*(HEX) [KPH or MPH), 6=Cx06_1_252_PH_1_HEX_KPH_or_MPH (1~252 (PH)=1*(HEX) [KPH or MPH), 7=Cx07_1_252_PH_1_HEX_KPH_or_MPH (1~252 (PH)=1*(HEX) [KPH or MPH), 8=Cx08_1_252_PH_1_HEX_KPH_or_MPH (1~252 (PH)=1*(HEX) [KPH or MPH), 9=Cx09_1_252_PH_1_HEX_KPH_or_MPH (1~252 (PH)=1*(HEX) [KPH or MPH), 10=Cx0A_1_252_PH_1_HEX_KPH_or_MPH (1~252 (PH)=1*(HEX) [KPH or MPH), 11=Cx0B_1_252_PH_1_HEX_KPH_or_MPH (1~252 (PH)=1*(HEX) [KPH or MPH), 12=Cx0C_1_252_PH_1_HEX_KPH_or_MPH (1~252 (PH)=1*(HEX) [KPH or MPH), 13=Cx0D_1_252_PH_1_HEX_KPH_or_MPH (1~252 (PH)=1*(HEX) [KPH or MPH), 14=Cx0E_1_252_PH_1_HEX_KPH_or_MPH (1~252 (PH)=1*(HEX) [KPH or MPH), 15=Cx0F_1_252_PH_1_HEX_KPH_or_MPH (1~252 (PH)=1*(HEX) [KPH or MPH), 16=Cx10_1_252_PH_1_HEX_KPH_or_MPH (1~252 (PH)=1*(HEX) [KPH or MPH), 17=Cx11_1_252_PH_1_HEX_KPH_or_MPH (1~252 (PH)=1*(HEX) [KPH or MPH), 18=Cx12_1_252_PH_1_HEX_KPH_or_MPH (1~252 (PH)=1*(HEX) [KPH or MPH), 19=Cx13_1_252_PH_1_HEX_KPH_or_MPH (1~252 (PH)=1*(HEX) [KPH or MPH), 20=Cx14_1_252_PH_1_HEX_KPH_or_MPH (1~252 (PH)=1*(HEX) [KPH or MPH), 21=Cx15_1_252_PH_1_HEX_KPH_or_MPH (1~252 (PH)=1*(HEX) [KPH or MPH), 22=Cx16_1_252_PH_1_HEX_KPH_or_MPH (1~252 (PH)=1*(HEX) [KPH or MPH), 23=Cx17_1_252_PH_1_HEX_KPH_or_MPH (1~252 (PH)=1*(HEX) [KPH or MPH), 24=Cx18_1_252_PH_1_HEX_KPH_or_MPH (1~252 (PH)=1*(HEX) [KPH or MPH), 25=Cx19_1_252_PH_1_HEX_KPH_or_MPH (1~252 (PH)=1*(HEX) [KPH or MPH), 26=Cx1A_1_252_PH_1_HEX_KPH_or_MPH (1~252 (PH)=1*(HEX) [KPH or MPH), 27=Cx1B_1_252_PH_1_HEX_KPH_or_MPH (1~252 (PH)=1*(HEX) [KPH or MPH), 28=Cx1C_1_252_PH_1_HEX_KPH_or_MPH (1~252 (PH)=1*(HEX) [KPH or MPH), 29=Cx1D_1_252_PH_1_HEX_KPH_or_MPH (1~252 (PH)=1*(HEX) [KPH or MPH), 30=Cx1E_1_252_PH_1_HEX_KPH_or_MPH (1~252 (PH)=1*(HEX) [KPH or MPH), 31=Cx1F_1_252_PH_1_HEX_KPH_or_MPH (1~252 (PH)=1*(HEX) [KPH or MPH), 32=Cx20_1_252_PH_1_HEX_KPH_or_MPH (1~252 (PH)=1*(HEX) [KPH or MPH), 33=Cx21_1_252_PH_1_HEX_KPH_or_MPH (1~252 (PH)=1*(HEX) [KPH or MPH), 34=Cx22_1_252_PH_1_HEX_KPH_or_MPH (1~252 (PH)=1*(HEX) [KPH or MPH), 35=Cx23_1_252_PH_1_HEX_KPH_or_MPH (1~252 (PH)=1*(HEX) [KPH or MPH), 36=Cx24_1_252_PH_1_HEX_KPH_or_MPH (1~252 (PH)=1*(HEX) [KPH or MPH), 37=Cx25_1_252_PH_1_HEX_KPH_or_MPH (1~252 (PH)=1*(HEX) [KPH or MPH), 38=Cx26_1_252_PH_1_HEX_KPH_or_MPH (1~252 (PH)=1*(HEX) [KPH or MPH), 39=Cx27_1_252_PH_1_HEX_KPH_or_MPH (1~252 (PH)=1*(HEX) [KPH or MPH), 40=Cx28_1_252_PH_1_HEX_KPH_or_MPH (1~252 (PH)=1*(HEX) [KPH or MPH), 41=Cx29_1_252_PH_1_HEX_KPH_or_MPH (1~252 (PH)=1*(HEX) [KPH or MPH), 42=Cx2A_1_252_PH_1_HEX_KPH_or_MPH (1~252 (PH)=1*(HEX) [KPH or MPH), 43=Cx2B_1_252_PH_1_HEX_KPH_or_MPH (1~252 (PH)=1*(HEX) [KPH or MPH), 44=Cx2C_1_252_PH_1_HEX_KPH_or_MPH (1~252 (PH)=1*(HEX) [KPH or MPH), 45=Cx2D_1_252_PH_1_HEX_KPH_or_MPH (1~252 (PH)=1*(HEX) [KPH or MPH), 46=Cx2E_1_252_PH_1_HEX_KPH_or_MPH (1~252 (PH)=1*(HEX) [KPH or MPH), 47=Cx2F_1_252_PH_1_HEX_KPH_or_MPH (1~252 (PH)=1*(HEX) [KPH or MPH), 48=Cx30_1_252_PH_1_HEX_KPH_or_MPH (1~252 (PH)=1*(HEX) [KPH or MPH), 49=Cx31_1_252_PH_1_HEX_KPH_or_MPH (1~252 (PH)=1*(HEX) [KPH or MPH), 50=Cx32_1_252_PH_1_HEX_KPH_or_MPH (1~252 (PH)=1*(HEX) [KPH or MPH), 51=Cx33_1_252_PH_1_HEX_KPH_or_MPH (1~252 (PH)=1*(HEX) [KPH or MPH), 52=Cx34_1_252_PH_1_HEX_KPH_or_MPH (1~252 (PH)=1*(HEX) [KPH or MPH), 53=Cx35_1_252_PH_1_HEX_KPH_or_MPH (1~252 (PH)=1*(HEX) [KPH or MPH), 54=Cx36_1_252_PH_1_HEX_KPH_or_MPH (1~252 (PH)=1*(HEX) [KPH or MPH), 55=Cx37_1_252_PH_1_HEX_KPH_or_MPH (1~252 (PH)=1*(HEX) [KPH or MPH), 56=Cx38_1_252_PH_1_HEX_KPH_or_MPH (1~252 (PH)=1*(HEX) [KPH or MPH), 57=Cx39_1_252_PH_1_HEX_KPH_or_MPH (1~252 (PH)=1*(HEX) [KPH or MPH), 58=Cx3A_1_252_PH_1_HEX_KPH_or_MPH (1~252 (PH)=1*(HEX) [KPH or MPH), 59=Cx3B_1_252_PH_1_HEX_KPH_or_MPH (1~252 (PH)=1*(HEX) [KPH or MPH), 60=Cx3C_1_252_PH_1_HEX_KPH_or_MPH (1~252 (PH)=1*(HEX) [KPH or MPH), 61=Cx3D_1_252_PH_1_HEX_KPH_or_MPH (1~252 (PH)=1*(HEX) [KPH or MPH), 62=Cx3E_1_252_PH_1_HEX_KPH_or_MPH (1~252 (PH)=1*(HEX) [KPH or MPH), 63=Cx3F_1_252_PH_1_HEX_KPH_or_MPH (1~252 (PH)=1*(HEX) [KPH or MPH), 64=Cx40_1_252_PH_1_HEX_KPH_or_MPH (1~252 (PH)=1*(HEX) [KPH or MPH), 65=Cx41_1_252_PH_1_HEX_KPH_or_MPH (1~252 (PH)=1*(HEX) [KPH or MPH), 66=Cx42_1_252_PH_1_HEX_KPH_or_MPH (1~252 (PH)=1*(HEX) [KPH or MPH), 67=Cx43_1_252_PH_1_HEX_KPH_or_MPH (1~252 (PH)=1*(HEX) [KPH or MPH), 68=Cx44_1_252_PH_1_HEX_KPH_or_MPH (1~252 (PH)=1*(HEX) [KPH or MPH), 69=Cx45_1_252_PH_1_HEX_KPH_or_MPH (1~252 (PH)=1*(HEX) [KPH or MPH), 70=Cx46_1_252_PH_1_HEX_KPH_or_MPH (1~252 (PH)=1*(HEX) [KPH or MPH), 71=Cx47_1_252_PH_1_HEX_KPH_or_MPH (1~252 (PH)=1*(HEX) [KPH or MPH), 72=Cx48_1_252_PH_1_HEX_KPH_or_MPH (1~252 (PH)=1*(HEX) [KPH or MPH), 73=Cx49_1_252_PH_1_HEX_KPH_or_MPH (1~252 (PH)=1*(HEX) [KPH or MPH), 74=Cx4A_1_252_PH_1_HEX_KPH_or_MPH (1~252 (PH)=1*(HEX) [KPH or MPH), 75=Cx4B_1_252_PH_1_HEX_KPH_or_MPH (1~252 (PH)=1*(HEX) [KPH or MPH), 76=Cx4C_1_252_PH_1_HEX_KPH_or_MPH (1~252 (PH)=1*(HEX) [KPH or MPH), 77=Cx4D_1_252_PH_1_HEX_KPH_or_MPH (1~252 (PH)=1*(HEX) [KPH or MPH), 78=Cx4E_1_252_PH_1_HEX_KPH_or_MPH (1~252 (PH)=1*(HEX) [KPH or MPH), 79=Cx4F_1_252_PH_1_HEX_KPH_or_MPH (1~252 (PH)=1*(HEX) [KPH or MPH), 80=Cx50_1_252_PH_1_HEX_KPH_or_MPH (1~252 (PH)=1*(HEX) [KPH or MPH), 81=Cx51_1_252_PH_1_HEX_KPH_or_MPH (1~252 (PH)=1*(HEX) [KPH or MPH), 82=Cx52_1_252_PH_1_HEX_KPH_or_MPH (1~252 (PH)=1*(HEX) [KPH or MPH), 83=Cx53_1_252_PH_1_HEX_KPH_or_MPH (1~252 (PH)=1*(HEX) [KPH or MPH), 84=Cx54_1_252_PH_1_HEX_KPH_or_MPH (1~252 (PH)=1*(HEX) [KPH or MPH), 85=Cx55_1_252_PH_1_HEX_KPH_or_MPH (1~252 (PH)=1*(HEX) [KPH or MPH), 86=Cx56_1_252_PH_1_HEX_KPH_or_MPH (1~252 (PH)=1*(HEX) [KPH or MPH), 87=Cx57_1_252_PH_1_HEX_KPH_or_MPH (1~252 (PH)=1*(HEX) [KPH or MPH), 88=Cx58_1_252_PH_1_HEX_KPH_or_MPH (1~252 (PH)=1*(HEX) [KPH or MPH), 89=Cx59_1_252_PH_1_HEX_KPH_or_MPH (1~252 (PH)=1*(HEX) [KPH or MPH), 90=Cx5A_1_252_PH_1_HEX_KPH_or_MPH (1~252 (PH)=1*(HEX) [KPH or MPH), 91=Cx5B_1_252_PH_1_HEX_KPH_or_MPH (1~252 (PH)=1*(HEX) [KPH or MPH), 92=Cx5C_1_252_PH_1_HEX_KPH_or_MPH (1~252 (PH)=1*(HEX) [KPH or MPH), 93=Cx5D_1_252_PH_1_HEX_KPH_or_MPH (1~252 (PH)=1*(HEX) [KPH or MPH), 94=Cx5E_1_252_PH_1_HEX_KPH_or_MPH (1~252 (PH)=1*(HEX) [KPH or MPH), 95=Cx5F_1_252_PH_1_HEX_KPH_or_MPH (1~252 (PH)=1*(HEX) [KPH or MPH), 96=Cx60_1_252_PH_1_HEX_KPH_or_MPH (1~252 (PH)=1*(HEX) [KPH or MPH), 97=Cx61_1_252_PH_1_HEX_KPH_or_MPH (1~252 (PH)=1*(HEX) [KPH or MPH), 98=Cx62_1_252_PH_1_HEX_KPH_or_MPH (1~252 (PH)=1*(HEX) [KPH or MPH), 99=Cx63_1_252_PH_1_HEX_KPH_or_MPH (1~252 (PH)=1*(HEX) [KPH or MPH), 100=Cx64_1_252_PH_1_HEX_KPH_or_MPH (1~252 (PH)=1*(HEX) [KPH or MPH), 101=Cx65_1_252_PH_1_HEX_KPH_or_MPH (1~252 (PH)=1*(HEX) [KPH or MPH), 102=Cx66_1_252_PH_1_HEX_KPH_or_MPH (1~252 (PH)=1*(HEX) [KPH or MPH), 103=Cx67_1_252_PH_1_HEX_KPH_or_MPH (1~252 (PH)=1*(HEX) [KPH or MPH), 104=Cx68_1_252_PH_1_HEX_KPH_or_MPH (1~252 (PH)=1*(HEX) [KPH or MPH), 105=Cx69_1_252_PH_1_HEX_KPH_or_MPH (1~252 (PH)=1*(HEX) [KPH or MPH), 106=Cx6A_1_252_PH_1_HEX_KPH_or_MPH (1~252 (PH)=1*(HEX) [KPH or MPH), 107=Cx6B_1_252_PH_1_HEX_KPH_or_MPH (1~252 (PH)=1*(HEX) [KPH or MPH), 108=Cx6C_1_252_PH_1_HEX_KPH_or_MPH (1~252 (PH)=1*(HEX) [KPH or MPH), 109=Cx6D_1_252_PH_1_HEX_KPH_or_MPH (1~252 (PH)=1*(HEX) [KPH or MPH), 110=Cx6E_1_252_PH_1_HEX_KPH_or_MPH (1~252 (PH)=1*(HEX) [KPH or MPH), 111=Cx6F_1_252_PH_1_HEX_KPH_or_MPH (1~252 (PH)=1*(HEX) [KPH or MPH), 112=Cx70_1_252_PH_1_HEX_KPH_or_MPH (1~252 (PH)=1*(HEX) [KPH or MPH), 113=Cx71_1_252_PH_1_HEX_KPH_or_MPH (1~252 (PH)=1*(HEX) [KPH or MPH), 114=Cx72_1_252_PH_1_HEX_KPH_or_MPH (1~252 (PH)=1*(HEX) [KPH or MPH), 115=Cx73_1_252_PH_1_HEX_KPH_or_MPH (1~252 (PH)=1*(HEX) [KPH or MPH), 116=Cx74_1_252_PH_1_HEX_KPH_or_MPH (1~252 (PH)=1*(HEX) [KPH or MPH), 117=Cx75_1_252_PH_1_HEX_KPH_or_MPH (1~252 (PH)=1*(HEX) [KPH or MPH), 118=Cx76_1_252_PH_1_HEX_KPH_or_MPH (1~252 (PH)=1*(HEX) [KPH or MPH), 119=Cx77_1_252_PH_1_HEX_KPH_or_MPH (1~252 (PH)=1*(HEX) [KPH or MPH), 120=Cx78_1_252_PH_1_HEX_KPH_or_MPH (1~252 (PH)=1*(HEX) [KPH or MPH), 121=Cx79_1_252_PH_1_HEX_KPH_or_MPH (1~252 (PH)=1*(HEX) [KPH or MPH), 122=Cx7A_1_252_PH_1_HEX_KPH_or_MPH (1~252 (PH)=1*(HEX) [KPH or MPH), 123=Cx7B_1_252_PH_1_HEX_KPH_or_MPH (1~252 (PH)=1*(HEX) [KPH or MPH), 124=Cx7C_1_252_PH_1_HEX_KPH_or_MPH (1~252 (PH)=1*(HEX) [KPH or MPH), 125=Cx7D_1_252_PH_1_HEX_KPH_or_MPH (1~252 (PH)=1*(HEX) [KPH or MPH), 126=Cx7E_1_252_PH_1_HEX_KPH_or_MPH (1~252 (PH)=1*(HEX) [KPH or MPH), 127=Cx7F_1_252_PH_1_HEX_KPH_or_MPH (1~252 (PH)=1*(HEX) [KPH or MPH), 128=Cx80_1_252_PH_1_HEX_KPH_or_MPH (1~252 (PH)=1*(HEX) [KPH or MPH), 129=Cx81_1_252_PH_1_HEX_KPH_or_MPH (1~252 (PH)=1*(HEX) [KPH or MPH), 130=Cx82_1_252_PH_1_HEX_KPH_or_MPH (1~252 (PH)=1*(HEX) [KPH or MPH), 131=Cx83_1_252_PH_1_HEX_KPH_or_MPH (1~252 (PH)=1*(HEX) [KPH or MPH), 132=Cx84_1_252_PH_1_HEX_KPH_or_MPH (1~252 (PH)=1*(HEX) [KPH or MPH), 133=Cx85_1_252_PH_1_HEX_KPH_or_MPH (1~252 (PH)=1*(HEX) [KPH or MPH), 134=Cx86_1_252_PH_1_HEX_KPH_or_MPH (1~252 (PH)=1*(HEX) [KPH or MPH), 135=Cx87_1_252_PH_1_HEX_KPH_or_MPH (1~252 (PH)=1*(HEX) [KPH or MPH), 136=Cx88_1_252_PH_1_HEX_KPH_or_MPH (1~252 (PH)=1*(HEX) [KPH or MPH), 137=Cx89_1_252_PH_1_HEX_KPH_or_MPH (1~252 (PH)=1*(HEX) [KPH or MPH), 138=Cx8A_1_252_PH_1_HEX_KPH_or_MPH (1~252 (PH)=1*(HEX) [KPH or MPH), 139=Cx8B_1_252_PH_1_HEX_KPH_or_MPH (1~252 (PH)=1*(HEX) [KPH or MPH), 140=Cx8C_1_252_PH_1_HEX_KPH_or_MPH (1~252 (PH)=1*(HEX) [KPH or MPH), 141=Cx8D_1_252_PH_1_HEX_KPH_or_MPH (1~252 (PH)=1*(HEX) [KPH or MPH), 142=Cx8E_1_252_PH_1_HEX_KPH_or_MPH (1~252 (PH)=1*(HEX) [KPH or MPH), 143=Cx8F_1_252_PH_1_HEX_KPH_or_MPH (1~252 (PH)=1*(HEX) [KPH or MPH), 144=Cx90_1_252_PH_1_HEX_KPH_or_MPH (1~252 (PH)=1*(HEX) [KPH or MPH), 145=Cx91_1_252_PH_1_HEX_KPH_or_MPH (1~252 (PH)=1*(HEX) [KPH or MPH), 146=Cx92_1_252_PH_1_HEX_KPH_or_MPH (1~252 (PH)=1*(HEX) [KPH or MPH), 147=Cx93_1_252_PH_1_HEX_KPH_or_MPH (1~252 (PH)=1*(HEX) [KPH or MPH), 148=Cx94_1_252_PH_1_HEX_KPH_or_MPH (1~252 (PH)=1*(HEX) [KPH or MPH), 149=Cx95_1_252_PH_1_HEX_KPH_or_MPH (1~252 (PH)=1*(HEX) [KPH or MPH), 150=Cx96_1_252_PH_1_HEX_KPH_or_MPH (1~252 (PH)=1*(HEX) [KPH or MPH), 151=Cx97_1_252_PH_1_HEX_KPH_or_MPH (1~252 (PH)=1*(HEX) [KPH or MPH), 152=Cx98_1_252_PH_1_HEX_KPH_or_MPH (1~252 (PH)=1*(HEX) [KPH or MPH), 153=Cx99_1_252_PH_1_HEX_KPH_or_MPH (1~252 (PH)=1*(HEX) [KPH or MPH), 154=Cx9A_1_252_PH_1_HEX_KPH_or_MPH (1~252 (PH)=1*(HEX) [KPH or MPH), 155=Cx9B_1_252_PH_1_HEX_KPH_or_MPH (1~252 (PH)=1*(HEX) [KPH or MPH), 156=Cx9C_1_252_PH_1_HEX_KPH_or_MPH (1~252 (PH)=1*(HEX) [KPH or MPH), 157=Cx9D_1_252_PH_1_HEX_KPH_or_MPH (1~252 (PH)=1*(HEX) [KPH or MPH), 158=Cx9E_1_252_PH_1_HEX_KPH_or_MPH (1~252 (PH)=1*(HEX) [KPH or MPH), 159=Cx9F_1_252_PH_1_HEX_KPH_or_MPH (1~252 (PH)=1*(HEX) [KPH or MPH), 160=CxA0_1_252_PH_1_HEX_KPH_or_MPH (1~252 (PH)=1*(HEX) [KPH or MPH), 161=CxA1_1_252_PH_1_HEX_KPH_or_MPH (1~252 (PH)=1*(HEX) [KPH or MPH), 162=CxA2_1_252_PH_1_HEX_KPH_or_MPH (1~252 (PH)=1*(HEX) [KPH or MPH), 163=CxA3_1_252_PH_1_HEX_KPH_or_MPH (1~252 (PH)=1*(HEX) [KPH or MPH), 164=CxA4_1_252_PH_1_HEX_KPH_or_MPH (1~252 (PH)=1*(HEX) [KPH or MPH), 165=CxA5_1_252_PH_1_HEX_KPH_or_MPH (1~252 (PH)=1*(HEX) [KPH or MPH), 166=CxA6_1_252_PH_1_HEX_KPH_or_MPH (1~252 (PH)=1*(HEX) [KPH or MPH), 167=CxA7_1_252_PH_1_HEX_KPH_or_MPH (1~252 (PH)=1*(HEX) [KPH or MPH), 168=CxA8_1_252_PH_1_HEX_KPH_or_MPH (1~252 (PH)=1*(HEX) [KPH or MPH), 169=CxA9_1_252_PH_1_HEX_KPH_or_MPH (1~252 (PH)=1*(HEX) [KPH or MPH), 170=CxAA_1_252_PH_1_HEX_KPH_or_MPH (1~252 (PH)=1*(HEX) [KPH or MPH), 171=CxAB_1_252_PH_1_HEX_KPH_or_MPH (1~252 (PH)=1*(HEX) [KPH or MPH), 172=CxAC_1_252_PH_1_HEX_KPH_or_MPH (1~252 (PH)=1*(HEX) [KPH or MPH), 173=CxAD_1_252_PH_1_HEX_KPH_or_MPH (1~252 (PH)=1*(HEX) [KPH or MPH), 174=CxAE_1_252_PH_1_HEX_KPH_or_MPH (1~252 (PH)=1*(HEX) [KPH or MPH), 175=CxAF_1_252_PH_1_HEX_KPH_or_MPH (1~252 (PH)=1*(HEX) [KPH or MPH), 176=CxB0_1_252_PH_1_HEX_KPH_or_MPH (1~252 (PH)=1*(HEX) [KPH or MPH), 177=CxB1_1_252_PH_1_HEX_KPH_or_MPH (1~252 (PH)=1*(HEX) [KPH or MPH), 178=CxB2_1_252_PH_1_HEX_KPH_or_MPH (1~252 (PH)=1*(HEX) [KPH or MPH), 179=CxB3_1_252_PH_1_HEX_KPH_or_MPH (1~252 (PH)=1*(HEX) [KPH or MPH), 180=CxB4_1_252_PH_1_HEX_KPH_or_MPH (1~252 (PH)=1*(HEX) [KPH or MPH), 181=CxB5_1_252_PH_1_HEX_KPH_or_MPH (1~252 (PH)=1*(HEX) [KPH or MPH), 182=CxB6_1_252_PH_1_HEX_KPH_or_MPH (1~252 (PH)=1*(HEX) [KPH or MPH), 183=CxB7_1_252_PH_1_HEX_KPH_or_MPH (1~252 (PH)=1*(HEX) [KPH or MPH), 184=CxB8_1_252_PH_1_HEX_KPH_or_MPH (1~252 (PH)=1*(HEX) [KPH or MPH), 185=CxB9_1_252_PH_1_HEX_KPH_or_MPH (1~252 (PH)=1*(HEX) [KPH or MPH), 186=CxBA_1_252_PH_1_HEX_KPH_or_MPH (1~252 (PH)=1*(HEX) [KPH or MPH), 187=CxBB_1_252_PH_1_HEX_KPH_or_MPH (1~252 (PH)=1*(HEX) [KPH or MPH), 188=CxBC_1_252_PH_1_HEX_KPH_or_MPH (1~252 (PH)=1*(HEX) [KPH or MPH), 189=CxBD_1_252_PH_1_HEX_KPH_or_MPH (1~252 (PH)=1*(HEX) [KPH or MPH), 190=CxBE_1_252_PH_1_HEX_KPH_or_MPH (1~252 (PH)=1*(HEX) [KPH or MPH), 191=CxBF_1_252_PH_1_HEX_KPH_or_MPH (1~252 (PH)=1*(HEX) [KPH or MPH), 192=CxC0_1_252_PH_1_HEX_KPH_or_MPH (1~252 (PH)=1*(HEX) [KPH or MPH), 193=CxC1_1_252_PH_1_HEX_KPH_or_MPH (1~252 (PH)=1*(HEX) [KPH or MPH), 194=CxC2_1_252_PH_1_HEX_KPH_or_MPH (1~252 (PH)=1*(HEX) [KPH or MPH), 195=CxC3_1_252_PH_1_HEX_KPH_or_MPH (1~252 (PH)=1*(HEX) [KPH or MPH), 196=CxC4_1_252_PH_1_HEX_KPH_or_MPH (1~252 (PH)=1*(HEX) [KPH or MPH), 197=CxC5_1_252_PH_1_HEX_KPH_or_MPH (1~252 (PH)=1*(HEX) [KPH or MPH), 198=CxC6_1_252_PH_1_HEX_KPH_or_MPH (1~252 (PH)=1*(HEX) [KPH or MPH), 199=CxC7_1_252_PH_1_HEX_KPH_or_MPH (1~252 (PH)=1*(HEX) [KPH or MPH), 200=CxC8_1_252_PH_1_HEX_KPH_or_MPH (1~252 (PH)=1*(HEX) [KPH or MPH), 201=CxC9_1_252_PH_1_HEX_KPH_or_MPH (1~252 (PH)=1*(HEX) [KPH or MPH), 202=CxCA_1_252_PH_1_HEX_KPH_or_MPH (1~252 (PH)=1*(HEX) [KPH or MPH), 203=CxCB_1_252_PH_1_HEX_KPH_or_MPH (1~252 (PH)=1*(HEX) [KPH or MPH), 204=CxCC_1_252_PH_1_HEX_KPH_or_MPH (1~252 (PH)=1*(HEX) [KPH or MPH), 205=CxCD_1_252_PH_1_HEX_KPH_or_MPH (1~252 (PH)=1*(HEX) [KPH or MPH), 206=CxCE_1_252_PH_1_HEX_KPH_or_MPH (1~252 (PH)=1*(HEX) [KPH or MPH), 207=CxCF_1_252_PH_1_HEX_KPH_or_MPH (1~252 (PH)=1*(HEX) [KPH or MPH), 208=CxD0_1_252_PH_1_HEX_KPH_or_MPH (1~252 (PH)=1*(HEX) [KPH or MPH), 209=CxD1_1_252_PH_1_HEX_KPH_or_MPH (1~252 (PH)=1*(HEX) [KPH or MPH), 210=CxD2_1_252_PH_1_HEX_KPH_or_MPH (1~252 (PH)=1*(HEX) [KPH or MPH), 211=CxD3_1_252_PH_1_HEX_KPH_or_MPH (1~252 (PH)=1*(HEX) [KPH or MPH), 212=CxD4_1_252_PH_1_HEX_KPH_or_MPH (1~252 (PH)=1*(HEX) [KPH or MPH), 213=CxD5_1_252_PH_1_HEX_KPH_or_MPH (1~252 (PH)=1*(HEX) [KPH or MPH), 214=CxD6_1_252_PH_1_HEX_KPH_or_MPH (1~252 (PH)=1*(HEX) [KPH or MPH), 215=CxD7_1_252_PH_1_HEX_KPH_or_MPH (1~252 (PH)=1*(HEX) [KPH or MPH), 216=CxD8_1_252_PH_1_HEX_KPH_or_MPH (1~252 (PH)=1*(HEX) [KPH or MPH), 217=CxD9_1_252_PH_1_HEX_KPH_or_MPH (1~252 (PH)=1*(HEX) [KPH or MPH), 218=CxDA_1_252_PH_1_HEX_KPH_or_MPH (1~252 (PH)=1*(HEX) [KPH or MPH), 219=CxDB_1_252_PH_1_HEX_KPH_or_MPH (1~252 (PH)=1*(HEX) [KPH or MPH), 220=CxDC_1_252_PH_1_HEX_KPH_or_MPH (1~252 (PH)=1*(HEX) [KPH or MPH), 221=CxDD_1_252_PH_1_HEX_KPH_or_MPH (1~252 (PH)=1*(HEX) [KPH or MPH), 222=CxDE_1_252_PH_1_HEX_KPH_or_MPH (1~252 (PH)=1*(HEX) [KPH or MPH), 223=CxDF_1_252_PH_1_HEX_KPH_or_MPH (1~252 (PH)=1*(HEX) [KPH or MPH), 224=CxE0_1_252_PH_1_HEX_KPH_or_MPH (1~252 (PH)=1*(HEX) [KPH or MPH), 225=CxE1_1_252_PH_1_HEX_KPH_or_MPH (1~252 (PH)=1*(HEX) [KPH or MPH), 226=CxE2_1_252_PH_1_HEX_KPH_or_MPH (1~252 (PH)=1*(HEX) [KPH or MPH), 227=CxE3_1_252_PH_1_HEX_KPH_or_MPH (1~252 (PH)=1*(HEX) [KPH or MPH), 228=CxE4_1_252_PH_1_HEX_KPH_or_MPH (1~252 (PH)=1*(HEX) [KPH or MPH), 229=CxE5_1_252_PH_1_HEX_KPH_or_MPH (1~252 (PH)=1*(HEX) [KPH or MPH), 230=CxE6_1_252_PH_1_HEX_KPH_or_MPH (1~252 (PH)=1*(HEX) [KPH or MPH), 231=CxE7_1_252_PH_1_HEX_KPH_or_MPH (1~252 (PH)=1*(HEX) [KPH or MPH), 232=CxE8_1_252_PH_1_HEX_KPH_or_MPH (1~252 (PH)=1*(HEX) [KPH or MPH), 233=CxE9_1_252_PH_1_HEX_KPH_or_MPH (1~252 (PH)=1*(HEX) [KPH or MPH), 234=CxEA_1_252_PH_1_HEX_KPH_or_MPH (1~252 (PH)=1*(HEX) [KPH or MPH), 235=CxEB_1_252_PH_1_HEX_KPH_or_MPH (1~252 (PH)=1*(HEX) [KPH or MPH), 236=CxEC_1_252_PH_1_HEX_KPH_or_MPH (1~252 (PH)=1*(HEX) [KPH or MPH), 237=CxED_1_252_PH_1_HEX_KPH_or_MPH (1~252 (PH)=1*(HEX) [KPH or MPH), 238=CxEE_1_252_PH_1_HEX_KPH_or_MPH (1~252 (PH)=1*(HEX) [KPH or MPH), 239=CxEF_1_252_PH_1_HEX_KPH_or_MPH (1~252 (PH)=1*(HEX) [KPH or MPH), 240=CxF0_1_252_PH_1_HEX_KPH_or_MPH (1~252 (PH)=1*(HEX) [KPH or MPH), 241=CxF1_1_252_PH_1_HEX_KPH_or_MPH (1~252 (PH)=1*(HEX) [KPH or MPH), 242=CxF2_1_252_PH_1_HEX_KPH_or_MPH (1~252 (PH)=1*(HEX) [KPH or MPH), 243=CxF3_1_252_PH_1_HEX_KPH_or_MPH (1~252 (PH)=1*(HEX) [KPH or MPH), 244=CxF4_1_252_PH_1_HEX_KPH_or_MPH (1~252 (PH)=1*(HEX) [KPH or MPH), 245=CxF5_1_252_PH_1_HEX_KPH_or_MPH (1~252 (PH)=1*(HEX) [KPH or MPH), 246=CxF6_1_252_PH_1_HEX_KPH_or_MPH (1~252 (PH)=1*(HEX) [KPH or MPH), 247=CxF7_1_252_PH_1_HEX_KPH_or_MPH (1~252 (PH)=1*(HEX) [KPH or MPH), 248=CxF8_1_252_PH_1_HEX_KPH_or_MPH (1~252 (PH)=1*(HEX) [KPH or MPH), 249=CxF9_1_252_PH_1_HEX_KPH_or_MPH (1~252 (PH)=1*(HEX) [KPH or MPH), 250=CxFA_1_252_PH_1_HEX_KPH_or_MPH (1~252 (PH)=1*(HEX) [KPH or MPH), 251=CxFB_1_252_PH_1_HEX_KPH_or_MPH (1~252 (PH)=1*(HEX) [KPH or MPH), 252=CxFC_1_252_PH_1_HEX_KPH_or_MPH (1~252 (PH)=1*(HEX) [KPH or MPH), 253=CxFD_ISLW_SDC1_LHD_Conditional_No_Passing_ZONE (LHD Conditional No Passing ZONE), 254=CxFE_ISLW_SDC1_RHD_Conditional_No_Passing_ZONE (RHD Conditional No Passing ZONE), 255=CxFF_ISLW_SDC1_Invalid}
    CF_ISLW_Spd_Dis_CLU_Con2:
      category=VALUE
      base-type=DataType/uint8
      compu {0=Cx00_ISLW_SDC2_No_Recognition_Default_ (No Recognition (Default)), 1=Cx01_1_252_PH_1_HEX_KPH_or_MPH (1~252 (PH)=1*(HEX) [KPH or MPH), 2=Cx02_1_252_PH_1_HEX_KPH_or_MPH (1~252 (PH)=1*(HEX) [KPH or MPH), 3=Cx03_1_252_PH_1_HEX_KPH_or_MPH (1~252 (PH)=1*(HEX) [KPH or MPH), 4=Cx04_1_252_PH_1_HEX_KPH_or_MPH (1~252 (PH)=1*(HEX) [KPH or MPH), 5=Cx05_1_252_PH_1_HEX_KPH_or_MPH (1~252 (PH)=1*(HEX) [KPH or MPH), 6=Cx06_1_252_PH_1_HEX_KPH_or_MPH (1~252 (PH)=1*(HEX) [KPH or MPH), 7=Cx07_1_252_PH_1_HEX_KPH_or_MPH (1~252 (PH)=1*(HEX) [KPH or MPH), 8=Cx08_1_252_PH_1_HEX_KPH_or_MPH (1~252 (PH)=1*(HEX) [KPH or MPH), 9=Cx09_1_252_PH_1_HEX_KPH_or_MPH (1~252 (PH)=1*(HEX) [KPH or MPH), 10=Cx0A_1_252_PH_1_HEX_KPH_or_MPH (1~252 (PH)=1*(HEX) [KPH or MPH), 11=Cx0B_1_252_PH_1_HEX_KPH_or_MPH (1~252 (PH)=1*(HEX) [KPH or MPH), 12=Cx0C_1_252_PH_1_HEX_KPH_or_MPH (1~252 (PH)=1*(HEX) [KPH or MPH), 13=Cx0D_1_252_PH_1_HEX_KPH_or_MPH (1~252 (PH)=1*(HEX) [KPH or MPH), 14=Cx0E_1_252_PH_1_HEX_KPH_or_MPH (1~252 (PH)=1*(HEX) [KPH or MPH), 15=Cx0F_1_252_PH_1_HEX_KPH_or_MPH (1~252 (PH)=1*(HEX) [KPH or MPH), 16=Cx10_1_252_PH_1_HEX_KPH_or_MPH (1~252 (PH)=1*(HEX) [KPH or MPH), 17=Cx11_1_252_PH_1_HEX_KPH_or_MPH (1~252 (PH)=1*(HEX) [KPH or MPH), 18=Cx12_1_252_PH_1_HEX_KPH_or_MPH (1~252 (PH)=1*(HEX) [KPH or MPH), 19=Cx13_1_252_PH_1_HEX_KPH_or_MPH (1~252 (PH)=1*(HEX) [KPH or MPH), 20=Cx14_1_252_PH_1_HEX_KPH_or_MPH (1~252 (PH)=1*(HEX) [KPH or MPH), 21=Cx15_1_252_PH_1_HEX_KPH_or_MPH (1~252 (PH)=1*(HEX) [KPH or MPH), 22=Cx16_1_252_PH_1_HEX_KPH_or_MPH (1~252 (PH)=1*(HEX) [KPH or MPH), 23=Cx17_1_252_PH_1_HEX_KPH_or_MPH (1~252 (PH)=1*(HEX) [KPH or MPH), 24=Cx18_1_252_PH_1_HEX_KPH_or_MPH (1~252 (PH)=1*(HEX) [KPH or MPH), 25=Cx19_1_252_PH_1_HEX_KPH_or_MPH (1~252 (PH)=1*(HEX) [KPH or MPH), 26=Cx1A_1_252_PH_1_HEX_KPH_or_MPH (1~252 (PH)=1*(HEX) [KPH or MPH), 27=Cx1B_1_252_PH_1_HEX_KPH_or_MPH (1~252 (PH)=1*(HEX) [KPH or MPH), 28=Cx1C_1_252_PH_1_HEX_KPH_or_MPH (1~252 (PH)=1*(HEX) [KPH or MPH), 29=Cx1D_1_252_PH_1_HEX_KPH_or_MPH (1~252 (PH)=1*(HEX) [KPH or MPH), 30=Cx1E_1_252_PH_1_HEX_KPH_or_MPH (1~252 (PH)=1*(HEX) [KPH or MPH), 31=Cx1F_1_252_PH_1_HEX_KPH_or_MPH (1~252 (PH)=1*(HEX) [KPH or MPH), 32=Cx20_1_252_PH_1_HEX_KPH_or_MPH (1~252 (PH)=1*(HEX) [KPH or MPH), 33=Cx21_1_252_PH_1_HEX_KPH_or_MPH (1~252 (PH)=1*(HEX) [KPH or MPH), 34=Cx22_1_252_PH_1_HEX_KPH_or_MPH (1~252 (PH)=1*(HEX) [KPH or MPH), 35=Cx23_1_252_PH_1_HEX_KPH_or_MPH (1~252 (PH)=1*(HEX) [KPH or MPH), 36=Cx24_1_252_PH_1_HEX_KPH_or_MPH (1~252 (PH)=1*(HEX) [KPH or MPH), 37=Cx25_1_252_PH_1_HEX_KPH_or_MPH (1~252 (PH)=1*(HEX) [KPH or MPH), 38=Cx26_1_252_PH_1_HEX_KPH_or_MPH (1~252 (PH)=1*(HEX) [KPH or MPH), 39=Cx27_1_252_PH_1_HEX_KPH_or_MPH (1~252 (PH)=1*(HEX) [KPH or MPH), 40=Cx28_1_252_PH_1_HEX_KPH_or_MPH (1~252 (PH)=1*(HEX) [KPH or MPH), 41=Cx29_1_252_PH_1_HEX_KPH_or_MPH (1~252 (PH)=1*(HEX) [KPH or MPH), 42=Cx2A_1_252_PH_1_HEX_KPH_or_MPH (1~252 (PH)=1*(HEX) [KPH or MPH), 43=Cx2B_1_252_PH_1_HEX_KPH_or_MPH (1~252 (PH)=1*(HEX) [KPH or MPH), 44=Cx2C_1_252_PH_1_HEX_KPH_or_MPH (1~252 (PH)=1*(HEX) [KPH or MPH), 45=Cx2D_1_252_PH_1_HEX_KPH_or_MPH (1~252 (PH)=1*(HEX) [KPH or MPH), 46=Cx2E_1_252_PH_1_HEX_KPH_or_MPH (1~252 (PH)=1*(HEX) [KPH or MPH), 47=Cx2F_1_252_PH_1_HEX_KPH_or_MPH (1~252 (PH)=1*(HEX) [KPH or MPH), 48=Cx30_1_252_PH_1_HEX_KPH_or_MPH (1~252 (PH)=1*(HEX) [KPH or MPH), 49=Cx31_1_252_PH_1_HEX_KPH_or_MPH (1~252 (PH)=1*(HEX) [KPH or MPH), 50=Cx32_1_252_PH_1_HEX_KPH_or_MPH (1~252 (PH)=1*(HEX) [KPH or MPH), 51=Cx33_1_252_PH_1_HEX_KPH_or_MPH (1~252 (PH)=1*(HEX) [KPH or MPH), 52=Cx34_1_252_PH_1_HEX_KPH_or_MPH (1~252 (PH)=1*(HEX) [KPH or MPH), 53=Cx35_1_252_PH_1_HEX_KPH_or_MPH (1~252 (PH)=1*(HEX) [KPH or MPH), 54=Cx36_1_252_PH_1_HEX_KPH_or_MPH (1~252 (PH)=1*(HEX) [KPH or MPH), 55=Cx37_1_252_PH_1_HEX_KPH_or_MPH (1~252 (PH)=1*(HEX) [KPH or MPH), 56=Cx38_1_252_PH_1_HEX_KPH_or_MPH (1~252 (PH)=1*(HEX) [KPH or MPH), 57=Cx39_1_252_PH_1_HEX_KPH_or_MPH (1~252 (PH)=1*(HEX) [KPH or MPH), 58=Cx3A_1_252_PH_1_HEX_KPH_or_MPH (1~252 (PH)=1*(HEX) [KPH or MPH), 59=Cx3B_1_252_PH_1_HEX_KPH_or_MPH (1~252 (PH)=1*(HEX) [KPH or MPH), 60=Cx3C_1_252_PH_1_HEX_KPH_or_MPH (1~252 (PH)=1*(HEX) [KPH or MPH), 61=Cx3D_1_252_PH_1_HEX_KPH_or_MPH (1~252 (PH)=1*(HEX) [KPH or MPH), 62=Cx3E_1_252_PH_1_HEX_KPH_or_MPH (1~252 (PH)=1*(HEX) [KPH or MPH), 63=Cx3F_1_252_PH_1_HEX_KPH_or_MPH (1~252 (PH)=1*(HEX) [KPH or MPH), 64=Cx40_1_252_PH_1_HEX_KPH_or_MPH (1~252 (PH)=1*(HEX) [KPH or MPH), 65=Cx41_1_252_PH_1_HEX_KPH_or_MPH (1~252 (PH)=1*(HEX) [KPH or MPH), 66=Cx42_1_252_PH_1_HEX_KPH_or_MPH (1~252 (PH)=1*(HEX) [KPH or MPH), 67=Cx43_1_252_PH_1_HEX_KPH_or_MPH (1~252 (PH)=1*(HEX) [KPH or MPH), 68=Cx44_1_252_PH_1_HEX_KPH_or_MPH (1~252 (PH)=1*(HEX) [KPH or MPH), 69=Cx45_1_252_PH_1_HEX_KPH_or_MPH (1~252 (PH)=1*(HEX) [KPH or MPH), 70=Cx46_1_252_PH_1_HEX_KPH_or_MPH (1~252 (PH)=1*(HEX) [KPH or MPH), 71=Cx47_1_252_PH_1_HEX_KPH_or_MPH (1~252 (PH)=1*(HEX) [KPH or MPH), 72=Cx48_1_252_PH_1_HEX_KPH_or_MPH (1~252 (PH)=1*(HEX) [KPH or MPH), 73=Cx49_1_252_PH_1_HEX_KPH_or_MPH (1~252 (PH)=1*(HEX) [KPH or MPH), 74=Cx4A_1_252_PH_1_HEX_KPH_or_MPH (1~252 (PH)=1*(HEX) [KPH or MPH), 75=Cx4B_1_252_PH_1_HEX_KPH_or_MPH (1~252 (PH)=1*(HEX) [KPH or MPH), 76=Cx4C_1_252_PH_1_HEX_KPH_or_MPH (1~252 (PH)=1*(HEX) [KPH or MPH), 77=Cx4D_1_252_PH_1_HEX_KPH_or_MPH (1~252 (PH)=1*(HEX) [KPH or MPH), 78=Cx4E_1_252_PH_1_HEX_KPH_or_MPH (1~252 (PH)=1*(HEX) [KPH or MPH), 79=Cx4F_1_252_PH_1_HEX_KPH_or_MPH (1~252 (PH)=1*(HEX) [KPH or MPH), 80=Cx50_1_252_PH_1_HEX_KPH_or_MPH (1~252 (PH)=1*(HEX) [KPH or MPH), 81=Cx51_1_252_PH_1_HEX_KPH_or_MPH (1~252 (PH)=1*(HEX) [KPH or MPH), 82=Cx52_1_252_PH_1_HEX_KPH_or_MPH (1~252 (PH)=1*(HEX) [KPH or MPH), 83=Cx53_1_252_PH_1_HEX_KPH_or_MPH (1~252 (PH)=1*(HEX) [KPH or MPH), 84=Cx54_1_252_PH_1_HEX_KPH_or_MPH (1~252 (PH)=1*(HEX) [KPH or MPH), 85=Cx55_1_252_PH_1_HEX_KPH_or_MPH (1~252 (PH)=1*(HEX) [KPH or MPH), 86=Cx56_1_252_PH_1_HEX_KPH_or_MPH (1~252 (PH)=1*(HEX) [KPH or MPH), 87=Cx57_1_252_PH_1_HEX_KPH_or_MPH (1~252 (PH)=1*(HEX) [KPH or MPH), 88=Cx58_1_252_PH_1_HEX_KPH_or_MPH (1~252 (PH)=1*(HEX) [KPH or MPH), 89=Cx59_1_252_PH_1_HEX_KPH_or_MPH (1~252 (PH)=1*(HEX) [KPH or MPH), 90=Cx5A_1_252_PH_1_HEX_KPH_or_MPH (1~252 (PH)=1*(HEX) [KPH or MPH), 91=Cx5B_1_252_PH_1_HEX_KPH_or_MPH (1~252 (PH)=1*(HEX) [KPH or MPH), 92=Cx5C_1_252_PH_1_HEX_KPH_or_MPH (1~252 (PH)=1*(HEX) [KPH or MPH), 93=Cx5D_1_252_PH_1_HEX_KPH_or_MPH (1~252 (PH)=1*(HEX) [KPH or MPH), 94=Cx5E_1_252_PH_1_HEX_KPH_or_MPH (1~252 (PH)=1*(HEX) [KPH or MPH), 95=Cx5F_1_252_PH_1_HEX_KPH_or_MPH (1~252 (PH)=1*(HEX) [KPH or MPH), 96=Cx60_1_252_PH_1_HEX_KPH_or_MPH (1~252 (PH)=1*(HEX) [KPH or MPH), 97=Cx61_1_252_PH_1_HEX_KPH_or_MPH (1~252 (PH)=1*(HEX) [KPH or MPH), 98=Cx62_1_252_PH_1_HEX_KPH_or_MPH (1~252 (PH)=1*(HEX) [KPH or MPH), 99=Cx63_1_252_PH_1_HEX_KPH_or_MPH (1~252 (PH)=1*(HEX) [KPH or MPH), 100=Cx64_1_252_PH_1_HEX_KPH_or_MPH (1~252 (PH)=1*(HEX) [KPH or MPH), 101=Cx65_1_252_PH_1_HEX_KPH_or_MPH (1~252 (PH)=1*(HEX) [KPH or MPH), 102=Cx66_1_252_PH_1_HEX_KPH_or_MPH (1~252 (PH)=1*(HEX) [KPH or MPH), 103=Cx67_1_252_PH_1_HEX_KPH_or_MPH (1~252 (PH)=1*(HEX) [KPH or MPH), 104=Cx68_1_252_PH_1_HEX_KPH_or_MPH (1~252 (PH)=1*(HEX) [KPH or MPH), 105=Cx69_1_252_PH_1_HEX_KPH_or_MPH (1~252 (PH)=1*(HEX) [KPH or MPH), 106=Cx6A_1_252_PH_1_HEX_KPH_or_MPH (1~252 (PH)=1*(HEX) [KPH or MPH), 107=Cx6B_1_252_PH_1_HEX_KPH_or_MPH (1~252 (PH)=1*(HEX) [KPH or MPH), 108=Cx6C_1_252_PH_1_HEX_KPH_or_MPH (1~252 (PH)=1*(HEX) [KPH or MPH), 109=Cx6D_1_252_PH_1_HEX_KPH_or_MPH (1~252 (PH)=1*(HEX) [KPH or MPH), 110=Cx6E_1_252_PH_1_HEX_KPH_or_MPH (1~252 (PH)=1*(HEX) [KPH or MPH), 111=Cx6F_1_252_PH_1_HEX_KPH_or_MPH (1~252 (PH)=1*(HEX) [KPH or MPH), 112=Cx70_1_252_PH_1_HEX_KPH_or_MPH (1~252 (PH)=1*(HEX) [KPH or MPH), 113=Cx71_1_252_PH_1_HEX_KPH_or_MPH (1~252 (PH)=1*(HEX) [KPH or MPH), 114=Cx72_1_252_PH_1_HEX_KPH_or_MPH (1~252 (PH)=1*(HEX) [KPH or MPH), 115=Cx73_1_252_PH_1_HEX_KPH_or_MPH (1~252 (PH)=1*(HEX) [KPH or MPH), 116=Cx74_1_252_PH_1_HEX_KPH_or_MPH (1~252 (PH)=1*(HEX) [KPH or MPH), 117=Cx75_1_252_PH_1_HEX_KPH_or_MPH (1~252 (PH)=1*(HEX) [KPH or MPH), 118=Cx76_1_252_PH_1_HEX_KPH_or_MPH (1~252 (PH)=1*(HEX) [KPH or MPH), 119=Cx77_1_252_PH_1_HEX_KPH_or_MPH (1~252 (PH)=1*(HEX) [KPH or MPH), 120=Cx78_1_252_PH_1_HEX_KPH_or_MPH (1~252 (PH)=1*(HEX) [KPH or MPH), 121=Cx79_1_252_PH_1_HEX_KPH_or_MPH (1~252 (PH)=1*(HEX) [KPH or MPH), 122=Cx7A_1_252_PH_1_HEX_KPH_or_MPH (1~252 (PH)=1*(HEX) [KPH or MPH), 123=Cx7B_1_252_PH_1_HEX_KPH_or_MPH (1~252 (PH)=1*(HEX) [KPH or MPH), 124=Cx7C_1_252_PH_1_HEX_KPH_or_MPH (1~252 (PH)=1*(HEX) [KPH or MPH), 125=Cx7D_1_252_PH_1_HEX_KPH_or_MPH (1~252 (PH)=1*(HEX) [KPH or MPH), 126=Cx7E_1_252_PH_1_HEX_KPH_or_MPH (1~252 (PH)=1*(HEX) [KPH or MPH), 127=Cx7F_1_252_PH_1_HEX_KPH_or_MPH (1~252 (PH)=1*(HEX) [KPH or MPH), 128=Cx80_1_252_PH_1_HEX_KPH_or_MPH (1~252 (PH)=1*(HEX) [KPH or MPH), 129=Cx81_1_252_PH_1_HEX_KPH_or_MPH (1~252 (PH)=1*(HEX) [KPH or MPH), 130=Cx82_1_252_PH_1_HEX_KPH_or_MPH (1~252 (PH)=1*(HEX) [KPH or MPH), 131=Cx83_1_252_PH_1_HEX_KPH_or_MPH (1~252 (PH)=1*(HEX) [KPH or MPH), 132=Cx84_1_252_PH_1_HEX_KPH_or_MPH (1~252 (PH)=1*(HEX) [KPH or MPH), 133=Cx85_1_252_PH_1_HEX_KPH_or_MPH (1~252 (PH)=1*(HEX) [KPH or MPH), 134=Cx86_1_252_PH_1_HEX_KPH_or_MPH (1~252 (PH)=1*(HEX) [KPH or MPH), 135=Cx87_1_252_PH_1_HEX_KPH_or_MPH (1~252 (PH)=1*(HEX) [KPH or MPH), 136=Cx88_1_252_PH_1_HEX_KPH_or_MPH (1~252 (PH)=1*(HEX) [KPH or MPH), 137=Cx89_1_252_PH_1_HEX_KPH_or_MPH (1~252 (PH)=1*(HEX) [KPH or MPH), 138=Cx8A_1_252_PH_1_HEX_KPH_or_MPH (1~252 (PH)=1*(HEX) [KPH or MPH), 139=Cx8B_1_252_PH_1_HEX_KPH_or_MPH (1~252 (PH)=1*(HEX) [KPH or MPH), 140=Cx8C_1_252_PH_1_HEX_KPH_or_MPH (1~252 (PH)=1*(HEX) [KPH or MPH), 141=Cx8D_1_252_PH_1_HEX_KPH_or_MPH (1~252 (PH)=1*(HEX) [KPH or MPH), 142=Cx8E_1_252_PH_1_HEX_KPH_or_MPH (1~252 (PH)=1*(HEX) [KPH or MPH), 143=Cx8F_1_252_PH_1_HEX_KPH_or_MPH (1~252 (PH)=1*(HEX) [KPH or MPH), 144=Cx90_1_252_PH_1_HEX_KPH_or_MPH (1~252 (PH)=1*(HEX) [KPH or MPH), 145=Cx91_1_252_PH_1_HEX_KPH_or_MPH (1~252 (PH)=1*(HEX) [KPH or MPH), 146=Cx92_1_252_PH_1_HEX_KPH_or_MPH (1~252 (PH)=1*(HEX) [KPH or MPH), 147=Cx93_1_252_PH_1_HEX_KPH_or_MPH (1~252 (PH)=1*(HEX) [KPH or MPH), 148=Cx94_1_252_PH_1_HEX_KPH_or_MPH (1~252 (PH)=1*(HEX) [KPH or MPH), 149=Cx95_1_252_PH_1_HEX_KPH_or_MPH (1~252 (PH)=1*(HEX) [KPH or MPH), 150=Cx96_1_252_PH_1_HEX_KPH_or_MPH (1~252 (PH)=1*(HEX) [KPH or MPH), 151=Cx97_1_252_PH_1_HEX_KPH_or_MPH (1~252 (PH)=1*(HEX) [KPH or MPH), 152=Cx98_1_252_PH_1_HEX_KPH_or_MPH (1~252 (PH)=1*(HEX) [KPH or MPH), 153=Cx99_1_252_PH_1_HEX_KPH_or_MPH (1~252 (PH)=1*(HEX) [KPH or MPH), 154=Cx9A_1_252_PH_1_HEX_KPH_or_MPH (1~252 (PH)=1*(HEX) [KPH or MPH), 155=Cx9B_1_252_PH_1_HEX_KPH_or_MPH (1~252 (PH)=1*(HEX) [KPH or MPH), 156=Cx9C_1_252_PH_1_HEX_KPH_or_MPH (1~252 (PH)=1*(HEX) [KPH or MPH), 157=Cx9D_1_252_PH_1_HEX_KPH_or_MPH (1~252 (PH)=1*(HEX) [KPH or MPH), 158=Cx9E_1_252_PH_1_HEX_KPH_or_MPH (1~252 (PH)=1*(HEX) [KPH or MPH), 159=Cx9F_1_252_PH_1_HEX_KPH_or_MPH (1~252 (PH)=1*(HEX) [KPH or MPH), 160=CxA0_1_252_PH_1_HEX_KPH_or_MPH (1~252 (PH)=1*(HEX) [KPH or MPH), 161=CxA1_1_252_PH_1_HEX_KPH_or_MPH (1~252 (PH)=1*(HEX) [KPH or MPH), 162=CxA2_1_252_PH_1_HEX_KPH_or_MPH (1~252 (PH)=1*(HEX) [KPH or MPH), 163=CxA3_1_252_PH_1_HEX_KPH_or_MPH (1~252 (PH)=1*(HEX) [KPH or MPH), 164=CxA4_1_252_PH_1_HEX_KPH_or_MPH (1~252 (PH)=1*(HEX) [KPH or MPH), 165=CxA5_1_252_PH_1_HEX_KPH_or_MPH (1~252 (PH)=1*(HEX) [KPH or MPH), 166=CxA6_1_252_PH_1_HEX_KPH_or_MPH (1~252 (PH)=1*(HEX) [KPH or MPH), 167=CxA7_1_252_PH_1_HEX_KPH_or_MPH (1~252 (PH)=1*(HEX) [KPH or MPH), 168=CxA8_1_252_PH_1_HEX_KPH_or_MPH (1~252 (PH)=1*(HEX) [KPH or MPH), 169=CxA9_1_252_PH_1_HEX_KPH_or_MPH (1~252 (PH)=1*(HEX) [KPH or MPH), 170=CxAA_1_252_PH_1_HEX_KPH_or_MPH (1~252 (PH)=1*(HEX) [KPH or MPH), 171=CxAB_1_252_PH_1_HEX_KPH_or_MPH (1~252 (PH)=1*(HEX) [KPH or MPH), 172=CxAC_1_252_PH_1_HEX_KPH_or_MPH (1~252 (PH)=1*(HEX) [KPH or MPH), 173=CxAD_1_252_PH_1_HEX_KPH_or_MPH (1~252 (PH)=1*(HEX) [KPH or MPH), 174=CxAE_1_252_PH_1_HEX_KPH_or_MPH (1~252 (PH)=1*(HEX) [KPH or MPH), 175=CxAF_1_252_PH_1_HEX_KPH_or_MPH (1~252 (PH)=1*(HEX) [KPH or MPH), 176=CxB0_1_252_PH_1_HEX_KPH_or_MPH (1~252 (PH)=1*(HEX) [KPH or MPH), 177=CxB1_1_252_PH_1_HEX_KPH_or_MPH (1~252 (PH)=1*(HEX) [KPH or MPH), 178=CxB2_1_252_PH_1_HEX_KPH_or_MPH (1~252 (PH)=1*(HEX) [KPH or MPH), 179=CxB3_1_252_PH_1_HEX_KPH_or_MPH (1~252 (PH)=1*(HEX) [KPH or MPH), 180=CxB4_1_252_PH_1_HEX_KPH_or_MPH (1~252 (PH)=1*(HEX) [KPH or MPH), 181=CxB5_1_252_PH_1_HEX_KPH_or_MPH (1~252 (PH)=1*(HEX) [KPH or MPH), 182=CxB6_1_252_PH_1_HEX_KPH_or_MPH (1~252 (PH)=1*(HEX) [KPH or MPH), 183=CxB7_1_252_PH_1_HEX_KPH_or_MPH (1~252 (PH)=1*(HEX) [KPH or MPH), 184=CxB8_1_252_PH_1_HEX_KPH_or_MPH (1~252 (PH)=1*(HEX) [KPH or MPH), 185=CxB9_1_252_PH_1_HEX_KPH_or_MPH (1~252 (PH)=1*(HEX) [KPH or MPH), 186=CxBA_1_252_PH_1_HEX_KPH_or_MPH (1~252 (PH)=1*(HEX) [KPH or MPH), 187=CxBB_1_252_PH_1_HEX_KPH_or_MPH (1~252 (PH)=1*(HEX) [KPH or MPH), 188=CxBC_1_252_PH_1_HEX_KPH_or_MPH (1~252 (PH)=1*(HEX) [KPH or MPH), 189=CxBD_1_252_PH_1_HEX_KPH_or_MPH (1~252 (PH)=1*(HEX) [KPH or MPH), 190=CxBE_1_252_PH_1_HEX_KPH_or_MPH (1~252 (PH)=1*(HEX) [KPH or MPH), 191=CxBF_1_252_PH_1_HEX_KPH_or_MPH (1~252 (PH)=1*(HEX) [KPH or MPH), 192=CxC0_1_252_PH_1_HEX_KPH_or_MPH (1~252 (PH)=1*(HEX) [KPH or MPH), 193=CxC1_1_252_PH_1_HEX_KPH_or_MPH (1~252 (PH)=1*(HEX) [KPH or MPH), 194=CxC2_1_252_PH_1_HEX_KPH_or_MPH (1~252 (PH)=1*(HEX) [KPH or MPH), 195=CxC3_1_252_PH_1_HEX_KPH_or_MPH (1~252 (PH)=1*(HEX) [KPH or MPH), 196=CxC4_1_252_PH_1_HEX_KPH_or_MPH (1~252 (PH)=1*(HEX) [KPH or MPH), 197=CxC5_1_252_PH_1_HEX_KPH_or_MPH (1~252 (PH)=1*(HEX) [KPH or MPH), 198=CxC6_1_252_PH_1_HEX_KPH_or_MPH (1~252 (PH)=1*(HEX) [KPH or MPH), 199=CxC7_1_252_PH_1_HEX_KPH_or_MPH (1~252 (PH)=1*(HEX) [KPH or MPH), 200=CxC8_1_252_PH_1_HEX_KPH_or_MPH (1~252 (PH)=1*(HEX) [KPH or MPH), 201=CxC9_1_252_PH_1_HEX_KPH_or_MPH (1~252 (PH)=1*(HEX) [KPH or MPH), 202=CxCA_1_252_PH_1_HEX_KPH_or_MPH (1~252 (PH)=1*(HEX) [KPH or MPH), 203=CxCB_1_252_PH_1_HEX_KPH_or_MPH (1~252 (PH)=1*(HEX) [KPH or MPH), 204=CxCC_1_252_PH_1_HEX_KPH_or_MPH (1~252 (PH)=1*(HEX) [KPH or MPH), 205=CxCD_1_252_PH_1_HEX_KPH_or_MPH (1~252 (PH)=1*(HEX) [KPH or MPH), 206=CxCE_1_252_PH_1_HEX_KPH_or_MPH (1~252 (PH)=1*(HEX) [KPH or MPH), 207=CxCF_1_252_PH_1_HEX_KPH_or_MPH (1~252 (PH)=1*(HEX) [KPH or MPH), 208=CxD0_1_252_PH_1_HEX_KPH_or_MPH (1~252 (PH)=1*(HEX) [KPH or MPH), 209=CxD1_1_252_PH_1_HEX_KPH_or_MPH (1~252 (PH)=1*(HEX) [KPH or MPH), 210=CxD2_1_252_PH_1_HEX_KPH_or_MPH (1~252 (PH)=1*(HEX) [KPH or MPH), 211=CxD3_1_252_PH_1_HEX_KPH_or_MPH (1~252 (PH)=1*(HEX) [KPH or MPH), 212=CxD4_1_252_PH_1_HEX_KPH_or_MPH (1~252 (PH)=1*(HEX) [KPH or MPH), 213=CxD5_1_252_PH_1_HEX_KPH_or_MPH (1~252 (PH)=1*(HEX) [KPH or MPH), 214=CxD6_1_252_PH_1_HEX_KPH_or_MPH (1~252 (PH)=1*(HEX) [KPH or MPH), 215=CxD7_1_252_PH_1_HEX_KPH_or_MPH (1~252 (PH)=1*(HEX) [KPH or MPH), 216=CxD8_1_252_PH_1_HEX_KPH_or_MPH (1~252 (PH)=1*(HEX) [KPH or MPH), 217=CxD9_1_252_PH_1_HEX_KPH_or_MPH (1~252 (PH)=1*(HEX) [KPH or MPH), 218=CxDA_1_252_PH_1_HEX_KPH_or_MPH (1~252 (PH)=1*(HEX) [KPH or MPH), 219=CxDB_1_252_PH_1_HEX_KPH_or_MPH (1~252 (PH)=1*(HEX) [KPH or MPH), 220=CxDC_1_252_PH_1_HEX_KPH_or_MPH (1~252 (PH)=1*(HEX) [KPH or MPH), 221=CxDD_1_252_PH_1_HEX_KPH_or_MPH (1~252 (PH)=1*(HEX) [KPH or MPH), 222=CxDE_1_252_PH_1_HEX_KPH_or_MPH (1~252 (PH)=1*(HEX) [KPH or MPH), 223=CxDF_1_252_PH_1_HEX_KPH_or_MPH (1~252 (PH)=1*(HEX) [KPH or MPH), 224=CxE0_1_252_PH_1_HEX_KPH_or_MPH (1~252 (PH)=1*(HEX) [KPH or MPH), 225=CxE1_1_252_PH_1_HEX_KPH_or_MPH (1~252 (PH)=1*(HEX) [KPH or MPH), 226=CxE2_1_252_PH_1_HEX_KPH_or_MPH (1~252 (PH)=1*(HEX) [KPH or MPH), 227=CxE3_1_252_PH_1_HEX_KPH_or_MPH (1~252 (PH)=1*(HEX) [KPH or MPH), 228=CxE4_1_252_PH_1_HEX_KPH_or_MPH (1~252 (PH)=1*(HEX) [KPH or MPH), 229=CxE5_1_252_PH_1_HEX_KPH_or_MPH (1~252 (PH)=1*(HEX) [KPH or MPH), 230=CxE6_1_252_PH_1_HEX_KPH_or_MPH (1~252 (PH)=1*(HEX) [KPH or MPH), 231=CxE7_1_252_PH_1_HEX_KPH_or_MPH (1~252 (PH)=1*(HEX) [KPH or MPH), 232=CxE8_1_252_PH_1_HEX_KPH_or_MPH (1~252 (PH)=1*(HEX) [KPH or MPH), 233=CxE9_1_252_PH_1_HEX_KPH_or_MPH (1~252 (PH)=1*(HEX) [KPH or MPH), 234=CxEA_1_252_PH_1_HEX_KPH_or_MPH (1~252 (PH)=1*(HEX) [KPH or MPH), 235=CxEB_1_252_PH_1_HEX_KPH_or_MPH (1~252 (PH)=1*(HEX) [KPH or MPH), 236=CxEC_1_252_PH_1_HEX_KPH_or_MPH (1~252 (PH)=1*(HEX) [KPH or MPH), 237=CxED_1_252_PH_1_HEX_KPH_or_MPH (1~252 (PH)=1*(HEX) [KPH or MPH), 238=CxEE_1_252_PH_1_HEX_KPH_or_MPH (1~252 (PH)=1*(HEX) [KPH or MPH), 239=CxEF_1_252_PH_1_HEX_KPH_or_MPH (1~252 (PH)=1*(HEX) [KPH or MPH), 240=CxF0_1_252_PH_1_HEX_KPH_or_MPH (1~252 (PH)=1*(HEX) [KPH or MPH), 241=CxF1_1_252_PH_1_HEX_KPH_or_MPH (1~252 (PH)=1*(HEX) [KPH or MPH), 242=CxF2_1_252_PH_1_HEX_KPH_or_MPH (1~252 (PH)=1*(HEX) [KPH or MPH), 243=CxF3_1_252_PH_1_HEX_KPH_or_MPH (1~252 (PH)=1*(HEX) [KPH or MPH), 244=CxF4_1_252_PH_1_HEX_KPH_or_MPH (1~252 (PH)=1*(HEX) [KPH or MPH), 245=CxF5_1_252_PH_1_HEX_KPH_or_MPH (1~252 (PH)=1*(HEX) [KPH or MPH), 246=CxF6_1_252_PH_1_HEX_KPH_or_MPH (1~252 (PH)=1*(HEX) [KPH or MPH), 247=CxF7_1_252_PH_1_HEX_KPH_or_MPH (1~252 (PH)=1*(HEX) [KPH or MPH), 248=CxF8_1_252_PH_1_HEX_KPH_or_MPH (1~252 (PH)=1*(HEX) [KPH or MPH), 249=CxF9_1_252_PH_1_HEX_KPH_or_MPH (1~252 (PH)=1*(HEX) [KPH or MPH), 250=CxFA_1_252_PH_1_HEX_KPH_or_MPH (1~252 (PH)=1*(HEX) [KPH or MPH), 251=CxFB_1_252_PH_1_HEX_KPH_or_MPH (1~252 (PH)=1*(HEX) [KPH or MPH), 252=CxFC_1_252_PH_1_HEX_KPH_or_MPH (1~252 (PH)=1*(HEX) [KPH or MPH), 253=CxFD_ISLW_SDC2_LHD_Conditional_No_Passing_ZONE (LHD Conditional No Passing ZONE), 254=CxFE_ISLW_SDC2_RHD_Conditional_No_Passing_ZONE (RHD Conditional No Passing ZONE), 255=CxFF_ISLW_SDC2_Invalid}
    CF_ISLW_Spd_Dis_CLU_Main:
      category=VALUE
      base-type=DataType/uint8
      compu {0=Cx00_ISLW_SDC_No_Recognition_Default_ (No Recognition (Default)), 1=Cx01_1_252 (1~252), 2=Cx02_1_252 (1~252), 3=Cx03_1_252 (1~252), 4=Cx04_1_252 (1~252), 5=Cx05_1_252 (1~252), 6=Cx06_1_252 (1~252), 7=Cx07_1_252 (1~252), 8=Cx08_1_252 (1~252), 9=Cx09_1_252 (1~252), 10=Cx0A_1_252 (1~252), 11=Cx0B_1_252 (1~252), 12=Cx0C_1_252 (1~252), 13=Cx0D_1_252 (1~252), 14=Cx0E_1_252 (1~252), 15=Cx0F_1_252 (1~252), 16=Cx10_1_252 (1~252), 17=Cx11_1_252 (1~252), 18=Cx12_1_252 (1~252), 19=Cx13_1_252 (1~252), 20=Cx14_1_252 (1~252), 21=Cx15_1_252 (1~252), 22=Cx16_1_252 (1~252), 23=Cx17_1_252 (1~252), 24=Cx18_1_252 (1~252), 25=Cx19_1_252 (1~252), 26=Cx1A_1_252 (1~252), 27=Cx1B_1_252 (1~252), 28=Cx1C_1_252 (1~252), 29=Cx1D_1_252 (1~252), 30=Cx1E_1_252 (1~252), 31=Cx1F_1_252 (1~252), 32=Cx20_1_252 (1~252), 33=Cx21_1_252 (1~252), 34=Cx22_1_252 (1~252), 35=Cx23_1_252 (1~252), 36=Cx24_1_252 (1~252), 37=Cx25_1_252 (1~252), 38=Cx26_1_252 (1~252), 39=Cx27_1_252 (1~252), 40=Cx28_1_252 (1~252), 41=Cx29_1_252 (1~252), 42=Cx2A_1_252 (1~252), 43=Cx2B_1_252 (1~252), 44=Cx2C_1_252 (1~252), 45=Cx2D_1_252 (1~252), 46=Cx2E_1_252 (1~252), 47=Cx2F_1_252 (1~252), 48=Cx30_1_252 (1~252), 49=Cx31_1_252 (1~252), 50=Cx32_1_252 (1~252), 51=Cx33_1_252 (1~252), 52=Cx34_1_252 (1~252), 53=Cx35_1_252 (1~252), 54=Cx36_1_252 (1~252), 55=Cx37_1_252 (1~252), 56=Cx38_1_252 (1~252), 57=Cx39_1_252 (1~252), 58=Cx3A_1_252 (1~252), 59=Cx3B_1_252 (1~252), 60=Cx3C_1_252 (1~252), 61=Cx3D_1_252 (1~252), 62=Cx3E_1_252 (1~252), 63=Cx3F_1_252 (1~252), 64=Cx40_1_252 (1~252), 65=Cx41_1_252 (1~252), 66=Cx42_1_252 (1~252), 67=Cx43_1_252 (1~252), 68=Cx44_1_252 (1~252), 69=Cx45_1_252 (1~252), 70=Cx46_1_252 (1~252), 71=Cx47_1_252 (1~252), 72=Cx48_1_252 (1~252), 73=Cx49_1_252 (1~252), 74=Cx4A_1_252 (1~252), 75=Cx4B_1_252 (1~252), 76=Cx4C_1_252 (1~252), 77=Cx4D_1_252 (1~252), 78=Cx4E_1_252 (1~252), 79=Cx4F_1_252 (1~252), 80=Cx50_1_252 (1~252), 81=Cx51_1_252 (1~252), 82=Cx52_1_252 (1~252), 83=Cx53_1_252 (1~252), 84=Cx54_1_252 (1~252), 85=Cx55_1_252 (1~252), 86=Cx56_1_252 (1~252), 87=Cx57_1_252 (1~252), 88=Cx58_1_252 (1~252), 89=Cx59_1_252 (1~252), 90=Cx5A_1_252 (1~252), 91=Cx5B_1_252 (1~252), 92=Cx5C_1_252 (1~252), 93=Cx5D_1_252 (1~252), 94=Cx5E_1_252 (1~252), 95=Cx5F_1_252 (1~252), 96=Cx60_1_252 (1~252), 97=Cx61_1_252 (1~252), 98=Cx62_1_252 (1~252), 99=Cx63_1_252 (1~252), 100=Cx64_1_252 (1~252), 101=Cx65_1_252 (1~252), 102=Cx66_1_252 (1~252), 103=Cx67_1_252 (1~252), 104=Cx68_1_252 (1~252), 105=Cx69_1_252 (1~252), 106=Cx6A_1_252 (1~252), 107=Cx6B_1_252 (1~252), 108=Cx6C_1_252 (1~252), 109=Cx6D_1_252 (1~252), 110=Cx6E_1_252 (1~252), 111=Cx6F_1_252 (1~252), 112=Cx70_1_252 (1~252), 113=Cx71_1_252 (1~252), 114=Cx72_1_252 (1~252), 115=Cx73_1_252 (1~252), 116=Cx74_1_252 (1~252), 117=Cx75_1_252 (1~252), 118=Cx76_1_252 (1~252), 119=Cx77_1_252 (1~252), 120=Cx78_1_252 (1~252), 121=Cx79_1_252 (1~252), 122=Cx7A_1_252 (1~252), 123=Cx7B_1_252 (1~252), 124=Cx7C_1_252 (1~252), 125=Cx7D_1_252 (1~252), 126=Cx7E_1_252 (1~252), 127=Cx7F_1_252 (1~252), 128=Cx80_1_252 (1~252), 129=Cx81_1_252 (1~252), 130=Cx82_1_252 (1~252), 131=Cx83_1_252 (1~252), 132=Cx84_1_252 (1~252), 133=Cx85_1_252 (1~252), 134=Cx86_1_252 (1~252), 135=Cx87_1_252 (1~252), 136=Cx88_1_252 (1~252), 137=Cx89_1_252 (1~252), 138=Cx8A_1_252 (1~252), 139=Cx8B_1_252 (1~252), 140=Cx8C_1_252 (1~252), 141=Cx8D_1_252 (1~252), 142=Cx8E_1_252 (1~252), 143=Cx8F_1_252 (1~252), 144=Cx90_1_252 (1~252), 145=Cx91_1_252 (1~252), 146=Cx92_1_252 (1~252), 147=Cx93_1_252 (1~252), 148=Cx94_1_252 (1~252), 149=Cx95_1_252 (1~252), 150=Cx96_1_252 (1~252), 151=Cx97_1_252 (1~252), 152=Cx98_1_252 (1~252), 153=Cx99_1_252 (1~252), 154=Cx9A_1_252 (1~252), 155=Cx9B_1_252 (1~252), 156=Cx9C_1_252 (1~252), 157=Cx9D_1_252 (1~252), 158=Cx9E_1_252 (1~252), 159=Cx9F_1_252 (1~252), 160=CxA0_1_252 (1~252), 161=CxA1_1_252 (1~252), 162=CxA2_1_252 (1~252), 163=CxA3_1_252 (1~252), 164=CxA4_1_252 (1~252), 165=CxA5_1_252 (1~252), 166=CxA6_1_252 (1~252), 167=CxA7_1_252 (1~252), 168=CxA8_1_252 (1~252), 169=CxA9_1_252 (1~252), 170=CxAA_1_252 (1~252), 171=CxAB_1_252 (1~252), 172=CxAC_1_252 (1~252), 173=CxAD_1_252 (1~252), 174=CxAE_1_252 (1~252), 175=CxAF_1_252 (1~252), 176=CxB0_1_252 (1~252), 177=CxB1_1_252 (1~252), 178=CxB2_1_252 (1~252), 179=CxB3_1_252 (1~252), 180=CxB4_1_252 (1~252), 181=CxB5_1_252 (1~252), 182=CxB6_1_252 (1~252), 183=CxB7_1_252 (1~252), 184=CxB8_1_252 (1~252), 185=CxB9_1_252 (1~252), 186=CxBA_1_252 (1~252), 187=CxBB_1_252 (1~252), 188=CxBC_1_252 (1~252), 189=CxBD_1_252 (1~252), 190=CxBE_1_252 (1~252), 191=CxBF_1_252 (1~252), 192=CxC0_1_252 (1~252), 193=CxC1_1_252 (1~252), 194=CxC2_1_252 (1~252), 195=CxC3_1_252 (1~252), 196=CxC4_1_252 (1~252), 197=CxC5_1_252 (1~252), 198=CxC6_1_252 (1~252), 199=CxC7_1_252 (1~252), 200=CxC8_1_252 (1~252), 201=CxC9_1_252 (1~252), 202=CxCA_1_252 (1~252), 203=CxCB_1_252 (1~252), 204=CxCC_1_252 (1~252), 205=CxCD_1_252 (1~252), 206=CxCE_1_252 (1~252), 207=CxCF_1_252 (1~252), 208=CxD0_1_252 (1~252), 209=CxD1_1_252 (1~252), 210=CxD2_1_252 (1~252), 211=CxD3_1_252 (1~252), 212=CxD4_1_252 (1~252), 213=CxD5_1_252 (1~252), 214=CxD6_1_252 (1~252), 215=CxD7_1_252 (1~252), 216=CxD8_1_252 (1~252), 217=CxD9_1_252 (1~252), 218=CxDA_1_252 (1~252), 219=CxDB_1_252 (1~252), 220=CxDC_1_252 (1~252), 221=CxDD_1_252 (1~252), 222=CxDE_1_252 (1~252), 223=CxDF_1_252 (1~252), 224=CxE0_1_252 (1~252), 225=CxE1_1_252 (1~252), 226=CxE2_1_252 (1~252), 227=CxE3_1_252 (1~252), 228=CxE4_1_252 (1~252), 229=CxE5_1_252 (1~252), 230=CxE6_1_252 (1~252), 231=CxE7_1_252 (1~252), 232=CxE8_1_252 (1~252), 233=CxE9_1_252 (1~252), 234=CxEA_1_252 (1~252), 235=CxEB_1_252 (1~252), 236=CxEC_1_252 (1~252), 237=CxED_1_252 (1~252), 238=CxEE_1_252 (1~252), 239=CxEF_1_252 (1~252), 240=CxF0_1_252 (1~252), 241=CxF1_1_252 (1~252), 242=CxF2_1_252 (1~252), 243=CxF3_1_252 (1~252), 244=CxF4_1_252 (1~252), 245=CxF5_1_252 (1~252), 246=CxF6_1_252 (1~252), 247=CxF7_1_252 (1~252), 248=CxF8_1_252 (1~252), 249=CxF9_1_252 (1~252), 250=CxFA_1_252 (1~252), 251=CxFB_1_252 (1~252), 252=CxFC_1_252 (1~252), 253=CxFD_ISLW_SDC_Unlimited_Speed (Unlimited Speed), 254=CxFE_ISLW_SDC_Reserved, 255=CxFF_ISLW_SDC_Invalid}
    CF_ISLW_Spd_Dis_NAVI_Con1:
      category=VALUE
      base-type=DataType/uint8
      compu {0=Cx00_ISLW_SDN1_No_Recognition_Default_ (No Recognition (Default)), 1=Cx01_1_252_PH_1_HEX_KPH_or_MPH (1~252 (PH)=1*(HEX) [KPH or MPH), 2=Cx02_1_252_PH_1_HEX_KPH_or_MPH (1~252 (PH)=1*(HEX) [KPH or MPH), 3=Cx03_1_252_PH_1_HEX_KPH_or_MPH (1~252 (PH)=1*(HEX) [KPH or MPH), 4=Cx04_1_252_PH_1_HEX_KPH_or_MPH (1~252 (PH)=1*(HEX) [KPH or MPH), 5=Cx05_1_252_PH_1_HEX_KPH_or_MPH (1~252 (PH)=1*(HEX) [KPH or MPH), 6=Cx06_1_252_PH_1_HEX_KPH_or_MPH (1~252 (PH)=1*(HEX) [KPH or MPH), 7=Cx07_1_252_PH_1_HEX_KPH_or_MPH (1~252 (PH)=1*(HEX) [KPH or MPH), 8=Cx08_1_252_PH_1_HEX_KPH_or_MPH (1~252 (PH)=1*(HEX) [KPH or MPH), 9=Cx09_1_252_PH_1_HEX_KPH_or_MPH (1~252 (PH)=1*(HEX) [KPH or MPH), 10=Cx0A_1_252_PH_1_HEX_KPH_or_MPH (1~252 (PH)=1*(HEX) [KPH or MPH), 11=Cx0B_1_252_PH_1_HEX_KPH_or_MPH (1~252 (PH)=1*(HEX) [KPH or MPH), 12=Cx0C_1_252_PH_1_HEX_KPH_or_MPH (1~252 (PH)=1*(HEX) [KPH or MPH), 13=Cx0D_1_252_PH_1_HEX_KPH_or_MPH (1~252 (PH)=1*(HEX) [KPH or MPH), 14=Cx0E_1_252_PH_1_HEX_KPH_or_MPH (1~252 (PH)=1*(HEX) [KPH or MPH), 15=Cx0F_1_252_PH_1_HEX_KPH_or_MPH (1~252 (PH)=1*(HEX) [KPH or MPH), 16=Cx10_1_252_PH_1_HEX_KPH_or_MPH (1~252 (PH)=1*(HEX) [KPH or MPH), 17=Cx11_1_252_PH_1_HEX_KPH_or_MPH (1~252 (PH)=1*(HEX) [KPH or MPH), 18=Cx12_1_252_PH_1_HEX_KPH_or_MPH (1~252 (PH)=1*(HEX) [KPH or MPH), 19=Cx13_1_252_PH_1_HEX_KPH_or_MPH (1~252 (PH)=1*(HEX) [KPH or MPH), 20=Cx14_1_252_PH_1_HEX_KPH_or_MPH (1~252 (PH)=1*(HEX) [KPH or MPH), 21=Cx15_1_252_PH_1_HEX_KPH_or_MPH (1~252 (PH)=1*(HEX) [KPH or MPH), 22=Cx16_1_252_PH_1_HEX_KPH_or_MPH (1~252 (PH)=1*(HEX) [KPH or MPH), 23=Cx17_1_252_PH_1_HEX_KPH_or_MPH (1~252 (PH)=1*(HEX) [KPH or MPH), 24=Cx18_1_252_PH_1_HEX_KPH_or_MPH (1~252 (PH)=1*(HEX) [KPH or MPH), 25=Cx19_1_252_PH_1_HEX_KPH_or_MPH (1~252 (PH)=1*(HEX) [KPH or MPH), 26=Cx1A_1_252_PH_1_HEX_KPH_or_MPH (1~252 (PH)=1*(HEX) [KPH or MPH), 27=Cx1B_1_252_PH_1_HEX_KPH_or_MPH (1~252 (PH)=1*(HEX) [KPH or MPH), 28=Cx1C_1_252_PH_1_HEX_KPH_or_MPH (1~252 (PH)=1*(HEX) [KPH or MPH), 29=Cx1D_1_252_PH_1_HEX_KPH_or_MPH (1~252 (PH)=1*(HEX) [KPH or MPH), 30=Cx1E_1_252_PH_1_HEX_KPH_or_MPH (1~252 (PH)=1*(HEX) [KPH or MPH), 31=Cx1F_1_252_PH_1_HEX_KPH_or_MPH (1~252 (PH)=1*(HEX) [KPH or MPH), 32=Cx20_1_252_PH_1_HEX_KPH_or_MPH (1~252 (PH)=1*(HEX) [KPH or MPH), 33=Cx21_1_252_PH_1_HEX_KPH_or_MPH (1~252 (PH)=1*(HEX) [KPH or MPH), 34=Cx22_1_252_PH_1_HEX_KPH_or_MPH (1~252 (PH)=1*(HEX) [KPH or MPH), 35=Cx23_1_252_PH_1_HEX_KPH_or_MPH (1~252 (PH)=1*(HEX) [KPH or MPH), 36=Cx24_1_252_PH_1_HEX_KPH_or_MPH (1~252 (PH)=1*(HEX) [KPH or MPH), 37=Cx25_1_252_PH_1_HEX_KPH_or_MPH (1~252 (PH)=1*(HEX) [KPH or MPH), 38=Cx26_1_252_PH_1_HEX_KPH_or_MPH (1~252 (PH)=1*(HEX) [KPH or MPH), 39=Cx27_1_252_PH_1_HEX_KPH_or_MPH (1~252 (PH)=1*(HEX) [KPH or MPH), 40=Cx28_1_252_PH_1_HEX_KPH_or_MPH (1~252 (PH)=1*(HEX) [KPH or MPH), 41=Cx29_1_252_PH_1_HEX_KPH_or_MPH (1~252 (PH)=1*(HEX) [KPH or MPH), 42=Cx2A_1_252_PH_1_HEX_KPH_or_MPH (1~252 (PH)=1*(HEX) [KPH or MPH), 43=Cx2B_1_252_PH_1_HEX_KPH_or_MPH (1~252 (PH)=1*(HEX) [KPH or MPH), 44=Cx2C_1_252_PH_1_HEX_KPH_or_MPH (1~252 (PH)=1*(HEX) [KPH or MPH), 45=Cx2D_1_252_PH_1_HEX_KPH_or_MPH (1~252 (PH)=1*(HEX) [KPH or MPH), 46=Cx2E_1_252_PH_1_HEX_KPH_or_MPH (1~252 (PH)=1*(HEX) [KPH or MPH), 47=Cx2F_1_252_PH_1_HEX_KPH_or_MPH (1~252 (PH)=1*(HEX) [KPH or MPH), 48=Cx30_1_252_PH_1_HEX_KPH_or_MPH (1~252 (PH)=1*(HEX) [KPH or MPH), 49=Cx31_1_252_PH_1_HEX_KPH_or_MPH (1~252 (PH)=1*(HEX) [KPH or MPH), 50=Cx32_1_252_PH_1_HEX_KPH_or_MPH (1~252 (PH)=1*(HEX) [KPH or MPH), 51=Cx33_1_252_PH_1_HEX_KPH_or_MPH (1~252 (PH)=1*(HEX) [KPH or MPH), 52=Cx34_1_252_PH_1_HEX_KPH_or_MPH (1~252 (PH)=1*(HEX) [KPH or MPH), 53=Cx35_1_252_PH_1_HEX_KPH_or_MPH (1~252 (PH)=1*(HEX) [KPH or MPH), 54=Cx36_1_252_PH_1_HEX_KPH_or_MPH (1~252 (PH)=1*(HEX) [KPH or MPH), 55=Cx37_1_252_PH_1_HEX_KPH_or_MPH (1~252 (PH)=1*(HEX) [KPH or MPH), 56=Cx38_1_252_PH_1_HEX_KPH_or_MPH (1~252 (PH)=1*(HEX) [KPH or MPH), 57=Cx39_1_252_PH_1_HEX_KPH_or_MPH (1~252 (PH)=1*(HEX) [KPH or MPH), 58=Cx3A_1_252_PH_1_HEX_KPH_or_MPH (1~252 (PH)=1*(HEX) [KPH or MPH), 59=Cx3B_1_252_PH_1_HEX_KPH_or_MPH (1~252 (PH)=1*(HEX) [KPH or MPH), 60=Cx3C_1_252_PH_1_HEX_KPH_or_MPH (1~252 (PH)=1*(HEX) [KPH or MPH), 61=Cx3D_1_252_PH_1_HEX_KPH_or_MPH (1~252 (PH)=1*(HEX) [KPH or MPH), 62=Cx3E_1_252_PH_1_HEX_KPH_or_MPH (1~252 (PH)=1*(HEX) [KPH or MPH), 63=Cx3F_1_252_PH_1_HEX_KPH_or_MPH (1~252 (PH)=1*(HEX) [KPH or MPH), 64=Cx40_1_252_PH_1_HEX_KPH_or_MPH (1~252 (PH)=1*(HEX) [KPH or MPH), 65=Cx41_1_252_PH_1_HEX_KPH_or_MPH (1~252 (PH)=1*(HEX) [KPH or MPH), 66=Cx42_1_252_PH_1_HEX_KPH_or_MPH (1~252 (PH)=1*(HEX) [KPH or MPH), 67=Cx43_1_252_PH_1_HEX_KPH_or_MPH (1~252 (PH)=1*(HEX) [KPH or MPH), 68=Cx44_1_252_PH_1_HEX_KPH_or_MPH (1~252 (PH)=1*(HEX) [KPH or MPH), 69=Cx45_1_252_PH_1_HEX_KPH_or_MPH (1~252 (PH)=1*(HEX) [KPH or MPH), 70=Cx46_1_252_PH_1_HEX_KPH_or_MPH (1~252 (PH)=1*(HEX) [KPH or MPH), 71=Cx47_1_252_PH_1_HEX_KPH_or_MPH (1~252 (PH)=1*(HEX) [KPH or MPH), 72=Cx48_1_252_PH_1_HEX_KPH_or_MPH (1~252 (PH)=1*(HEX) [KPH or MPH), 73=Cx49_1_252_PH_1_HEX_KPH_or_MPH (1~252 (PH)=1*(HEX) [KPH or MPH), 74=Cx4A_1_252_PH_1_HEX_KPH_or_MPH (1~252 (PH)=1*(HEX) [KPH or MPH), 75=Cx4B_1_252_PH_1_HEX_KPH_or_MPH (1~252 (PH)=1*(HEX) [KPH or MPH), 76=Cx4C_1_252_PH_1_HEX_KPH_or_MPH (1~252 (PH)=1*(HEX) [KPH or MPH), 77=Cx4D_1_252_PH_1_HEX_KPH_or_MPH (1~252 (PH)=1*(HEX) [KPH or MPH), 78=Cx4E_1_252_PH_1_HEX_KPH_or_MPH (1~252 (PH)=1*(HEX) [KPH or MPH), 79=Cx4F_1_252_PH_1_HEX_KPH_or_MPH (1~252 (PH)=1*(HEX) [KPH or MPH), 80=Cx50_1_252_PH_1_HEX_KPH_or_MPH (1~252 (PH)=1*(HEX) [KPH or MPH), 81=Cx51_1_252_PH_1_HEX_KPH_or_MPH (1~252 (PH)=1*(HEX) [KPH or MPH), 82=Cx52_1_252_PH_1_HEX_KPH_or_MPH (1~252 (PH)=1*(HEX) [KPH or MPH), 83=Cx53_1_252_PH_1_HEX_KPH_or_MPH (1~252 (PH)=1*(HEX) [KPH or MPH), 84=Cx54_1_252_PH_1_HEX_KPH_or_MPH (1~252 (PH)=1*(HEX) [KPH or MPH), 85=Cx55_1_252_PH_1_HEX_KPH_or_MPH (1~252 (PH)=1*(HEX) [KPH or MPH), 86=Cx56_1_252_PH_1_HEX_KPH_or_MPH (1~252 (PH)=1*(HEX) [KPH or MPH), 87=Cx57_1_252_PH_1_HEX_KPH_or_MPH (1~252 (PH)=1*(HEX) [KPH or MPH), 88=Cx58_1_252_PH_1_HEX_KPH_or_MPH (1~252 (PH)=1*(HEX) [KPH or MPH), 89=Cx59_1_252_PH_1_HEX_KPH_or_MPH (1~252 (PH)=1*(HEX) [KPH or MPH), 90=Cx5A_1_252_PH_1_HEX_KPH_or_MPH (1~252 (PH)=1*(HEX) [KPH or MPH), 91=Cx5B_1_252_PH_1_HEX_KPH_or_MPH (1~252 (PH)=1*(HEX) [KPH or MPH), 92=Cx5C_1_252_PH_1_HEX_KPH_or_MPH (1~252 (PH)=1*(HEX) [KPH or MPH), 93=Cx5D_1_252_PH_1_HEX_KPH_or_MPH (1~252 (PH)=1*(HEX) [KPH or MPH), 94=Cx5E_1_252_PH_1_HEX_KPH_or_MPH (1~252 (PH)=1*(HEX) [KPH or MPH), 95=Cx5F_1_252_PH_1_HEX_KPH_or_MPH (1~252 (PH)=1*(HEX) [KPH or MPH), 96=Cx60_1_252_PH_1_HEX_KPH_or_MPH (1~252 (PH)=1*(HEX) [KPH or MPH), 97=Cx61_1_252_PH_1_HEX_KPH_or_MPH (1~252 (PH)=1*(HEX) [KPH or MPH), 98=Cx62_1_252_PH_1_HEX_KPH_or_MPH (1~252 (PH)=1*(HEX) [KPH or MPH), 99=Cx63_1_252_PH_1_HEX_KPH_or_MPH (1~252 (PH)=1*(HEX) [KPH or MPH), 100=Cx64_1_252_PH_1_HEX_KPH_or_MPH (1~252 (PH)=1*(HEX) [KPH or MPH), 101=Cx65_1_252_PH_1_HEX_KPH_or_MPH (1~252 (PH)=1*(HEX) [KPH or MPH), 102=Cx66_1_252_PH_1_HEX_KPH_or_MPH (1~252 (PH)=1*(HEX) [KPH or MPH), 103=Cx67_1_252_PH_1_HEX_KPH_or_MPH (1~252 (PH)=1*(HEX) [KPH or MPH), 104=Cx68_1_252_PH_1_HEX_KPH_or_MPH (1~252 (PH)=1*(HEX) [KPH or MPH), 105=Cx69_1_252_PH_1_HEX_KPH_or_MPH (1~252 (PH)=1*(HEX) [KPH or MPH), 106=Cx6A_1_252_PH_1_HEX_KPH_or_MPH (1~252 (PH)=1*(HEX) [KPH or MPH), 107=Cx6B_1_252_PH_1_HEX_KPH_or_MPH (1~252 (PH)=1*(HEX) [KPH or MPH), 108=Cx6C_1_252_PH_1_HEX_KPH_or_MPH (1~252 (PH)=1*(HEX) [KPH or MPH), 109=Cx6D_1_252_PH_1_HEX_KPH_or_MPH (1~252 (PH)=1*(HEX) [KPH or MPH), 110=Cx6E_1_252_PH_1_HEX_KPH_or_MPH (1~252 (PH)=1*(HEX) [KPH or MPH), 111=Cx6F_1_252_PH_1_HEX_KPH_or_MPH (1~252 (PH)=1*(HEX) [KPH or MPH), 112=Cx70_1_252_PH_1_HEX_KPH_or_MPH (1~252 (PH)=1*(HEX) [KPH or MPH), 113=Cx71_1_252_PH_1_HEX_KPH_or_MPH (1~252 (PH)=1*(HEX) [KPH or MPH), 114=Cx72_1_252_PH_1_HEX_KPH_or_MPH (1~252 (PH)=1*(HEX) [KPH or MPH), 115=Cx73_1_252_PH_1_HEX_KPH_or_MPH (1~252 (PH)=1*(HEX) [KPH or MPH), 116=Cx74_1_252_PH_1_HEX_KPH_or_MPH (1~252 (PH)=1*(HEX) [KPH or MPH), 117=Cx75_1_252_PH_1_HEX_KPH_or_MPH (1~252 (PH)=1*(HEX) [KPH or MPH), 118=Cx76_1_252_PH_1_HEX_KPH_or_MPH (1~252 (PH)=1*(HEX) [KPH or MPH), 119=Cx77_1_252_PH_1_HEX_KPH_or_MPH (1~252 (PH)=1*(HEX) [KPH or MPH), 120=Cx78_1_252_PH_1_HEX_KPH_or_MPH (1~252 (PH)=1*(HEX) [KPH or MPH), 121=Cx79_1_252_PH_1_HEX_KPH_or_MPH (1~252 (PH)=1*(HEX) [KPH or MPH), 122=Cx7A_1_252_PH_1_HEX_KPH_or_MPH (1~252 (PH)=1*(HEX) [KPH or MPH), 123=Cx7B_1_252_PH_1_HEX_KPH_or_MPH (1~252 (PH)=1*(HEX) [KPH or MPH), 124=Cx7C_1_252_PH_1_HEX_KPH_or_MPH (1~252 (PH)=1*(HEX) [KPH or MPH), 125=Cx7D_1_252_PH_1_HEX_KPH_or_MPH (1~252 (PH)=1*(HEX) [KPH or MPH), 126=Cx7E_1_252_PH_1_HEX_KPH_or_MPH (1~252 (PH)=1*(HEX) [KPH or MPH), 127=Cx7F_1_252_PH_1_HEX_KPH_or_MPH (1~252 (PH)=1*(HEX) [KPH or MPH), 128=Cx80_1_252_PH_1_HEX_KPH_or_MPH (1~252 (PH)=1*(HEX) [KPH or MPH), 129=Cx81_1_252_PH_1_HEX_KPH_or_MPH (1~252 (PH)=1*(HEX) [KPH or MPH), 130=Cx82_1_252_PH_1_HEX_KPH_or_MPH (1~252 (PH)=1*(HEX) [KPH or MPH), 131=Cx83_1_252_PH_1_HEX_KPH_or_MPH (1~252 (PH)=1*(HEX) [KPH or MPH), 132=Cx84_1_252_PH_1_HEX_KPH_or_MPH (1~252 (PH)=1*(HEX) [KPH or MPH), 133=Cx85_1_252_PH_1_HEX_KPH_or_MPH (1~252 (PH)=1*(HEX) [KPH or MPH), 134=Cx86_1_252_PH_1_HEX_KPH_or_MPH (1~252 (PH)=1*(HEX) [KPH or MPH), 135=Cx87_1_252_PH_1_HEX_KPH_or_MPH (1~252 (PH)=1*(HEX) [KPH or MPH), 136=Cx88_1_252_PH_1_HEX_KPH_or_MPH (1~252 (PH)=1*(HEX) [KPH or MPH), 137=Cx89_1_252_PH_1_HEX_KPH_or_MPH (1~252 (PH)=1*(HEX) [KPH or MPH), 138=Cx8A_1_252_PH_1_HEX_KPH_or_MPH (1~252 (PH)=1*(HEX) [KPH or MPH), 139=Cx8B_1_252_PH_1_HEX_KPH_or_MPH (1~252 (PH)=1*(HEX) [KPH or MPH), 140=Cx8C_1_252_PH_1_HEX_KPH_or_MPH (1~252 (PH)=1*(HEX) [KPH or MPH), 141=Cx8D_1_252_PH_1_HEX_KPH_or_MPH (1~252 (PH)=1*(HEX) [KPH or MPH), 142=Cx8E_1_252_PH_1_HEX_KPH_or_MPH (1~252 (PH)=1*(HEX) [KPH or MPH), 143=Cx8F_1_252_PH_1_HEX_KPH_or_MPH (1~252 (PH)=1*(HEX) [KPH or MPH), 144=Cx90_1_252_PH_1_HEX_KPH_or_MPH (1~252 (PH)=1*(HEX) [KPH or MPH), 145=Cx91_1_252_PH_1_HEX_KPH_or_MPH (1~252 (PH)=1*(HEX) [KPH or MPH), 146=Cx92_1_252_PH_1_HEX_KPH_or_MPH (1~252 (PH)=1*(HEX) [KPH or MPH), 147=Cx93_1_252_PH_1_HEX_KPH_or_MPH (1~252 (PH)=1*(HEX) [KPH or MPH), 148=Cx94_1_252_PH_1_HEX_KPH_or_MPH (1~252 (PH)=1*(HEX) [KPH or MPH), 149=Cx95_1_252_PH_1_HEX_KPH_or_MPH (1~252 (PH)=1*(HEX) [KPH or MPH), 150=Cx96_1_252_PH_1_HEX_KPH_or_MPH (1~252 (PH)=1*(HEX) [KPH or MPH), 151=Cx97_1_252_PH_1_HEX_KPH_or_MPH (1~252 (PH)=1*(HEX) [KPH or MPH), 152=Cx98_1_252_PH_1_HEX_KPH_or_MPH (1~252 (PH)=1*(HEX) [KPH or MPH), 153=Cx99_1_252_PH_1_HEX_KPH_or_MPH (1~252 (PH)=1*(HEX) [KPH or MPH), 154=Cx9A_1_252_PH_1_HEX_KPH_or_MPH (1~252 (PH)=1*(HEX) [KPH or MPH), 155=Cx9B_1_252_PH_1_HEX_KPH_or_MPH (1~252 (PH)=1*(HEX) [KPH or MPH), 156=Cx9C_1_252_PH_1_HEX_KPH_or_MPH (1~252 (PH)=1*(HEX) [KPH or MPH), 157=Cx9D_1_252_PH_1_HEX_KPH_or_MPH (1~252 (PH)=1*(HEX) [KPH or MPH), 158=Cx9E_1_252_PH_1_HEX_KPH_or_MPH (1~252 (PH)=1*(HEX) [KPH or MPH), 159=Cx9F_1_252_PH_1_HEX_KPH_or_MPH (1~252 (PH)=1*(HEX) [KPH or MPH), 160=CxA0_1_252_PH_1_HEX_KPH_or_MPH (1~252 (PH)=1*(HEX) [KPH or MPH), 161=CxA1_1_252_PH_1_HEX_KPH_or_MPH (1~252 (PH)=1*(HEX) [KPH or MPH), 162=CxA2_1_252_PH_1_HEX_KPH_or_MPH (1~252 (PH)=1*(HEX) [KPH or MPH), 163=CxA3_1_252_PH_1_HEX_KPH_or_MPH (1~252 (PH)=1*(HEX) [KPH or MPH), 164=CxA4_1_252_PH_1_HEX_KPH_or_MPH (1~252 (PH)=1*(HEX) [KPH or MPH), 165=CxA5_1_252_PH_1_HEX_KPH_or_MPH (1~252 (PH)=1*(HEX) [KPH or MPH), 166=CxA6_1_252_PH_1_HEX_KPH_or_MPH (1~252 (PH)=1*(HEX) [KPH or MPH), 167=CxA7_1_252_PH_1_HEX_KPH_or_MPH (1~252 (PH)=1*(HEX) [KPH or MPH), 168=CxA8_1_252_PH_1_HEX_KPH_or_MPH (1~252 (PH)=1*(HEX) [KPH or MPH), 169=CxA9_1_252_PH_1_HEX_KPH_or_MPH (1~252 (PH)=1*(HEX) [KPH or MPH), 170=CxAA_1_252_PH_1_HEX_KPH_or_MPH (1~252 (PH)=1*(HEX) [KPH or MPH), 171=CxAB_1_252_PH_1_HEX_KPH_or_MPH (1~252 (PH)=1*(HEX) [KPH or MPH), 172=CxAC_1_252_PH_1_HEX_KPH_or_MPH (1~252 (PH)=1*(HEX) [KPH or MPH), 173=CxAD_1_252_PH_1_HEX_KPH_or_MPH (1~252 (PH)=1*(HEX) [KPH or MPH), 174=CxAE_1_252_PH_1_HEX_KPH_or_MPH (1~252 (PH)=1*(HEX) [KPH or MPH), 175=CxAF_1_252_PH_1_HEX_KPH_or_MPH (1~252 (PH)=1*(HEX) [KPH or MPH), 176=CxB0_1_252_PH_1_HEX_KPH_or_MPH (1~252 (PH)=1*(HEX) [KPH or MPH), 177=CxB1_1_252_PH_1_HEX_KPH_or_MPH (1~252 (PH)=1*(HEX) [KPH or MPH), 178=CxB2_1_252_PH_1_HEX_KPH_or_MPH (1~252 (PH)=1*(HEX) [KPH or MPH), 179=CxB3_1_252_PH_1_HEX_KPH_or_MPH (1~252 (PH)=1*(HEX) [KPH or MPH), 180=CxB4_1_252_PH_1_HEX_KPH_or_MPH (1~252 (PH)=1*(HEX) [KPH or MPH), 181=CxB5_1_252_PH_1_HEX_KPH_or_MPH (1~252 (PH)=1*(HEX) [KPH or MPH), 182=CxB6_1_252_PH_1_HEX_KPH_or_MPH (1~252 (PH)=1*(HEX) [KPH or MPH), 183=CxB7_1_252_PH_1_HEX_KPH_or_MPH (1~252 (PH)=1*(HEX) [KPH or MPH), 184=CxB8_1_252_PH_1_HEX_KPH_or_MPH (1~252 (PH)=1*(HEX) [KPH or MPH), 185=CxB9_1_252_PH_1_HEX_KPH_or_MPH (1~252 (PH)=1*(HEX) [KPH or MPH), 186=CxBA_1_252_PH_1_HEX_KPH_or_MPH (1~252 (PH)=1*(HEX) [KPH or MPH), 187=CxBB_1_252_PH_1_HEX_KPH_or_MPH (1~252 (PH)=1*(HEX) [KPH or MPH), 188=CxBC_1_252_PH_1_HEX_KPH_or_MPH (1~252 (PH)=1*(HEX) [KPH or MPH), 189=CxBD_1_252_PH_1_HEX_KPH_or_MPH (1~252 (PH)=1*(HEX) [KPH or MPH), 190=CxBE_1_252_PH_1_HEX_KPH_or_MPH (1~252 (PH)=1*(HEX) [KPH or MPH), 191=CxBF_1_252_PH_1_HEX_KPH_or_MPH (1~252 (PH)=1*(HEX) [KPH or MPH), 192=CxC0_1_252_PH_1_HEX_KPH_or_MPH (1~252 (PH)=1*(HEX) [KPH or MPH), 193=CxC1_1_252_PH_1_HEX_KPH_or_MPH (1~252 (PH)=1*(HEX) [KPH or MPH), 194=CxC2_1_252_PH_1_HEX_KPH_or_MPH (1~252 (PH)=1*(HEX) [KPH or MPH), 195=CxC3_1_252_PH_1_HEX_KPH_or_MPH (1~252 (PH)=1*(HEX) [KPH or MPH), 196=CxC4_1_252_PH_1_HEX_KPH_or_MPH (1~252 (PH)=1*(HEX) [KPH or MPH), 197=CxC5_1_252_PH_1_HEX_KPH_or_MPH (1~252 (PH)=1*(HEX) [KPH or MPH), 198=CxC6_1_252_PH_1_HEX_KPH_or_MPH (1~252 (PH)=1*(HEX) [KPH or MPH), 199=CxC7_1_252_PH_1_HEX_KPH_or_MPH (1~252 (PH)=1*(HEX) [KPH or MPH), 200=CxC8_1_252_PH_1_HEX_KPH_or_MPH (1~252 (PH)=1*(HEX) [KPH or MPH), 201=CxC9_1_252_PH_1_HEX_KPH_or_MPH (1~252 (PH)=1*(HEX) [KPH or MPH), 202=CxCA_1_252_PH_1_HEX_KPH_or_MPH (1~252 (PH)=1*(HEX) [KPH or MPH), 203=CxCB_1_252_PH_1_HEX_KPH_or_MPH (1~252 (PH)=1*(HEX) [KPH or MPH), 204=CxCC_1_252_PH_1_HEX_KPH_or_MPH (1~252 (PH)=1*(HEX) [KPH or MPH), 205=CxCD_1_252_PH_1_HEX_KPH_or_MPH (1~252 (PH)=1*(HEX) [KPH or MPH), 206=CxCE_1_252_PH_1_HEX_KPH_or_MPH (1~252 (PH)=1*(HEX) [KPH or MPH), 207=CxCF_1_252_PH_1_HEX_KPH_or_MPH (1~252 (PH)=1*(HEX) [KPH or MPH), 208=CxD0_1_252_PH_1_HEX_KPH_or_MPH (1~252 (PH)=1*(HEX) [KPH or MPH), 209=CxD1_1_252_PH_1_HEX_KPH_or_MPH (1~252 (PH)=1*(HEX) [KPH or MPH), 210=CxD2_1_252_PH_1_HEX_KPH_or_MPH (1~252 (PH)=1*(HEX) [KPH or MPH), 211=CxD3_1_252_PH_1_HEX_KPH_or_MPH (1~252 (PH)=1*(HEX) [KPH or MPH), 212=CxD4_1_252_PH_1_HEX_KPH_or_MPH (1~252 (PH)=1*(HEX) [KPH or MPH), 213=CxD5_1_252_PH_1_HEX_KPH_or_MPH (1~252 (PH)=1*(HEX) [KPH or MPH), 214=CxD6_1_252_PH_1_HEX_KPH_or_MPH (1~252 (PH)=1*(HEX) [KPH or MPH), 215=CxD7_1_252_PH_1_HEX_KPH_or_MPH (1~252 (PH)=1*(HEX) [KPH or MPH), 216=CxD8_1_252_PH_1_HEX_KPH_or_MPH (1~252 (PH)=1*(HEX) [KPH or MPH), 217=CxD9_1_252_PH_1_HEX_KPH_or_MPH (1~252 (PH)=1*(HEX) [KPH or MPH), 218=CxDA_1_252_PH_1_HEX_KPH_or_MPH (1~252 (PH)=1*(HEX) [KPH or MPH), 219=CxDB_1_252_PH_1_HEX_KPH_or_MPH (1~252 (PH)=1*(HEX) [KPH or MPH), 220=CxDC_1_252_PH_1_HEX_KPH_or_MPH (1~252 (PH)=1*(HEX) [KPH or MPH), 221=CxDD_1_252_PH_1_HEX_KPH_or_MPH (1~252 (PH)=1*(HEX) [KPH or MPH), 222=CxDE_1_252_PH_1_HEX_KPH_or_MPH (1~252 (PH)=1*(HEX) [KPH or MPH), 223=CxDF_1_252_PH_1_HEX_KPH_or_MPH (1~252 (PH)=1*(HEX) [KPH or MPH), 224=CxE0_1_252_PH_1_HEX_KPH_or_MPH (1~252 (PH)=1*(HEX) [KPH or MPH), 225=CxE1_1_252_PH_1_HEX_KPH_or_MPH (1~252 (PH)=1*(HEX) [KPH or MPH), 226=CxE2_1_252_PH_1_HEX_KPH_or_MPH (1~252 (PH)=1*(HEX) [KPH or MPH), 227=CxE3_1_252_PH_1_HEX_KPH_or_MPH (1~252 (PH)=1*(HEX) [KPH or MPH), 228=CxE4_1_252_PH_1_HEX_KPH_or_MPH (1~252 (PH)=1*(HEX) [KPH or MPH), 229=CxE5_1_252_PH_1_HEX_KPH_or_MPH (1~252 (PH)=1*(HEX) [KPH or MPH), 230=CxE6_1_252_PH_1_HEX_KPH_or_MPH (1~252 (PH)=1*(HEX) [KPH or MPH), 231=CxE7_1_252_PH_1_HEX_KPH_or_MPH (1~252 (PH)=1*(HEX) [KPH or MPH), 232=CxE8_1_252_PH_1_HEX_KPH_or_MPH (1~252 (PH)=1*(HEX) [KPH or MPH), 233=CxE9_1_252_PH_1_HEX_KPH_or_MPH (1~252 (PH)=1*(HEX) [KPH or MPH), 234=CxEA_1_252_PH_1_HEX_KPH_or_MPH (1~252 (PH)=1*(HEX) [KPH or MPH), 235=CxEB_1_252_PH_1_HEX_KPH_or_MPH (1~252 (PH)=1*(HEX) [KPH or MPH), 236=CxEC_1_252_PH_1_HEX_KPH_or_MPH (1~252 (PH)=1*(HEX) [KPH or MPH), 237=CxED_1_252_PH_1_HEX_KPH_or_MPH (1~252 (PH)=1*(HEX) [KPH or MPH), 238=CxEE_1_252_PH_1_HEX_KPH_or_MPH (1~252 (PH)=1*(HEX) [KPH or MPH), 239=CxEF_1_252_PH_1_HEX_KPH_or_MPH (1~252 (PH)=1*(HEX) [KPH or MPH), 240=CxF0_1_252_PH_1_HEX_KPH_or_MPH (1~252 (PH)=1*(HEX) [KPH or MPH), 241=CxF1_1_252_PH_1_HEX_KPH_or_MPH (1~252 (PH)=1*(HEX) [KPH or MPH), 242=CxF2_1_252_PH_1_HEX_KPH_or_MPH (1~252 (PH)=1*(HEX) [KPH or MPH), 243=CxF3_1_252_PH_1_HEX_KPH_or_MPH (1~252 (PH)=1*(HEX) [KPH or MPH), 244=CxF4_1_252_PH_1_HEX_KPH_or_MPH (1~252 (PH)=1*(HEX) [KPH or MPH), 245=CxF5_1_252_PH_1_HEX_KPH_or_MPH (1~252 (PH)=1*(HEX) [KPH or MPH), 246=CxF6_1_252_PH_1_HEX_KPH_or_MPH (1~252 (PH)=1*(HEX) [KPH or MPH), 247=CxF7_1_252_PH_1_HEX_KPH_or_MPH (1~252 (PH)=1*(HEX) [KPH or MPH), 248=CxF8_1_252_PH_1_HEX_KPH_or_MPH (1~252 (PH)=1*(HEX) [KPH or MPH), 249=CxF9_1_252_PH_1_HEX_KPH_or_MPH (1~252 (PH)=1*(HEX) [KPH or MPH), 250=CxFA_1_252_PH_1_HEX_KPH_or_MPH (1~252 (PH)=1*(HEX) [KPH or MPH), 251=CxFB_1_252_PH_1_HEX_KPH_or_MPH (1~252 (PH)=1*(HEX) [KPH or MPH), 252=CxFC_1_252_PH_1_HEX_KPH_or_MPH (1~252 (PH)=1*(HEX) [KPH or MPH), 253=CxFD_ISLW_SDN1_LHD_Conditional_No_Passing_ZONE (LHD Conditional No Passing ZONE), 254=CxFE_ISLW_SDN1_RHD_Conditional_No_Passing_ZONE (RHD Conditional No Passing ZONE), 255=CxFF_ISLW_SDN1_Invalid}
    CF_ISLW_Spd_Dis_NAVI_Con2:
      category=VALUE
      base-type=DataType/uint8
      compu {0=Cx00_ISLW_SDN2_No_Recognition_Default_ (No Recognition (Default)), 1=Cx01_1_252_PH_1_HEX_KPH_or_MPH (1~252 (PH)=1*(HEX) [KPH or MPH), 2=Cx02_1_252_PH_1_HEX_KPH_or_MPH (1~252 (PH)=1*(HEX) [KPH or MPH), 3=Cx03_1_252_PH_1_HEX_KPH_or_MPH (1~252 (PH)=1*(HEX) [KPH or MPH), 4=Cx04_1_252_PH_1_HEX_KPH_or_MPH (1~252 (PH)=1*(HEX) [KPH or MPH), 5=Cx05_1_252_PH_1_HEX_KPH_or_MPH (1~252 (PH)=1*(HEX) [KPH or MPH), 6=Cx06_1_252_PH_1_HEX_KPH_or_MPH (1~252 (PH)=1*(HEX) [KPH or MPH), 7=Cx07_1_252_PH_1_HEX_KPH_or_MPH (1~252 (PH)=1*(HEX) [KPH or MPH), 8=Cx08_1_252_PH_1_HEX_KPH_or_MPH (1~252 (PH)=1*(HEX) [KPH or MPH), 9=Cx09_1_252_PH_1_HEX_KPH_or_MPH (1~252 (PH)=1*(HEX) [KPH or MPH), 10=Cx0A_1_252_PH_1_HEX_KPH_or_MPH (1~252 (PH)=1*(HEX) [KPH or MPH), 11=Cx0B_1_252_PH_1_HEX_KPH_or_MPH (1~252 (PH)=1*(HEX) [KPH or MPH), 12=Cx0C_1_252_PH_1_HEX_KPH_or_MPH (1~252 (PH)=1*(HEX) [KPH or MPH), 13=Cx0D_1_252_PH_1_HEX_KPH_or_MPH (1~252 (PH)=1*(HEX) [KPH or MPH), 14=Cx0E_1_252_PH_1_HEX_KPH_or_MPH (1~252 (PH)=1*(HEX) [KPH or MPH), 15=Cx0F_1_252_PH_1_HEX_KPH_or_MPH (1~252 (PH)=1*(HEX) [KPH or MPH), 16=Cx10_1_252_PH_1_HEX_KPH_or_MPH (1~252 (PH)=1*(HEX) [KPH or MPH), 17=Cx11_1_252_PH_1_HEX_KPH_or_MPH (1~252 (PH)=1*(HEX) [KPH or MPH), 18=Cx12_1_252_PH_1_HEX_KPH_or_MPH (1~252 (PH)=1*(HEX) [KPH or MPH), 19=Cx13_1_252_PH_1_HEX_KPH_or_MPH (1~252 (PH)=1*(HEX) [KPH or MPH), 20=Cx14_1_252_PH_1_HEX_KPH_or_MPH (1~252 (PH)=1*(HEX) [KPH or MPH), 21=Cx15_1_252_PH_1_HEX_KPH_or_MPH (1~252 (PH)=1*(HEX) [KPH or MPH), 22=Cx16_1_252_PH_1_HEX_KPH_or_MPH (1~252 (PH)=1*(HEX) [KPH or MPH), 23=Cx17_1_252_PH_1_HEX_KPH_or_MPH (1~252 (PH)=1*(HEX) [KPH or MPH), 24=Cx18_1_252_PH_1_HEX_KPH_or_MPH (1~252 (PH)=1*(HEX) [KPH or MPH), 25=Cx19_1_252_PH_1_HEX_KPH_or_MPH (1~252 (PH)=1*(HEX) [KPH or MPH), 26=Cx1A_1_252_PH_1_HEX_KPH_or_MPH (1~252 (PH)=1*(HEX) [KPH or MPH), 27=Cx1B_1_252_PH_1_HEX_KPH_or_MPH (1~252 (PH)=1*(HEX) [KPH or MPH), 28=Cx1C_1_252_PH_1_HEX_KPH_or_MPH (1~252 (PH)=1*(HEX) [KPH or MPH), 29=Cx1D_1_252_PH_1_HEX_KPH_or_MPH (1~252 (PH)=1*(HEX) [KPH or MPH), 30=Cx1E_1_252_PH_1_HEX_KPH_or_MPH (1~252 (PH)=1*(HEX) [KPH or MPH), 31=Cx1F_1_252_PH_1_HEX_KPH_or_MPH (1~252 (PH)=1*(HEX) [KPH or MPH), 32=Cx20_1_252_PH_1_HEX_KPH_or_MPH (1~252 (PH)=1*(HEX) [KPH or MPH), 33=Cx21_1_252_PH_1_HEX_KPH_or_MPH (1~252 (PH)=1*(HEX) [KPH or MPH), 34=Cx22_1_252_PH_1_HEX_KPH_or_MPH (1~252 (PH)=1*(HEX) [KPH or MPH), 35=Cx23_1_252_PH_1_HEX_KPH_or_MPH (1~252 (PH)=1*(HEX) [KPH or MPH), 36=Cx24_1_252_PH_1_HEX_KPH_or_MPH (1~252 (PH)=1*(HEX) [KPH or MPH), 37=Cx25_1_252_PH_1_HEX_KPH_or_MPH (1~252 (PH)=1*(HEX) [KPH or MPH), 38=Cx26_1_252_PH_1_HEX_KPH_or_MPH (1~252 (PH)=1*(HEX) [KPH or MPH), 39=Cx27_1_252_PH_1_HEX_KPH_or_MPH (1~252 (PH)=1*(HEX) [KPH or MPH), 40=Cx28_1_252_PH_1_HEX_KPH_or_MPH (1~252 (PH)=1*(HEX) [KPH or MPH), 41=Cx29_1_252_PH_1_HEX_KPH_or_MPH (1~252 (PH)=1*(HEX) [KPH or MPH), 42=Cx2A_1_252_PH_1_HEX_KPH_or_MPH (1~252 (PH)=1*(HEX) [KPH or MPH), 43=Cx2B_1_252_PH_1_HEX_KPH_or_MPH (1~252 (PH)=1*(HEX) [KPH or MPH), 44=Cx2C_1_252_PH_1_HEX_KPH_or_MPH (1~252 (PH)=1*(HEX) [KPH or MPH), 45=Cx2D_1_252_PH_1_HEX_KPH_or_MPH (1~252 (PH)=1*(HEX) [KPH or MPH), 46=Cx2E_1_252_PH_1_HEX_KPH_or_MPH (1~252 (PH)=1*(HEX) [KPH or MPH), 47=Cx2F_1_252_PH_1_HEX_KPH_or_MPH (1~252 (PH)=1*(HEX) [KPH or MPH), 48=Cx30_1_252_PH_1_HEX_KPH_or_MPH (1~252 (PH)=1*(HEX) [KPH or MPH), 49=Cx31_1_252_PH_1_HEX_KPH_or_MPH (1~252 (PH)=1*(HEX) [KPH or MPH), 50=Cx32_1_252_PH_1_HEX_KPH_or_MPH (1~252 (PH)=1*(HEX) [KPH or MPH), 51=Cx33_1_252_PH_1_HEX_KPH_or_MPH (1~252 (PH)=1*(HEX) [KPH or MPH), 52=Cx34_1_252_PH_1_HEX_KPH_or_MPH (1~252 (PH)=1*(HEX) [KPH or MPH), 53=Cx35_1_252_PH_1_HEX_KPH_or_MPH (1~252 (PH)=1*(HEX) [KPH or MPH), 54=Cx36_1_252_PH_1_HEX_KPH_or_MPH (1~252 (PH)=1*(HEX) [KPH or MPH), 55=Cx37_1_252_PH_1_HEX_KPH_or_MPH (1~252 (PH)=1*(HEX) [KPH or MPH), 56=Cx38_1_252_PH_1_HEX_KPH_or_MPH (1~252 (PH)=1*(HEX) [KPH or MPH), 57=Cx39_1_252_PH_1_HEX_KPH_or_MPH (1~252 (PH)=1*(HEX) [KPH or MPH), 58=Cx3A_1_252_PH_1_HEX_KPH_or_MPH (1~252 (PH)=1*(HEX) [KPH or MPH), 59=Cx3B_1_252_PH_1_HEX_KPH_or_MPH (1~252 (PH)=1*(HEX) [KPH or MPH), 60=Cx3C_1_252_PH_1_HEX_KPH_or_MPH (1~252 (PH)=1*(HEX) [KPH or MPH), 61=Cx3D_1_252_PH_1_HEX_KPH_or_MPH (1~252 (PH)=1*(HEX) [KPH or MPH), 62=Cx3E_1_252_PH_1_HEX_KPH_or_MPH (1~252 (PH)=1*(HEX) [KPH or MPH), 63=Cx3F_1_252_PH_1_HEX_KPH_or_MPH (1~252 (PH)=1*(HEX) [KPH or MPH), 64=Cx40_1_252_PH_1_HEX_KPH_or_MPH (1~252 (PH)=1*(HEX) [KPH or MPH), 65=Cx41_1_252_PH_1_HEX_KPH_or_MPH (1~252 (PH)=1*(HEX) [KPH or MPH), 66=Cx42_1_252_PH_1_HEX_KPH_or_MPH (1~252 (PH)=1*(HEX) [KPH or MPH), 67=Cx43_1_252_PH_1_HEX_KPH_or_MPH (1~252 (PH)=1*(HEX) [KPH or MPH), 68=Cx44_1_252_PH_1_HEX_KPH_or_MPH (1~252 (PH)=1*(HEX) [KPH or MPH), 69=Cx45_1_252_PH_1_HEX_KPH_or_MPH (1~252 (PH)=1*(HEX) [KPH or MPH), 70=Cx46_1_252_PH_1_HEX_KPH_or_MPH (1~252 (PH)=1*(HEX) [KPH or MPH), 71=Cx47_1_252_PH_1_HEX_KPH_or_MPH (1~252 (PH)=1*(HEX) [KPH or MPH), 72=Cx48_1_252_PH_1_HEX_KPH_or_MPH (1~252 (PH)=1*(HEX) [KPH or MPH), 73=Cx49_1_252_PH_1_HEX_KPH_or_MPH (1~252 (PH)=1*(HEX) [KPH or MPH), 74=Cx4A_1_252_PH_1_HEX_KPH_or_MPH (1~252 (PH)=1*(HEX) [KPH or MPH), 75=Cx4B_1_252_PH_1_HEX_KPH_or_MPH (1~252 (PH)=1*(HEX) [KPH or MPH), 76=Cx4C_1_252_PH_1_HEX_KPH_or_MPH (1~252 (PH)=1*(HEX) [KPH or MPH), 77=Cx4D_1_252_PH_1_HEX_KPH_or_MPH (1~252 (PH)=1*(HEX) [KPH or MPH), 78=Cx4E_1_252_PH_1_HEX_KPH_or_MPH (1~252 (PH)=1*(HEX) [KPH or MPH), 79=Cx4F_1_252_PH_1_HEX_KPH_or_MPH (1~252 (PH)=1*(HEX) [KPH or MPH), 80=Cx50_1_252_PH_1_HEX_KPH_or_MPH (1~252 (PH)=1*(HEX) [KPH or MPH), 81=Cx51_1_252_PH_1_HEX_KPH_or_MPH (1~252 (PH)=1*(HEX) [KPH or MPH), 82=Cx52_1_252_PH_1_HEX_KPH_or_MPH (1~252 (PH)=1*(HEX) [KPH or MPH), 83=Cx53_1_252_PH_1_HEX_KPH_or_MPH (1~252 (PH)=1*(HEX) [KPH or MPH), 84=Cx54_1_252_PH_1_HEX_KPH_or_MPH (1~252 (PH)=1*(HEX) [KPH or MPH), 85=Cx55_1_252_PH_1_HEX_KPH_or_MPH (1~252 (PH)=1*(HEX) [KPH or MPH), 86=Cx56_1_252_PH_1_HEX_KPH_or_MPH (1~252 (PH)=1*(HEX) [KPH or MPH), 87=Cx57_1_252_PH_1_HEX_KPH_or_MPH (1~252 (PH)=1*(HEX) [KPH or MPH), 88=Cx58_1_252_PH_1_HEX_KPH_or_MPH (1~252 (PH)=1*(HEX) [KPH or MPH), 89=Cx59_1_252_PH_1_HEX_KPH_or_MPH (1~252 (PH)=1*(HEX) [KPH or MPH), 90=Cx5A_1_252_PH_1_HEX_KPH_or_MPH (1~252 (PH)=1*(HEX) [KPH or MPH), 91=Cx5B_1_252_PH_1_HEX_KPH_or_MPH (1~252 (PH)=1*(HEX) [KPH or MPH), 92=Cx5C_1_252_PH_1_HEX_KPH_or_MPH (1~252 (PH)=1*(HEX) [KPH or MPH), 93=Cx5D_1_252_PH_1_HEX_KPH_or_MPH (1~252 (PH)=1*(HEX) [KPH or MPH), 94=Cx5E_1_252_PH_1_HEX_KPH_or_MPH (1~252 (PH)=1*(HEX) [KPH or MPH), 95=Cx5F_1_252_PH_1_HEX_KPH_or_MPH (1~252 (PH)=1*(HEX) [KPH or MPH), 96=Cx60_1_252_PH_1_HEX_KPH_or_MPH (1~252 (PH)=1*(HEX) [KPH or MPH), 97=Cx61_1_252_PH_1_HEX_KPH_or_MPH (1~252 (PH)=1*(HEX) [KPH or MPH), 98=Cx62_1_252_PH_1_HEX_KPH_or_MPH (1~252 (PH)=1*(HEX) [KPH or MPH), 99=Cx63_1_252_PH_1_HEX_KPH_or_MPH (1~252 (PH)=1*(HEX) [KPH or MPH), 100=Cx64_1_252_PH_1_HEX_KPH_or_MPH (1~252 (PH)=1*(HEX) [KPH or MPH), 101=Cx65_1_252_PH_1_HEX_KPH_or_MPH (1~252 (PH)=1*(HEX) [KPH or MPH), 102=Cx66_1_252_PH_1_HEX_KPH_or_MPH (1~252 (PH)=1*(HEX) [KPH or MPH), 103=Cx67_1_252_PH_1_HEX_KPH_or_MPH (1~252 (PH)=1*(HEX) [KPH or MPH), 104=Cx68_1_252_PH_1_HEX_KPH_or_MPH (1~252 (PH)=1*(HEX) [KPH or MPH), 105=Cx69_1_252_PH_1_HEX_KPH_or_MPH (1~252 (PH)=1*(HEX) [KPH or MPH), 106=Cx6A_1_252_PH_1_HEX_KPH_or_MPH (1~252 (PH)=1*(HEX) [KPH or MPH), 107=Cx6B_1_252_PH_1_HEX_KPH_or_MPH (1~252 (PH)=1*(HEX) [KPH or MPH), 108=Cx6C_1_252_PH_1_HEX_KPH_or_MPH (1~252 (PH)=1*(HEX) [KPH or MPH), 109=Cx6D_1_252_PH_1_HEX_KPH_or_MPH (1~252 (PH)=1*(HEX) [KPH or MPH), 110=Cx6E_1_252_PH_1_HEX_KPH_or_MPH (1~252 (PH)=1*(HEX) [KPH or MPH), 111=Cx6F_1_252_PH_1_HEX_KPH_or_MPH (1~252 (PH)=1*(HEX) [KPH or MPH), 112=Cx70_1_252_PH_1_HEX_KPH_or_MPH (1~252 (PH)=1*(HEX) [KPH or MPH), 113=Cx71_1_252_PH_1_HEX_KPH_or_MPH (1~252 (PH)=1*(HEX) [KPH or MPH), 114=Cx72_1_252_PH_1_HEX_KPH_or_MPH (1~252 (PH)=1*(HEX) [KPH or MPH), 115=Cx73_1_252_PH_1_HEX_KPH_or_MPH (1~252 (PH)=1*(HEX) [KPH or MPH), 116=Cx74_1_252_PH_1_HEX_KPH_or_MPH (1~252 (PH)=1*(HEX) [KPH or MPH), 117=Cx75_1_252_PH_1_HEX_KPH_or_MPH (1~252 (PH)=1*(HEX) [KPH or MPH), 118=Cx76_1_252_PH_1_HEX_KPH_or_MPH (1~252 (PH)=1*(HEX) [KPH or MPH), 119=Cx77_1_252_PH_1_HEX_KPH_or_MPH (1~252 (PH)=1*(HEX) [KPH or MPH), 120=Cx78_1_252_PH_1_HEX_KPH_or_MPH (1~252 (PH)=1*(HEX) [KPH or MPH), 121=Cx79_1_252_PH_1_HEX_KPH_or_MPH (1~252 (PH)=1*(HEX) [KPH or MPH), 122=Cx7A_1_252_PH_1_HEX_KPH_or_MPH (1~252 (PH)=1*(HEX) [KPH or MPH), 123=Cx7B_1_252_PH_1_HEX_KPH_or_MPH (1~252 (PH)=1*(HEX) [KPH or MPH), 124=Cx7C_1_252_PH_1_HEX_KPH_or_MPH (1~252 (PH)=1*(HEX) [KPH or MPH), 125=Cx7D_1_252_PH_1_HEX_KPH_or_MPH (1~252 (PH)=1*(HEX) [KPH or MPH), 126=Cx7E_1_252_PH_1_HEX_KPH_or_MPH (1~252 (PH)=1*(HEX) [KPH or MPH), 127=Cx7F_1_252_PH_1_HEX_KPH_or_MPH (1~252 (PH)=1*(HEX) [KPH or MPH), 128=Cx80_1_252_PH_1_HEX_KPH_or_MPH (1~252 (PH)=1*(HEX) [KPH or MPH), 129=Cx81_1_252_PH_1_HEX_KPH_or_MPH (1~252 (PH)=1*(HEX) [KPH or MPH), 130=Cx82_1_252_PH_1_HEX_KPH_or_MPH (1~252 (PH)=1*(HEX) [KPH or MPH), 131=Cx83_1_252_PH_1_HEX_KPH_or_MPH (1~252 (PH)=1*(HEX) [KPH or MPH), 132=Cx84_1_252_PH_1_HEX_KPH_or_MPH (1~252 (PH)=1*(HEX) [KPH or MPH), 133=Cx85_1_252_PH_1_HEX_KPH_or_MPH (1~252 (PH)=1*(HEX) [KPH or MPH), 134=Cx86_1_252_PH_1_HEX_KPH_or_MPH (1~252 (PH)=1*(HEX) [KPH or MPH), 135=Cx87_1_252_PH_1_HEX_KPH_or_MPH (1~252 (PH)=1*(HEX) [KPH or MPH), 136=Cx88_1_252_PH_1_HEX_KPH_or_MPH (1~252 (PH)=1*(HEX) [KPH or MPH), 137=Cx89_1_252_PH_1_HEX_KPH_or_MPH (1~252 (PH)=1*(HEX) [KPH or MPH), 138=Cx8A_1_252_PH_1_HEX_KPH_or_MPH (1~252 (PH)=1*(HEX) [KPH or MPH), 139=Cx8B_1_252_PH_1_HEX_KPH_or_MPH (1~252 (PH)=1*(HEX) [KPH or MPH), 140=Cx8C_1_252_PH_1_HEX_KPH_or_MPH (1~252 (PH)=1*(HEX) [KPH or MPH), 141=Cx8D_1_252_PH_1_HEX_KPH_or_MPH (1~252 (PH)=1*(HEX) [KPH or MPH), 142=Cx8E_1_252_PH_1_HEX_KPH_or_MPH (1~252 (PH)=1*(HEX) [KPH or MPH), 143=Cx8F_1_252_PH_1_HEX_KPH_or_MPH (1~252 (PH)=1*(HEX) [KPH or MPH), 144=Cx90_1_252_PH_1_HEX_KPH_or_MPH (1~252 (PH)=1*(HEX) [KPH or MPH), 145=Cx91_1_252_PH_1_HEX_KPH_or_MPH (1~252 (PH)=1*(HEX) [KPH or MPH), 146=Cx92_1_252_PH_1_HEX_KPH_or_MPH (1~252 (PH)=1*(HEX) [KPH or MPH), 147=Cx93_1_252_PH_1_HEX_KPH_or_MPH (1~252 (PH)=1*(HEX) [KPH or MPH), 148=Cx94_1_252_PH_1_HEX_KPH_or_MPH (1~252 (PH)=1*(HEX) [KPH or MPH), 149=Cx95_1_252_PH_1_HEX_KPH_or_MPH (1~252 (PH)=1*(HEX) [KPH or MPH), 150=Cx96_1_252_PH_1_HEX_KPH_or_MPH (1~252 (PH)=1*(HEX) [KPH or MPH), 151=Cx97_1_252_PH_1_HEX_KPH_or_MPH (1~252 (PH)=1*(HEX) [KPH or MPH), 152=Cx98_1_252_PH_1_HEX_KPH_or_MPH (1~252 (PH)=1*(HEX) [KPH or MPH), 153=Cx99_1_252_PH_1_HEX_KPH_or_MPH (1~252 (PH)=1*(HEX) [KPH or MPH), 154=Cx9A_1_252_PH_1_HEX_KPH_or_MPH (1~252 (PH)=1*(HEX) [KPH or MPH), 155=Cx9B_1_252_PH_1_HEX_KPH_or_MPH (1~252 (PH)=1*(HEX) [KPH or MPH), 156=Cx9C_1_252_PH_1_HEX_KPH_or_MPH (1~252 (PH)=1*(HEX) [KPH or MPH), 157=Cx9D_1_252_PH_1_HEX_KPH_or_MPH (1~252 (PH)=1*(HEX) [KPH or MPH), 158=Cx9E_1_252_PH_1_HEX_KPH_or_MPH (1~252 (PH)=1*(HEX) [KPH or MPH), 159=Cx9F_1_252_PH_1_HEX_KPH_or_MPH (1~252 (PH)=1*(HEX) [KPH or MPH), 160=CxA0_1_252_PH_1_HEX_KPH_or_MPH (1~252 (PH)=1*(HEX) [KPH or MPH), 161=CxA1_1_252_PH_1_HEX_KPH_or_MPH (1~252 (PH)=1*(HEX) [KPH or MPH), 162=CxA2_1_252_PH_1_HEX_KPH_or_MPH (1~252 (PH)=1*(HEX) [KPH or MPH), 163=CxA3_1_252_PH_1_HEX_KPH_or_MPH (1~252 (PH)=1*(HEX) [KPH or MPH), 164=CxA4_1_252_PH_1_HEX_KPH_or_MPH (1~252 (PH)=1*(HEX) [KPH or MPH), 165=CxA5_1_252_PH_1_HEX_KPH_or_MPH (1~252 (PH)=1*(HEX) [KPH or MPH), 166=CxA6_1_252_PH_1_HEX_KPH_or_MPH (1~252 (PH)=1*(HEX) [KPH or MPH), 167=CxA7_1_252_PH_1_HEX_KPH_or_MPH (1~252 (PH)=1*(HEX) [KPH or MPH), 168=CxA8_1_252_PH_1_HEX_KPH_or_MPH (1~252 (PH)=1*(HEX) [KPH or MPH), 169=CxA9_1_252_PH_1_HEX_KPH_or_MPH (1~252 (PH)=1*(HEX) [KPH or MPH), 170=CxAA_1_252_PH_1_HEX_KPH_or_MPH (1~252 (PH)=1*(HEX) [KPH or MPH), 171=CxAB_1_252_PH_1_HEX_KPH_or_MPH (1~252 (PH)=1*(HEX) [KPH or MPH), 172=CxAC_1_252_PH_1_HEX_KPH_or_MPH (1~252 (PH)=1*(HEX) [KPH or MPH), 173=CxAD_1_252_PH_1_HEX_KPH_or_MPH (1~252 (PH)=1*(HEX) [KPH or MPH), 174=CxAE_1_252_PH_1_HEX_KPH_or_MPH (1~252 (PH)=1*(HEX) [KPH or MPH), 175=CxAF_1_252_PH_1_HEX_KPH_or_MPH (1~252 (PH)=1*(HEX) [KPH or MPH), 176=CxB0_1_252_PH_1_HEX_KPH_or_MPH (1~252 (PH)=1*(HEX) [KPH or MPH), 177=CxB1_1_252_PH_1_HEX_KPH_or_MPH (1~252 (PH)=1*(HEX) [KPH or MPH), 178=CxB2_1_252_PH_1_HEX_KPH_or_MPH (1~252 (PH)=1*(HEX) [KPH or MPH), 179=CxB3_1_252_PH_1_HEX_KPH_or_MPH (1~252 (PH)=1*(HEX) [KPH or MPH), 180=CxB4_1_252_PH_1_HEX_KPH_or_MPH (1~252 (PH)=1*(HEX) [KPH or MPH), 181=CxB5_1_252_PH_1_HEX_KPH_or_MPH (1~252 (PH)=1*(HEX) [KPH or MPH), 182=CxB6_1_252_PH_1_HEX_KPH_or_MPH (1~252 (PH)=1*(HEX) [KPH or MPH), 183=CxB7_1_252_PH_1_HEX_KPH_or_MPH (1~252 (PH)=1*(HEX) [KPH or MPH), 184=CxB8_1_252_PH_1_HEX_KPH_or_MPH (1~252 (PH)=1*(HEX) [KPH or MPH), 185=CxB9_1_252_PH_1_HEX_KPH_or_MPH (1~252 (PH)=1*(HEX) [KPH or MPH), 186=CxBA_1_252_PH_1_HEX_KPH_or_MPH (1~252 (PH)=1*(HEX) [KPH or MPH), 187=CxBB_1_252_PH_1_HEX_KPH_or_MPH (1~252 (PH)=1*(HEX) [KPH or MPH), 188=CxBC_1_252_PH_1_HEX_KPH_or_MPH (1~252 (PH)=1*(HEX) [KPH or MPH), 189=CxBD_1_252_PH_1_HEX_KPH_or_MPH (1~252 (PH)=1*(HEX) [KPH or MPH), 190=CxBE_1_252_PH_1_HEX_KPH_or_MPH (1~252 (PH)=1*(HEX) [KPH or MPH), 191=CxBF_1_252_PH_1_HEX_KPH_or_MPH (1~252 (PH)=1*(HEX) [KPH or MPH), 192=CxC0_1_252_PH_1_HEX_KPH_or_MPH (1~252 (PH)=1*(HEX) [KPH or MPH), 193=CxC1_1_252_PH_1_HEX_KPH_or_MPH (1~252 (PH)=1*(HEX) [KPH or MPH), 194=CxC2_1_252_PH_1_HEX_KPH_or_MPH (1~252 (PH)=1*(HEX) [KPH or MPH), 195=CxC3_1_252_PH_1_HEX_KPH_or_MPH (1~252 (PH)=1*(HEX) [KPH or MPH), 196=CxC4_1_252_PH_1_HEX_KPH_or_MPH (1~252 (PH)=1*(HEX) [KPH or MPH), 197=CxC5_1_252_PH_1_HEX_KPH_or_MPH (1~252 (PH)=1*(HEX) [KPH or MPH), 198=CxC6_1_252_PH_1_HEX_KPH_or_MPH (1~252 (PH)=1*(HEX) [KPH or MPH), 199=CxC7_1_252_PH_1_HEX_KPH_or_MPH (1~252 (PH)=1*(HEX) [KPH or MPH), 200=CxC8_1_252_PH_1_HEX_KPH_or_MPH (1~252 (PH)=1*(HEX) [KPH or MPH), 201=CxC9_1_252_PH_1_HEX_KPH_or_MPH (1~252 (PH)=1*(HEX) [KPH or MPH), 202=CxCA_1_252_PH_1_HEX_KPH_or_MPH (1~252 (PH)=1*(HEX) [KPH or MPH), 203=CxCB_1_252_PH_1_HEX_KPH_or_MPH (1~252 (PH)=1*(HEX) [KPH or MPH), 204=CxCC_1_252_PH_1_HEX_KPH_or_MPH (1~252 (PH)=1*(HEX) [KPH or MPH), 205=CxCD_1_252_PH_1_HEX_KPH_or_MPH (1~252 (PH)=1*(HEX) [KPH or MPH), 206=CxCE_1_252_PH_1_HEX_KPH_or_MPH (1~252 (PH)=1*(HEX) [KPH or MPH), 207=CxCF_1_252_PH_1_HEX_KPH_or_MPH (1~252 (PH)=1*(HEX) [KPH or MPH), 208=CxD0_1_252_PH_1_HEX_KPH_or_MPH (1~252 (PH)=1*(HEX) [KPH or MPH), 209=CxD1_1_252_PH_1_HEX_KPH_or_MPH (1~252 (PH)=1*(HEX) [KPH or MPH), 210=CxD2_1_252_PH_1_HEX_KPH_or_MPH (1~252 (PH)=1*(HEX) [KPH or MPH), 211=CxD3_1_252_PH_1_HEX_KPH_or_MPH (1~252 (PH)=1*(HEX) [KPH or MPH), 212=CxD4_1_252_PH_1_HEX_KPH_or_MPH (1~252 (PH)=1*(HEX) [KPH or MPH), 213=CxD5_1_252_PH_1_HEX_KPH_or_MPH (1~252 (PH)=1*(HEX) [KPH or MPH), 214=CxD6_1_252_PH_1_HEX_KPH_or_MPH (1~252 (PH)=1*(HEX) [KPH or MPH), 215=CxD7_1_252_PH_1_HEX_KPH_or_MPH (1~252 (PH)=1*(HEX) [KPH or MPH), 216=CxD8_1_252_PH_1_HEX_KPH_or_MPH (1~252 (PH)=1*(HEX) [KPH or MPH), 217=CxD9_1_252_PH_1_HEX_KPH_or_MPH (1~252 (PH)=1*(HEX) [KPH or MPH), 218=CxDA_1_252_PH_1_HEX_KPH_or_MPH (1~252 (PH)=1*(HEX) [KPH or MPH), 219=CxDB_1_252_PH_1_HEX_KPH_or_MPH (1~252 (PH)=1*(HEX) [KPH or MPH), 220=CxDC_1_252_PH_1_HEX_KPH_or_MPH (1~252 (PH)=1*(HEX) [KPH or MPH), 221=CxDD_1_252_PH_1_HEX_KPH_or_MPH (1~252 (PH)=1*(HEX) [KPH or MPH), 222=CxDE_1_252_PH_1_HEX_KPH_or_MPH (1~252 (PH)=1*(HEX) [KPH or MPH), 223=CxDF_1_252_PH_1_HEX_KPH_or_MPH (1~252 (PH)=1*(HEX) [KPH or MPH), 224=CxE0_1_252_PH_1_HEX_KPH_or_MPH (1~252 (PH)=1*(HEX) [KPH or MPH), 225=CxE1_1_252_PH_1_HEX_KPH_or_MPH (1~252 (PH)=1*(HEX) [KPH or MPH), 226=CxE2_1_252_PH_1_HEX_KPH_or_MPH (1~252 (PH)=1*(HEX) [KPH or MPH), 227=CxE3_1_252_PH_1_HEX_KPH_or_MPH (1~252 (PH)=1*(HEX) [KPH or MPH), 228=CxE4_1_252_PH_1_HEX_KPH_or_MPH (1~252 (PH)=1*(HEX) [KPH or MPH), 229=CxE5_1_252_PH_1_HEX_KPH_or_MPH (1~252 (PH)=1*(HEX) [KPH or MPH), 230=CxE6_1_252_PH_1_HEX_KPH_or_MPH (1~252 (PH)=1*(HEX) [KPH or MPH), 231=CxE7_1_252_PH_1_HEX_KPH_or_MPH (1~252 (PH)=1*(HEX) [KPH or MPH), 232=CxE8_1_252_PH_1_HEX_KPH_or_MPH (1~252 (PH)=1*(HEX) [KPH or MPH), 233=CxE9_1_252_PH_1_HEX_KPH_or_MPH (1~252 (PH)=1*(HEX) [KPH or MPH), 234=CxEA_1_252_PH_1_HEX_KPH_or_MPH (1~252 (PH)=1*(HEX) [KPH or MPH), 235=CxEB_1_252_PH_1_HEX_KPH_or_MPH (1~252 (PH)=1*(HEX) [KPH or MPH), 236=CxEC_1_252_PH_1_HEX_KPH_or_MPH (1~252 (PH)=1*(HEX) [KPH or MPH), 237=CxED_1_252_PH_1_HEX_KPH_or_MPH (1~252 (PH)=1*(HEX) [KPH or MPH), 238=CxEE_1_252_PH_1_HEX_KPH_or_MPH (1~252 (PH)=1*(HEX) [KPH or MPH), 239=CxEF_1_252_PH_1_HEX_KPH_or_MPH (1~252 (PH)=1*(HEX) [KPH or MPH), 240=CxF0_1_252_PH_1_HEX_KPH_or_MPH (1~252 (PH)=1*(HEX) [KPH or MPH), 241=CxF1_1_252_PH_1_HEX_KPH_or_MPH (1~252 (PH)=1*(HEX) [KPH or MPH), 242=CxF2_1_252_PH_1_HEX_KPH_or_MPH (1~252 (PH)=1*(HEX) [KPH or MPH), 243=CxF3_1_252_PH_1_HEX_KPH_or_MPH (1~252 (PH)=1*(HEX) [KPH or MPH), 244=CxF4_1_252_PH_1_HEX_KPH_or_MPH (1~252 (PH)=1*(HEX) [KPH or MPH), 245=CxF5_1_252_PH_1_HEX_KPH_or_MPH (1~252 (PH)=1*(HEX) [KPH or MPH), 246=CxF6_1_252_PH_1_HEX_KPH_or_MPH (1~252 (PH)=1*(HEX) [KPH or MPH), 247=CxF7_1_252_PH_1_HEX_KPH_or_MPH (1~252 (PH)=1*(HEX) [KPH or MPH), 248=CxF8_1_252_PH_1_HEX_KPH_or_MPH (1~252 (PH)=1*(HEX) [KPH or MPH), 249=CxF9_1_252_PH_1_HEX_KPH_or_MPH (1~252 (PH)=1*(HEX) [KPH or MPH), 250=CxFA_1_252_PH_1_HEX_KPH_or_MPH (1~252 (PH)=1*(HEX) [KPH or MPH), 251=CxFB_1_252_PH_1_HEX_KPH_or_MPH (1~252 (PH)=1*(HEX) [KPH or MPH), 252=CxFC_1_252_PH_1_HEX_KPH_or_MPH (1~252 (PH)=1*(HEX) [KPH or MPH), 253=CxFD_ISLW_SDN2_LHD_Conditional_No_Passing_ZONE (LHD Conditional No Passing ZONE), 254=CxFE_ISLW_SDN2_RHD_Conditional_No_Passing_ZONE (RHD Conditional No Passing ZONE), 255=CxFF_ISLW_SDN2_Invalid}
    CF_ISLW_Spd_Dis_NAVI_Main:
      category=VALUE
      base-type=DataType/uint8
      compu {0=Cx00_ISLW_SDN_No_Recognition_Default_ (No Recognition (Default)), 1=Cx01_1_252 (1~252), 2=Cx02_1_252 (1~252), 3=Cx03_1_252 (1~252), 4=Cx04_1_252 (1~252), 5=Cx05_1_252 (1~252), 6=Cx06_1_252 (1~252), 7=Cx07_1_252 (1~252), 8=Cx08_1_252 (1~252), 9=Cx09_1_252 (1~252), 10=Cx0A_1_252 (1~252), 11=Cx0B_1_252 (1~252), 12=Cx0C_1_252 (1~252), 13=Cx0D_1_252 (1~252), 14=Cx0E_1_252 (1~252), 15=Cx0F_1_252 (1~252), 16=Cx10_1_252 (1~252), 17=Cx11_1_252 (1~252), 18=Cx12_1_252 (1~252), 19=Cx13_1_252 (1~252), 20=Cx14_1_252 (1~252), 21=Cx15_1_252 (1~252), 22=Cx16_1_252 (1~252), 23=Cx17_1_252 (1~252), 24=Cx18_1_252 (1~252), 25=Cx19_1_252 (1~252), 26=Cx1A_1_252 (1~252), 27=Cx1B_1_252 (1~252), 28=Cx1C_1_252 (1~252), 29=Cx1D_1_252 (1~252), 30=Cx1E_1_252 (1~252), 31=Cx1F_1_252 (1~252), 32=Cx20_1_252 (1~252), 33=Cx21_1_252 (1~252), 34=Cx22_1_252 (1~252), 35=Cx23_1_252 (1~252), 36=Cx24_1_252 (1~252), 37=Cx25_1_252 (1~252), 38=Cx26_1_252 (1~252), 39=Cx27_1_252 (1~252), 40=Cx28_1_252 (1~252), 41=Cx29_1_252 (1~252), 42=Cx2A_1_252 (1~252), 43=Cx2B_1_252 (1~252), 44=Cx2C_1_252 (1~252), 45=Cx2D_1_252 (1~252), 46=Cx2E_1_252 (1~252), 47=Cx2F_1_252 (1~252), 48=Cx30_1_252 (1~252), 49=Cx31_1_252 (1~252), 50=Cx32_1_252 (1~252), 51=Cx33_1_252 (1~252), 52=Cx34_1_252 (1~252), 53=Cx35_1_252 (1~252), 54=Cx36_1_252 (1~252), 55=Cx37_1_252 (1~252), 56=Cx38_1_252 (1~252), 57=Cx39_1_252 (1~252), 58=Cx3A_1_252 (1~252), 59=Cx3B_1_252 (1~252), 60=Cx3C_1_252 (1~252), 61=Cx3D_1_252 (1~252), 62=Cx3E_1_252 (1~252), 63=Cx3F_1_252 (1~252), 64=Cx40_1_252 (1~252), 65=Cx41_1_252 (1~252), 66=Cx42_1_252 (1~252), 67=Cx43_1_252 (1~252), 68=Cx44_1_252 (1~252), 69=Cx45_1_252 (1~252), 70=Cx46_1_252 (1~252), 71=Cx47_1_252 (1~252), 72=Cx48_1_252 (1~252), 73=Cx49_1_252 (1~252), 74=Cx4A_1_252 (1~252), 75=Cx4B_1_252 (1~252), 76=Cx4C_1_252 (1~252), 77=Cx4D_1_252 (1~252), 78=Cx4E_1_252 (1~252), 79=Cx4F_1_252 (1~252), 80=Cx50_1_252 (1~252), 81=Cx51_1_252 (1~252), 82=Cx52_1_252 (1~252), 83=Cx53_1_252 (1~252), 84=Cx54_1_252 (1~252), 85=Cx55_1_252 (1~252), 86=Cx56_1_252 (1~252), 87=Cx57_1_252 (1~252), 88=Cx58_1_252 (1~252), 89=Cx59_1_252 (1~252), 90=Cx5A_1_252 (1~252), 91=Cx5B_1_252 (1~252), 92=Cx5C_1_252 (1~252), 93=Cx5D_1_252 (1~252), 94=Cx5E_1_252 (1~252), 95=Cx5F_1_252 (1~252), 96=Cx60_1_252 (1~252), 97=Cx61_1_252 (1~252), 98=Cx62_1_252 (1~252), 99=Cx63_1_252 (1~252), 100=Cx64_1_252 (1~252), 101=Cx65_1_252 (1~252), 102=Cx66_1_252 (1~252), 103=Cx67_1_252 (1~252), 104=Cx68_1_252 (1~252), 105=Cx69_1_252 (1~252), 106=Cx6A_1_252 (1~252), 107=Cx6B_1_252 (1~252), 108=Cx6C_1_252 (1~252), 109=Cx6D_1_252 (1~252), 110=Cx6E_1_252 (1~252), 111=Cx6F_1_252 (1~252), 112=Cx70_1_252 (1~252), 113=Cx71_1_252 (1~252), 114=Cx72_1_252 (1~252), 115=Cx73_1_252 (1~252), 116=Cx74_1_252 (1~252), 117=Cx75_1_252 (1~252), 118=Cx76_1_252 (1~252), 119=Cx77_1_252 (1~252), 120=Cx78_1_252 (1~252), 121=Cx79_1_252 (1~252), 122=Cx7A_1_252 (1~252), 123=Cx7B_1_252 (1~252), 124=Cx7C_1_252 (1~252), 125=Cx7D_1_252 (1~252), 126=Cx7E_1_252 (1~252), 127=Cx7F_1_252 (1~252), 128=Cx80_1_252 (1~252), 129=Cx81_1_252 (1~252), 130=Cx82_1_252 (1~252), 131=Cx83_1_252 (1~252), 132=Cx84_1_252 (1~252), 133=Cx85_1_252 (1~252), 134=Cx86_1_252 (1~252), 135=Cx87_1_252 (1~252), 136=Cx88_1_252 (1~252), 137=Cx89_1_252 (1~252), 138=Cx8A_1_252 (1~252), 139=Cx8B_1_252 (1~252), 140=Cx8C_1_252 (1~252), 141=Cx8D_1_252 (1~252), 142=Cx8E_1_252 (1~252), 143=Cx8F_1_252 (1~252), 144=Cx90_1_252 (1~252), 145=Cx91_1_252 (1~252), 146=Cx92_1_252 (1~252), 147=Cx93_1_252 (1~252), 148=Cx94_1_252 (1~252), 149=Cx95_1_252 (1~252), 150=Cx96_1_252 (1~252), 151=Cx97_1_252 (1~252), 152=Cx98_1_252 (1~252), 153=Cx99_1_252 (1~252), 154=Cx9A_1_252 (1~252), 155=Cx9B_1_252 (1~252), 156=Cx9C_1_252 (1~252), 157=Cx9D_1_252 (1~252), 158=Cx9E_1_252 (1~252), 159=Cx9F_1_252 (1~252), 160=CxA0_1_252 (1~252), 161=CxA1_1_252 (1~252), 162=CxA2_1_252 (1~252), 163=CxA3_1_252 (1~252), 164=CxA4_1_252 (1~252), 165=CxA5_1_252 (1~252), 166=CxA6_1_252 (1~252), 167=CxA7_1_252 (1~252), 168=CxA8_1_252 (1~252), 169=CxA9_1_252 (1~252), 170=CxAA_1_252 (1~252), 171=CxAB_1_252 (1~252), 172=CxAC_1_252 (1~252), 173=CxAD_1_252 (1~252), 174=CxAE_1_252 (1~252), 175=CxAF_1_252 (1~252), 176=CxB0_1_252 (1~252), 177=CxB1_1_252 (1~252), 178=CxB2_1_252 (1~252), 179=CxB3_1_252 (1~252), 180=CxB4_1_252 (1~252), 181=CxB5_1_252 (1~252), 182=CxB6_1_252 (1~252), 183=CxB7_1_252 (1~252), 184=CxB8_1_252 (1~252), 185=CxB9_1_252 (1~252), 186=CxBA_1_252 (1~252), 187=CxBB_1_252 (1~252), 188=CxBC_1_252 (1~252), 189=CxBD_1_252 (1~252), 190=CxBE_1_252 (1~252), 191=CxBF_1_252 (1~252), 192=CxC0_1_252 (1~252), 193=CxC1_1_252 (1~252), 194=CxC2_1_252 (1~252), 195=CxC3_1_252 (1~252), 196=CxC4_1_252 (1~252), 197=CxC5_1_252 (1~252), 198=CxC6_1_252 (1~252), 199=CxC7_1_252 (1~252), 200=CxC8_1_252 (1~252), 201=CxC9_1_252 (1~252), 202=CxCA_1_252 (1~252), 203=CxCB_1_252 (1~252), 204=CxCC_1_252 (1~252), 205=CxCD_1_252 (1~252), 206=CxCE_1_252 (1~252), 207=CxCF_1_252 (1~252), 208=CxD0_1_252 (1~252), 209=CxD1_1_252 (1~252), 210=CxD2_1_252 (1~252), 211=CxD3_1_252 (1~252), 212=CxD4_1_252 (1~252), 213=CxD5_1_252 (1~252), 214=CxD6_1_252 (1~252), 215=CxD7_1_252 (1~252), 216=CxD8_1_252 (1~252), 217=CxD9_1_252 (1~252), 218=CxDA_1_252 (1~252), 219=CxDB_1_252 (1~252), 220=CxDC_1_252 (1~252), 221=CxDD_1_252 (1~252), 222=CxDE_1_252 (1~252), 223=CxDF_1_252 (1~252), 224=CxE0_1_252 (1~252), 225=CxE1_1_252 (1~252), 226=CxE2_1_252 (1~252), 227=CxE3_1_252 (1~252), 228=CxE4_1_252 (1~252), 229=CxE5_1_252 (1~252), 230=CxE6_1_252 (1~252), 231=CxE7_1_252 (1~252), 232=CxE8_1_252 (1~252), 233=CxE9_1_252 (1~252), 234=CxEA_1_252 (1~252), 235=CxEB_1_252 (1~252), 236=CxEC_1_252 (1~252), 237=CxED_1_252 (1~252), 238=CxEE_1_252 (1~252), 239=CxEF_1_252 (1~252), 240=CxF0_1_252 (1~252), 241=CxF1_1_252 (1~252), 242=CxF2_1_252 (1~252), 243=CxF3_1_252 (1~252), 244=CxF4_1_252 (1~252), 245=CxF5_1_252 (1~252), 246=CxF6_1_252 (1~252), 247=CxF7_1_252 (1~252), 248=CxF8_1_252 (1~252), 249=CxF9_1_252 (1~252), 250=CxFA_1_252 (1~252), 251=CxFB_1_252 (1~252), 252=CxFC_1_252 (1~252), 253=CxFD_ISLW_SDN_Unlimited_Speed (Unlimited Speed), 254=CxFE_ISLW_SDN_Reserved, 255=CxFF_ISLW_SDN_Invalid}
    CF_ISLW_Status: category=VALUE, base-type=DataType/uint8, compu {0=Cx0_Status_ISLW_Valid (ISLW Valid (default)), 1=Cx1_Status_ISLW_Invalid_Failure (ISLW Invalid/Failure), 2=Cx2_Status_ISLW_Temporary_Unavailable (ISLW Temporary Unavailable)}
    CF_LeadVehDptAlert_Display: category=VALUE, base-type=DataType/uint8, compu {0=Cx0_LVDA_D_Default, 1=Cx1_LVDA_D_Display_Lead_Vehicle_Departure_Alert_ (Display “Lead Vehicle Departure Alert”), 2=Cx2_LVDA_D_Reserved, 3=Cx3_LVDA_D_Invalid}
    CF_LeadVehDptAlert_USM: category=VALUE, base-type=DataType/uint8, compu {0=Cx0_LVDA_U_No_Option_default_ (No Option (default)), 1=Cx1_LVDA_U_Off, 2=Cx2_LVDA_U_On, 3=Cx3_LVDA_U_Invalid}
    CF_LKA_ActToi: category=VALUE, base-type=DataType/boolean, compu {0=Cx0_LKA_De_activate_TOI (De-activate TOI), 1=Cx1_LKA_Activate_TOI (Activate TOI)}
    CF_LKA_CRC: category=VALUE, base-type=DataType/uint8
    CF_LKA_FusionState: category=VALUE, base-type=DataType/uint8, compu {0=Cx0_LKA_FS_Normal, 1=Cx1_LKA_FS_Fusion_Disabled (Fusion Disabled), 2=Cx2_LKA_FS_SCC_Communication_Error (SCC Communication Error), 3=Cx3_LKA_FS_Camera_Blockage (Camera Blockage)}
    CF_LKA_HandsOff_Snd: category=VALUE, base-type=DataType/boolean, compu {0=Cx0_HandsoffS_Off, 1=Cx1_HandoffS_Hands_Off_Sound_Warning (Hands-off Sound Warning)}
    CF_LKA_LaneRecogState: category=VALUE, base-type=DataType/uint8, compu {0=Cx0_LaneRS_No_Recognition (Not Recognition), 1=Cx1_LaneRS_Left_Lane_Recognition (Left Lane Recognition), 2=Cx2_LaneRS_Right_Lane_Recognition (Right Lane Recognition), 3=Cx3_LaneRS_Full_Lane_Recognition (Full Lane Recognition)}
    CF_LKA_LHWarning: category=VALUE, base-type=DataType/uint8, compu {0=Cx0_LHW_No_Warning (No Warning), 1=Cx1_LHW_HAPTIC_Warning_and_Acoustic_Warning_and_Display (HAPTIC Warning and Acoustic Warning and Display), 2=Cx2_LHW_Acoustic_Warning_and_Display (Acoustic Warning and Display)}
    CF_LKA_MsgCount: category=VALUE, base-type=DataType/uint8
    CF_LKA_Opt_USM: category=VALUE, base-type=DataType/uint8, compu {0=Cx0_OptU_None_LKA_LDW_Option (None LKA/LDW Option), 1=Cx1_OptU_LDW, 2=Cx2_OptU_LKA, 3=Cx3_OptU_Active_LKA (ACTIVE LKA), 4=Cx4_OptU_LDW_Only (LDW Only (None LKA)), 5=Cx5_OptU_LDW_only_OFF (LDW only OFF (None LKA)), 6=Cx6_OptU_LDW_LKA_OFF (LDW/LKA OFF), 7=Cx7_OptU_Invalid}
    CF_LKA_RHWarning: category=VALUE, base-type=DataType/uint8, compu {0=Cx0_RHW_No_Warning (No Warning), 1=Cx1_RHW_HAPTIC_Warning_and_Acoustic_Warning_and_Display (HAPTIC Warning and Acoustic Warning and Display), 2=Cx2_RHW_Acoustic_Warning_and_Display (Acoustic Warning and Display)}
    CF_LKA_SymbolState: category=VALUE, base-type=DataType/uint8, compu {0=Cx0_SymbolS_Off, 1=Cx1_SymbolS_White_On (White On), 2=Cx2_SymbolS_Green_On (Green On), 3=Cx3_SymbolS_Green_Blink (Green Blink), 4=Cx4_SymbolS_Orange_On (Orange On), 5=Cx5_SymbolS_Orange_Blink (Orange Blink), 6=Cx6_SymbolS_Orange_ON_Regulation_ (Orange ON (Regulation)), 7=Cx7_SymbolS_White_Blink (White Blink)}
    CF_LKA_SysState:
      category=VALUE
      base-type=DataType/uint8
      compu {0=Cx0_LKA_SS_System_OFF (System OFF), 1=Cx1_LKA_SS_Low_Vehicle_Speed (Low Vehicle Speed), 2=Cx2_LKA_SS_System_Unavailable (System Unavailable), 3=Cx3_LKA_SS_MDPS_Control_Full_Lane_Recognized (MDPS Control_Full Lane Recognized), 4=Cx4_LKA_SS_Full_Lane_Recognized (Full Lane Recognized), 5=Cx5_LKA_SS_Left_Line_Recognized (Left Line Recognized), 6=Cx6_LKA_SS_Right_Line_Recognized (Right Line Recognized), 7=Cx7_LKA_SS_MDPS_Control_Left_Line_Recognized (MDPS Control_Left Line Recognized), 8=Cx8_LKA_SS_MDPS_Control_Right_Line_Recognized (MDPS Control_Right Line Recognized), 14=CxE_LKA_SS_System_Not_Calibrated (System Not Calibrated), 15=CxF_LKA_SS_System_Failure (System Failure)}
    CF_LKA_SysWarning: category=VALUE, base-type=DataType/uint8
    CF_LKA_ToiFlt: category=VALUE, base-type=DataType/boolean, compu {0=Cx0_ToiF_No_Fault (No Fault), 1=Cx1_ToiF_Fault_Present (Fault Present)}
    CF_LKA_USM_Mode: category=VALUE, base-type=DataType/uint8, compu {0=Cx0_USMM_NONE, 1=Cx1_USMM_LKA_1_Mode (LKA 1 Mode), 2=Cx2_USMM_LKA_2_Mode (LKA 2 Mode), 3=Cx3_USMM_LDW}
    CF_VSM_BeltCmd: category=VALUE, base-type=DataType/uint8, compu {0=Cx0_BeltC_Release_no_alert, 1=Cx1_BeltC_Precrash_full_retraction, 2=Cx2_BeltC_Haptic_Warning}
    CF_VSM_DecCmdAct: category=VALUE, base-type=DataType/boolean, compu {0=Cx0_VSMDCA_No_request (No request), 1=Cx1_VSMDCA_valid (Request valid)}
    CF_VSM_HBACmd: category=VALUE, base-type=DataType/uint8, compu {0=Cx0_Standard_threshold (Standard threshold), 1=Cx1_Lowered_threshold_1 (Lowered threshold 1), 2=Cx2_Lowered_threshold_2 (Lowered threshold 2), 3=Cx3_Lowered_threshold_3 (Lowered threshold 3)}
    CF_VSM_Prefill: category=VALUE, base-type=DataType/boolean, compu {0=Cx0_Prefill_No_Prefill, 1=Cx1_Prefill_Prefill}
    CF_VSM_Warn: category=VALUE, base-type=DataType/uint8, compu {0=Cx0_Warn_No_warning, 1=Cx1_Warn_Warning_Level_1, 2=Cx2_Warn_Warning_Level_2, 3=Cx3_Warn_Warning_Level_3}
    CR_FCA_Alive: category=VALUE, base-type=DataType/uint8
    CR_LKA_StrToqReq: category=VALUE, base-type=DataType/uint16
    CR_VSM_DecCmd: category=VALUE, base-type=DataType/uint8
    DAW_LVDA_OptUsmSta: category=VALUE, base-type=DataType/uint8, compu {0=Cx0_DAW_LVDA_OptUS_No_Option_default_ (No Option (default)), 1=Cx1_DAW_LVDA_OptUS_Off, 2=Cx2_DAW_LVDA_OptUS_On, 3=Cx3_DAW_LVDA_OptUS_Error_Indicator (Error Indicator)}
    DAW_LVDA_PUDis: category=VALUE, base-type=DataType/uint8, compu {0=Cx0_DAW_LVDA_PUD_Default, 1=Cx1_DAW_LVDA_PUD_Display_Leading_vehicle_departure_alert_ (Display “Leading vehicle departure alert”), 2=Cx2_DAW_LVDA_PUD_Reserved, 3=Cx3_DAW_LVDA_PUD_Error_indicator (Error indicator)}
    DAW_OptUsmSta: category=VALUE, base-type=DataType/uint8, compu {0=Cx0_DAW_OptUS_None_DAW_Option_Default_ (None DAW Option (Default)), 1=Cx1_DAW_OptUS_System_Off (System Off), 2=Cx2_DAW_OptUS_System_On (System On), 3=Cx3_DAW_OptUS_Reserved, 4=Cx4_DAW_OptUS_Reserved, 5=Cx5_DAW_OptUS_Reserved, 6=Cx6_DAW_OptUS_Reserved, 7=Cx7_DAW_OptUS_Invalid_Gray_ (Invalid (Gray))}
    DAW_SnstvtyModRetVal: category=VALUE, base-type=DataType/uint8, compu {0=Cx0_DAW_SMRV_Default, 1=Cx1_DAW_SMRV_Late, 2=Cx2_DAW_SMRV_Normal, 3=Cx3_DAW_SMRV_Reserved, 4=Cx4_DAW_SMRV_Reserved, 5=Cx5_DAW_SMRV_Reserved, 6=Cx6_DAW_SMRV_Reserved, 7=Cx7_DAW_SMRV_Invalid}
    DAW_SysSta:
      category=VALUE
      base-type=DataType/uint8
      compu {0=Cx0_DAW_SS_System_Off (System Off), 1=Cx1_DAW_SS_Attention_Level_1 (Attention Level 1), 2=Cx2_DAW_SS_Attention_Level_2 (Attention Level 2), 3=Cx3_DAW_SS_Attention_Level_3 (Attention Level 3), 4=Cx4_DAW_SS_Attention_Level_4 (Attention Level 4), 5=Cx5_DAW_SS_Attention_Level_5 (Attention Level 5), 6=Cx6_DAW_SS_Reserved, 7=Cx7_DAW_SS_Reserved, 8=Cx8_DAW_SS_Reserved, 9=Cx9_DAW_SS_Reserved, 10=CxA_DAW_SS_Reserved, 11=CxB_DAW_SS_Reserved, 12=CxC_DAW_SS_Reserved, 13=CxD_DAW_SS_Reserved, 14=CxE_DAW_SS_System_Standby (System Standby), 15=CxF_DAW_SS_System_Fail (System Fail)}
    DAW_TimeRstReq: category=VALUE, base-type=DataType/uint8, compu {0=Cx0_DAW_TRR_No_signal (No signal), 1=Cx1_DAW_TRR_Time_reset (Time reset), 2=Cx2_DAW_TRR_Reserved, 3=Cx3_DAW_TRR_Error_indicator (Error indicator)}
    DAW_WrnMsgSta: category=VALUE, base-type=DataType/uint8, compu {0=Cx0_DAW_WMS_No_Warning (No Warning), 1=Cx1_DAW_WMS_Rest_Recommend_Warning (Rest Recommend Warning), 2=Cx2_DAW_WMS_Hands_Off_TMS_call_request (Hands-Off TMS call request), 3=Cx3_DAW_WMS_Reserved, 4=Cx4_DAW_WMS_Reserved, 5=Cx5_DAW_WMS_Reserved, 6=Cx6_DAW_WMS_Reserved, 7=Cx7_DAW_WMS_Error_indicator (Error indicator)}
    FCA_CmdAct: category=VALUE, base-type=DataType/boolean, compu {0=Cx0_CmdA_No_Request, 1=Cx1_CmdA_Request_valid}
    FCA_CRC: category=VALUE, base-type=DataType/uint8
    FCA_DclReqVal: category=VALUE, base-type=DataType/uint8
    FCA_DrvSetState: category=VALUE, base-type=DataType/uint8, compu-method=CM_FCA_DrvSetState
    FCA_DrvSetStatus: category=VALUE, base-type=DataType/uint8, compu-method=CM_FCA_DrvSetState
    FCA_Equip_MFC:
      category=VALUE
      base-type=DataType/uint8
      compu {0=Cx0_DAW_E_MFC_No_Coding (No Coding), 1=Cx1_DAW_E_MFC_Sensor_Fusion_FCA (Sensor Fusion FCA), 2=Cx2_DAW_E_MFC_Camera_only_FCA (Camera only FCA), 3=Cx3_DAW_E_MFC_No_FCA_Option (No FCA Option), 4=Cx4_DAW_E_MFC_ADAS_DRV_Option (ADAS_DRV Option), 5=Cx5_DAW_E_MFC_Reserved, 6=Cx6_DAW_E_MFC_Not_used (Not used), 7=Cx7_DAW_E_MFC_Error_indicator (Error indicator)}
    FCA_Failinfo: category=VALUE, base-type=DataType/uint8, compu {0=Cx0_FailI_Normal, 1=Cx1_FailI_Temp_Unavailable_by_Camera, 2=Cx2_FailI_Temp_Unavailable_by_Radar, 3=Cx3_FailI_Service_Required, 4=Cx4_FailI_Temp_Unavailable_by_Camera_Only, 5=Cx5_FailI_Reserved, 6=Cx6_FailI_Reserved, 7=Cx7_FailI_Reserved}
    FCA_FullActvReq: category=VALUE, base-type=DataType/uint8, compu {0=Cx0_FCA_FAR_No_Full_act (No Full act), 1=Cx1_FCA_FAR_Full_act (Full act), 2=Cx2_FCA_FAR_Reserved, 3=Cx3_FCA_FAR_Error_Indicator (Error Indicator)}
    FCA_HydrlcBstAsstReq: category=VALUE, base-type=DataType/uint8, compu {0=Cx0_FCA_HBAR_Standard_threshold (Standard threshold), 1=Cx1_FCA_HBAR_Lowered_threshold_1 (Lowered threshold 1), 2=Cx2_FCA_HBAR_Lowered_threshold_2 (Lowered threshold 2), 3=Cx3_FCA_HBAR_Lowered_threshold_3 (Lowered threshold 3)}
    FCA_OnOffEquipSta: category=VALUE, base-type=DataType/uint8, compu {0=Cx0_FCA_OOES_Default, 1=Cx1_FCA_OOES_Off, 2=Cx2_FCA_OOES_Warning, 3=Cx3_FCA_OOES_Assist, 4=Cx4_FCA_OOES_Reserved, 5=Cx5_FCA_OOES_Reserved, 6=Cx6_FCA_OOES_Reserved, 7=Cx7_FCA_OOES_Invalid}
    FCA_PartialActvReq: category=VALUE, base-type=DataType/uint8, compu {0=Cx0_FCA_PartialAR_No_Partial_act (No Partial act), 1=Cx1_FCA_PartialAR_Partail_act_ (Partail act), 2=Cx2_FCA_PartialAR_Reserved, 3=Cx3_FCA_PartialAR_Error_Indicator (Error Indicator)}
    FCA_PrefillActvReq: category=VALUE, base-type=DataType/uint8, compu {0=Cx0_FCA_PrefillAR_No_pre_fill (No pre-fill), 1=Cx1_FCA_PrefillAR_Pre_fill_act (Pre-fill act), 2=Cx2_FCA_PrefillAR_Reserved, 3=Cx3_FCA_PrefillAR_Error_Indicator (Error Indicator)}
    FCA_RelativeVelocity: category=VALUE, base-type=DataType/uint16
    FCA_RelVel: category=VALUE, base-type=DataType/uint16
    FCA_Sensor_Type: category=VALUE, base-type=DataType/boolean, compu {0=Cx0_FCA_ST_Not_sensor_fusion (Not sensor fusion), 1=Cx1_FCA_ST_Sensor_fusion (Sensor fusion)}
    FCA_SnstvtyModRetVal: category=VALUE, base-type=DataType/uint8, compu {0=Cx0_FCA_SMRV_Default, 1=Cx1_FCA_SMRV_Late, 2=Cx2_FCA_SMRV_Normal, 3=Cx3_FCA_SMRV_Early, 4=Cx4_FCA_SMRV_Reserved, 5=Cx5_FCA_SMRV_Reserved, 6=Cx6_FCA_SMRV_Reserved, 7=Cx7_FCA_SMRV_Invalid}
    FCA_Status: category=VALUE, base-type=DataType/uint8, compu {0=Cx0_Status_Not_Applied, 1=Cx1_Status_System_Off, 2=Cx2_Status_System_On, 3=Cx3_Status_Invalid}
    FCA_StbltActvReq: category=VALUE, base-type=DataType/uint8, compu {0=Cx0_FCA_SAR_Release_No_alert (Release No alert), 1=Cx1_FCA_SAR_Pre_crash_full_retraction (Pre-crash full retraction), 2=Cx2_FCA_SAR_Haptic_warning (Haptic warning), 3=Cx3_FCA_SAR_Reserved, 4=Cx4_FCA_SAR_Reserved, 5=Cx5_FCA_SAR_Reserved, 6=Cx6_FCA_SAR_Reserved, 7=Cx7_FCA_SAR_Reserved}
    FCA_StopReq: category=VALUE, base-type=DataType/boolean, compu {0=Cx0_StopR_No_Request, 1=Cx1_StopR_Stop_control_is_required}
    FCA_SysFlrSta:
      category=VALUE
      base-type=DataType/uint8
      compu {0=Cx0_FCA_SFS_Normal, 1=Cx1_FCA_SFS_Temp_Unavailable_by_FLC_Sensor_fusion (Temp. Unavailable by Front View Camera (Sensor fusion)), 2=Cx2_FCA_SFS_Temp_Unavailable_by_FLR_only_or_SensorfusionInFLR (Temp. Unavailable by Front Radar (Radar only or Sensor fusion in Radar)), 3=Cx3_FCA_SFS_Service_Required (Service Required), 4=Cx4_FCA_SFS_Temp_Unavailable_by_FLC_only (Temp. Unavailable by Front View Camera (Camera only)), 5=Cx5_FCA_SFS_Temp_Unavailable_by_FLC_Sensor_fusion_in_ADAS_DRV (Temp. Unavailable by Front View Camera (Sensor fusion in ADAS_DRV)), 6=Cx6_FCA_SFS_Temp_Unavailable_by_FLR_Sensor_fusion_in_FLC (Temp. Unavailable by Front Radar (Sensor fusion in Camera)), 7=Cx7_FCA_SFS_Reserved}
    FCA_TimetoCllsn: category=VALUE, base-type=DataType/uint8
    FCA_TimetoCollision: category=VALUE, base-type=DataType/uint8
    FCA_USM: category=VALUE, base-type=DataType/uint8, compu {0=Cx0_USM_Default, 1=Cx1_USM_Off, 2=Cx2_USM_Warning, 3=Cx3_USM_Assist, 4=Cx4_USM_Reserved, 5=Cx5_USM_Reserved, 6=Cx6_USM_Reserved, 7=Cx7_USM_Invalid}
    FCA_VehStpReq: category=VALUE, base-type=DataType/uint8, compu {0=Cx0_FCA_VSR_No_request (No request), 1=Cx1_FCA_VSR_Stop_control_is_required (Stop control is required), 2=Cx2_FCA_VSR_Reserved, 3=Cx3_FCA_VSR_Error_Indicator (Error Indicator)}
    FCA_WarningTargetDisplay: category=VALUE, base-type=DataType/uint8
    FCA_WrngLvlSta: category=VALUE, base-type=DataType/uint8, compu {0=Cx0_FCA_WLS_No_warning (No warning), 1=Cx1_FCA_WLS_Warning_level_1 (Warning level 1), 2=Cx2_FCA_WLS_Warning_level_2 (Warning level 2), 3=Cx3_FCA_WLS_Warning_level_3 (Warning level 3)}
    FCA_WrngSndSta: category=VALUE, base-type=DataType/uint8, compu {0=Cx0_WrngSS_No_warning, 1=Cx1_WrngSS_Warning_1, 2=Cx2_WrngSS_Warning_2, 3=Cx3_WrngSS_Warning_3}
    FCA_WrngTrgtDis: category=VALUE, base-type=DataType/uint8
    FR_CMR_AlvCnt1Val: category=VALUE, base-type=DataType/uint8
    FR_CMR_AlvCnt2Val: category=VALUE, base-type=DataType/uint8
    FR_CMR_Crc1Val: category=VALUE, base-type=DataType/uint16
    FR_CMR_Crc2Val: category=VALUE, base-type=DataType/uint16
    FR_CMR_ReqADASMapMsgVal: category=VALUE, base-type=DataType/uint16
    FR_CMR_SCCEquipSta: category=VALUE, base-type=DataType/uint8, compu {0=Cx0_CMR_SCC_ES_Not_Applied (Not Applied), 1=Cx1_CMR_SCC_ES_Applied, 2=Cx2_CMR_SCC_ES_Not_used (Not used), 3=Cx3_CMR_SCC_ES_Error_Indicator (Error Indicator)}
    FR_CMR_SwVer1Val: category=VALUE, base-type=DataType/uint8
    FR_CMR_SwVer2Val: category=VALUE, base-type=DataType/uint8
    HBA_IndLmpReq: category=VALUE, base-type=DataType/uint8, compu {0=Cx0_HBA_ILR_Indicator_Lamp_Off (HBA Indicator Lamp Off), 1=Cx1_HBA_ILR_Indicator_Lamp_On (HBA Indicator Lamp On), 2=Cx2_HBA_ILR_Reserved, 3=Cx3_HBA_ILR_Error_indicator (Error indicator)}
    HBA_OptUsmSta: category=VALUE, base-type=DataType/uint8, compu {0=Cx0_HBA_OptUS_None_HBA_Option_Default_ (None HBA Option (Default)), 1=Cx1_HBA_OptUS_HBA_Function_Off (HBA Function Off), 2=Cx2_HBA_OptUS_HBA_Function_On (HBA Function On), 3=Cx3_HBA_OptUS_Invalid_Fail_ (Invalid (Fail))}
    HBA_SysOptSta: category=VALUE, base-type=DataType/uint8, compu {0=Cx0_HBA_SOS_None_HBA_Option_Default_ (None HBA Option (Default)), 1=Cx1_HBA_SOS_HBA_Option (HBA Option), 2=Cx2_HBA_SOS_Reserved, 3=Cx3_HBA_SOS_Error_indicator (Error indicator)}
    HBA_SysSta: category=VALUE, base-type=DataType/uint8, compu {0=Cx0_HBA_SysS_Disable (HBA Disable), 1=Cx1_HBA_SysS_Enable_High_Beam_Off (HBA Enable & High Beam Off), 2=Cx2_HBA_SysS_Enable_High_Beam_On (HBA Enable & High Beam On), 3=Cx3_HBA_SysS_Reserved, 4=Cx4_HBA_SysS_Reserved, 5=Cx5_HBA_SysS_Reserved, 6=Cx6_HBA_SysS_Reserved, 7=Cx7_HBA_SysS_System_Fail (System Fail)}
    HVOA_ADAS_CMD_10_20ms_T: category=STRUCTURE
      17 x element, all with category=TYPE_REFERENCE:
        ADAS_CMD_AlvCnt10Val: range raw 0..255, implementation-data-type=ADAS_CMD_AlvCnt10Val
        ADAS_CMD_Crc10Val: range raw 0..65535, implementation-data-type=ADAS_CMD_Crc10Val
        FCA_DclReqVal: implementation-data-type=FCA_DclReqVal
        FCA_FullActvReq: range raw 0..3, implementation-data-type=FCA_FullActvReq
        FCA_HydrlcBstAsstReq: range raw 0..3, implementation-data-type=FCA_HydrlcBstAsstReq
        FCA_OnOffEquipSta: range raw 0..7, implementation-data-type=FCA_OnOffEquipSta
        FCA_PartialActvReq: range raw 0..3, implementation-data-type=FCA_PartialActvReq
        FCA_PrefillActvReq: range raw 0..3, implementation-data-type=FCA_PrefillActvReq
        FCA_RelVel: range raw 0..511, implementation-data-type=FCA_RelVel
        FCA_SnstvtyModRetVal: range raw 0..7, implementation-data-type=FCA_SnstvtyModRetVal
        FCA_StbltActvReq: range raw 0..7, implementation-data-type=FCA_StbltActvReq
        FCA_SysFlrSta: range raw 0..7, implementation-data-type=FCA_SysFlrSta
        FCA_TimetoCllsn: implementation-data-type=FCA_TimetoCllsn
        FCA_VehStpReq: range raw 0..3, implementation-data-type=FCA_VehStpReq
        FCA_WrngLvlSta: range raw 0..3, implementation-data-type=FCA_WrngLvlSta
        FCA_WrngSndSta: range raw 0..7, implementation-data-type=FCA_WrngSndSta
        FCA_WrngTrgtDis: range raw 0..31, implementation-data-type=FCA_WrngTrgtDis
    HVOA_ADAS_CMD_30_10ms_T: category=STRUCTURE
      16 x element, all with category=TYPE_REFERENCE:
        DE_HVOA_ADAS_CMD_30_10ms: range raw 0..3, implementation-data-type=ADAS_ActToiSta
        ADAS_CMD_AlvCnt30Val: range raw 0..255, implementation-data-type=ADAS_CMD_AlvCnt30Val
        ADAS_CMD_Crc30Val: range raw 0..65535, implementation-data-type=ADAS_CMD_Crc30Val
        ADAS_Damping_Gain: implementation-data-type=ADAS_Damping_Gain
        ADAS_StrTqReqVal: range raw 0..2047, implementation-data-type=ADAS_StrTqReqVal
        ADAS_ToiFltSta: range raw 0..3, implementation-data-type=ADAS_ToiFltSta
        Info_PedtrnDst: range raw 0..7, implementation-data-type=Info_PedtrnDst
        LKA_HndsoffSnd: range raw 0..3, implementation-data-type=LKA_HndsoffSnd
        LKA_LHLnWrnSta: range raw 0..3, implementation-data-type=LKA_LHLnWrnSta
        LKA_OptUsmSta: range raw 0..7, implementation-data-type=LKA_OptUsmSta
        LKA_RcgSta: range raw 0..7, implementation-data-type=LKA_RcgSta
        LKA_RHLnWrnSta: range raw 0..3, implementation-data-type=LKA_RHLnWrnSta
        LKA_StrSnd: range raw 0..3, implementation-data-type=LKA_StrSnd
        LKA_SysIndReq: range raw 0..7, implementation-data-type=LKA_SysIndReq
        LKA_SysWrn: range raw 0..15, implementation-data-type=LKA_SysWrn
        LKA_UsmMod: range raw 0..3, implementation-data-type=LKA_UsmMod
    HVOA_FCA11_FS_T: category=STRUCTURE
      17 x element, all with category=TYPE_REFERENCE:
        CF_VSM_BeltCmd: range raw 0..7, implementation-data-type=CF_VSM_BeltCmd
        CF_VSM_DecCmdAct: implementation-data-type=CF_VSM_DecCmdAct
        CF_VSM_HBACmd: range raw 0..3, implementation-data-type=CF_VSM_HBACmd
        CF_VSM_Prefill: implementation-data-type=CF_VSM_Prefill
        CF_VSM_Warn: range raw 0..3, implementation-data-type=CF_VSM_Warn
        CR_FCA_Alive: range raw 0..15, implementation-data-type=CR_FCA_Alive
        CR_VSM_DecCmd: implementation-data-type=CR_VSM_DecCmd
        FCA_CmdAct: implementation-data-type=FCA_CmdAct
        FCA_CRC: range raw 0..255, implementation-data-type=FCA_CRC
        FCA_DrvSetStatus: range raw 0..7, implementation-data-type=FCA_DrvSetStatus
        FCA_Failinfo: range raw 0..7, implementation-data-type=FCA_Failinfo
        FCA_RelativeVelocity: range raw 0..511, implementation-data-type=FCA_RelativeVelocity
        FCA_Sensor_Type: implementation-data-type=FCA_Sensor_Type
        FCA_Status: range raw 0..3, implementation-data-type=FCA_Status
        FCA_StopReq: implementation-data-type=FCA_StopReq
        FCA_TimetoCollision: implementation-data-type=FCA_TimetoCollision
        FCA_WrngSndSta: range raw 0..3, implementation-data-type=FCA_WrngSndSta
    HVOA_FCA12_T: category=STRUCTURE
      element FCA_DrvSetState: range raw 0..7, implementation-data-type=FCA_DrvSetState
      element FCA_USM: range raw 0..7, implementation-data-type=FCA_USM
      element FCA_WarningTargetDisplay: range raw 0..31, implementation-data-type=FCA_WarningTargetDisplay
    HVOA_FR_CMR_01_10ms_T: category=STRUCTURE
      18 x element, all with category=TYPE_REFERENCE:
        DAW_LVDA_OptUsmSta: range raw 0..3, implementation-data-type=DAW_LVDA_OptUsmSta
        DAW_LVDA_PUDis: range raw 0..3, implementation-data-type=DAW_LVDA_PUDis
        DAW_OptUsmSta: range raw 0..7, implementation-data-type=DAW_OptUsmSta
        DAW_SnstvtyModRetVal: range raw 0..7, implementation-data-type=DAW_SnstvtyModRetVal
        DAW_SysSta: range raw 0..15, implementation-data-type=DAW_SysSta
        DAW_TimeRstReq: range raw 0..3, implementation-data-type=DAW_TimeRstReq
        DAW_WrnMsgSta: range raw 0..7, implementation-data-type=DAW_WrnMsgSta
        FCA_Equip_MFC: range raw 0..7, implementation-data-type=FCA_Equip_MFC
        FR_CMR_AlvCnt1Val: range raw 0..255, implementation-data-type=FR_CMR_AlvCnt1Val
        FR_CMR_Crc1Val: range raw 0..65535, implementation-data-type=FR_CMR_Crc1Val
        FR_CMR_ReqADASMapMsgVal: range raw 0..65535, implementation-data-type=FR_CMR_ReqADASMapMsgVal
        FR_CMR_SCCEquipSta: range raw 0..3, implementation-data-type=FR_CMR_SCCEquipSta
        FR_CMR_SwVer1Val: range raw 0..15, implementation-data-type=FR_CMR_SwVer1Val
        FR_CMR_SwVer2Val: range raw 0..255, implementation-data-type=FR_CMR_SwVer2Val
        HBA_IndLmpReq: range raw 0..3, implementation-data-type=HBA_IndLmpReq
        HBA_OptUsmSta: range raw 0..3, implementation-data-type=HBA_OptUsmSta
        HBA_SysOptSta: range raw 0..3, implementation-data-type=HBA_SysOptSta
        HBA_SysSta: range raw 0..7, implementation-data-type=HBA_SysSta
    HVOA_FR_CMR_02_100ms_T: category=STRUCTURE
      29 x element, all with category=TYPE_REFERENCE:
        FR_CMR_AlvCnt2Val: range raw 0..255, implementation-data-type=FR_CMR_AlvCnt2Val
        FR_CMR_Crc2Val: range raw 0..65535, implementation-data-type=FR_CMR_Crc2Val
        ISLA_AddtnlSign: range raw 0..31, implementation-data-type=ISLA_AddtnlSign
        ISLA_AutoUsmSta: range raw 0..3, implementation-data-type=ISLA_AutoUsmSta
        ISLA_Cntry: range raw 0..15, implementation-data-type=ISLA_Cntry
        ISLA_IcyWrn: range raw 0..3, implementation-data-type=ISLA_IcyWrn
        ISLA_OffstUsmSta: range raw 0..7, implementation-data-type=ISLA_OffstUsmSta
        ISLA_OptUsmSta: range raw 0..7, implementation-data-type=ISLA_OptUsmSta
        ISLA_Popup: range raw 0..7, implementation-data-type=ISLA_Popup
        ISLA_SchoolZone: range raw 0..3, implementation-data-type=ISLA_SchoolZone
        ISLA_SpdChgReq: range raw 0..3, implementation-data-type=ISLA_SpdChgReq
        ISLA_SpdwOffst: implementation-data-type=ISLA_SpdwOffst
        ISLA_SpdWrn: range raw 0..3, implementation-data-type=ISLA_SpdWrn
        ISLA_SwIgnoreReq: range raw 0..3, implementation-data-type=ISLA_SwIgnoreReq
        ISLA_SymFlashMod: range raw 0..7, implementation-data-type=ISLA_SymFlashMod
        ISLW_NoPassingInfoDis: range raw 0..7, implementation-data-type=ISLW_NoPassingInfoDis
        ISLW_OptUsmSta: range raw 0..3, implementation-data-type=ISLW_OptUsmSta
        ISLW_OvrlpSignDis: range raw 0..3, implementation-data-type=ISLW_OvrlpSignDis
        ISLW_SpdCluDisSubCond1: implementation-data-type=ISLW_SpdCluDisSubCond1
        ISLW_SpdCluDisSubCond2: implementation-data-type=ISLW_SpdCluDisSubCond2
        ISLW_SpdCluMainDis: implementation-data-type=ISLW_SpdCluMainDis
        ISLW_SpdCluSubMainDis: implementation-data-type=ISLW_SpdCluSubMainDis
        ISLW_SpdNaviDisSubCond1: implementation-data-type=ISLW_SpdNaviDisSubCond1
        ISLW_SpdNaviDisSubCond2: implementation-data-type=ISLW_SpdNaviDisSubCond2
        ISLW_SpdNaviMainDis: implementation-data-type=ISLW_SpdNaviMainDis
        ISLW_SpdNaviSubMainDis: implementation-data-type=ISLW_SpdNaviSubMainDis
        ISLW_SubCondinfoSta1: range raw 0..15, implementation-data-type=ISLW_SubCondinfoSta1
        ISLW_SubCondinfoSta2: range raw 0..15, implementation-data-type=ISLW_SubCondinfoSta2
        ISLW_SysSta: range raw 0..3, implementation-data-type=ISLW_SysSta
    HVOA_LKA11_FS_T: category=STRUCTURE
      19 x element, all with category=TYPE_REFERENCE:
        CF_HBA_Lamp: implementation-data-type=CF_HBA_Lamp
        CF_HBA_Opt: implementation-data-type=CF_HBA_Opt
        CF_HBA_Opt_USM: range raw 0..3, implementation-data-type=CF_HBA_Opt_USM
        CF_HBA_SysState: range raw 0..7, implementation-data-type=CF_HBA_SysState
        CF_LKA_ActToi: implementation-data-type=CF_LKA_ActToi
        CF_LKA_CRC: range raw 0..255, implementation-data-type=CF_LKA_CRC
        CF_LKA_FusionState: range raw 0..3, implementation-data-type=CF_LKA_FusionState
        CF_LKA_HandsOff_Snd: implementation-data-type=CF_LKA_HandsOff_Snd
        CF_LKA_LaneRecogState: range raw 0..3, implementation-data-type=CF_LKA_LaneRecogState
        CF_LKA_LHWarning: range raw 0..3, implementation-data-type=CF_LKA_LHWarning
        CF_LKA_MsgCount: range raw 0..15, implementation-data-type=CF_LKA_MsgCount
        CF_LKA_Opt_USM: range raw 0..7, implementation-data-type=CF_LKA_Opt_USM
        CF_LKA_RHWarning: range raw 0..3, implementation-data-type=CF_LKA_RHWarning
        CF_LKA_SymbolState: range raw 0..7, implementation-data-type=CF_LKA_SymbolState
        CF_LKA_SysState: range raw 0..15, implementation-data-type=CF_LKA_SysState
        CF_LKA_SysWarning: range raw 0..15, implementation-data-type=CF_LKA_SysWarning
        CF_LKA_ToiFlt: implementation-data-type=CF_LKA_ToiFlt
        CF_LKA_USM_Mode: range raw 0..3, implementation-data-type=CF_LKA_USM_Mode
        CR_LKA_StrToqReq: range raw 0..2047, implementation-data-type=CR_LKA_StrToqReq
    HVOA_LKA12_T: category=STRUCTURE
      17 x element, all with category=TYPE_REFERENCE:
        CF_DAW_Opt_USM_NEW: range raw 0..3, implementation-data-type=CF_DAW_Opt_USM_NEW
        CF_DAW_Status: range raw 0..15, implementation-data-type=CF_DAW_Status
        CF_DAW_TimeReset: implementation-data-type=CF_DAW_TimeReset
        CF_DAW_Warn: range raw 0..3, implementation-data-type=CF_DAW_Warn
        CF_ISLW_Addinfo_Display: range raw 0..3, implementation-data-type=CF_ISLW_Addinfo_Display
        CF_ISLW_OvrlapSign_Dis: range raw 0..3, implementation-data-type=CF_ISLW_OvrlapSign_Dis
        CF_ISLW_Spd_Dis_CLU_Main: implementation-data-type=CF_ISLW_Spd_Dis_CLU_Main
        CF_ISLW_Spd_Dis_NAVI_Main: implementation-data-type=CF_ISLW_Spd_Dis_NAVI_Main
        CF_ISLW_Status: range raw 0..3, implementation-data-type=CF_ISLW_Status
        CF_LeadVehDptAlert_Display: range raw 0..3, implementation-data-type=CF_LeadVehDptAlert_Display
        CF_LeadVehDptAlert_USM: range raw 0..3, implementation-data-type=CF_LeadVehDptAlert_USM
        ISLA_IcyWrn: implementation-data-type=ISLA_IcyWrn
        ISLA_SpdChgReq: range raw 0..3, implementation-data-type=ISLA_SpdChgReq
        ISLA_SpdwOffst: implementation-data-type=ISLA_SpdwOffst
        ISLA_SpdWrn: implementation-data-type=ISLA_SpdWrn
        ISLA_SwIgnoreReq: range raw 0..3, implementation-data-type=ISLA_SwIgnoreReq
        ISLA_SymFlashMod: range raw 0..7, implementation-data-type=ISLA_SymFlashMod
    HVOA_LKA13_T: category=STRUCTURE
      13 x element, all with category=TYPE_REFERENCE:
        CF_ISLW_ConInfo_Sta_Con1: range raw 0..15, implementation-data-type=CF_ISLW_ConInfo_Sta_Con1
        CF_ISLW_ConInfo_Sta_Con2: range raw 0..15, implementation-data-type=CF_ISLW_ConInfo_Sta_Con2
        CF_ISLW_Spd_Dis_CLU_Con1: implementation-data-type=CF_ISLW_Spd_Dis_CLU_Con1
        CF_ISLW_Spd_Dis_CLU_Con2: implementation-data-type=CF_ISLW_Spd_Dis_CLU_Con2
        CF_ISLW_Spd_Dis_NAVI_Con1: implementation-data-type=CF_ISLW_Spd_Dis_NAVI_Con1
        CF_ISLW_Spd_Dis_NAVI_Con2: implementation-data-type=CF_ISLW_Spd_Dis_NAVI_Con2
        ISLA_AddtnlSign: range raw 0..31, implementation-data-type=ISLA_AddtnlSign
        ISLA_AutoUsmSta: range raw 0..3, implementation-data-type=ISLA_AutoUsmSta
        ISLA_Cntry: range raw 0..15, implementation-data-type=ISLA_Cntry
        ISLA_OffstUsmSta: range raw 0..7, implementation-data-type=ISLA_OffstUsmSta
        ISLA_OptUsmSta: range raw 0..7, implementation-data-type=ISLA_OptUsmSta
        ISLA_Popup: range raw 0..7, implementation-data-type=ISLA_Popup
        ISLA_SchoolZone: implementation-data-type=ISLA_SchoolZone
    Info_PedtrnDst: category=VALUE, base-type=DataType/uint8, compu {0=Cx0_Info_PD_15m_Default_ (15m~(Default)), 1=Cx1_Info_PD_10_15m (10~15m), 2=Cx2_Info_PD_5_10m (5~10m), 3=Cx3_Info_PD_0_5m (0~5m), 4=Cx4_Info_PD_Reserved, 5=Cx5_Info_PD_Reserved, 6=Cx6_Info_PD_Reserved, 7=Cx7_Info_PD_Invalid}
    ISLA_AddtnlSign:
      category=VALUE
      base-type=DataType/uint8
      compu {0=Cx00_ISLA_AS_No_Recognition_default_ (No Recognition (default)), 1=Cx01_ISLA_AS_School_Crossing (School Crossing), 2=Cx02_ISLA_AS_Pedestrian_Crossing (Pedestrian Crossing), 3=Cx03_ISLA_AS_Bicycle_Crossing (Bicycle Crossing), 4=Cx04_ISLA_AS_Reserved, 5=Cx05_ISLA_AS_Reserved, 6=Cx06_ISLA_AS_Reserved, 7=Cx07_ISLA_AS_Reserved, 8=Cx08_ISLA_AS_Stop, 9=Cx09_ISLA_AS_Yield, 10=Cx0A_ISLA_AS_Stop_Ahead (Stop Ahead), 11=Cx0B_ISLA_AS_Yield_Ahead (Yield Ahead), 12=Cx0C_ISLA_AS_Road_Construction_Ahead (Road Construction Ahead), 13=Cx0D_ISLA_AS_Lane_Reduction (Lane Reduction), 14=Cx0E_ISLA_AS_Reserved, 15=Cx0F_ISLA_AS_Reserved, 16=Cx10_ISLA_AS_Do_Not_Pass (Do Not Pass), 17=Cx11_ISLA_AS_Reserved, 18=Cx12_ISLA_AS_Reserved, 19=Cx13_ISLA_AS_Reserved, 20=Cx14_ISLA_AS_Reserved, 21=Cx15_ISLA_AS_Reserved, 22=Cx16_ISLA_AS_Reserved, 23=Cx17_ISLA_AS_Reserved, 24=Cx18_ISLA_AS_Exit, 25=Cx19_ISLA_AS_Roundabout, 26=Cx1A_ISLA_AS_Right_Curve (Right Curve), 27=Cx1B_ISLA_AS_Left_Curve (Left Curve), 28=Cx1C_ISLA_AS_Winding_Road (Winding Road), 29=Cx1D_ISLA_AS_Reserved, 30=Cx1E_ISLA_AS_Reserved, 31=Cx1F_ISLA_AS_Reserved}
    ISLA_AutoUsmSta: category=VALUE, base-type=DataType/uint8, compu {0=Cx0_ISLA_AUS_None_Auto_Function_Delete_Menu_ (None Auto Function (Delete Menu)), 1=Cx1_ISLA_AUS_Auto_Off (Auto Off), 2=Cx2_ISLA_AUS_Auto_On (Auto On), 3=Cx3_ISLA_AUS_Invalid_GRAY_ (Invalid (GRAY))}
    ISLA_Cntry:
      category=VALUE
      base-type=DataType/uint8
      compu {0=Cx0_ISLA_C_Europe_Russia_Australia (Europe/Russia/Australia), 1=Cx1_ISLA_C_Domestic, 2=Cx2_ISLA_C_China, 3=Cx3_ISLA_C_USA, 4=Cx4_ISLA_C_Canada, 5=Cx5_ISLA_C_Australia, 6=Cx6_ISLA_C_Reserved, 7=Cx7_ISLA_C_Reserved, 8=Cx8_ISLA_C_Reserved, 9=Cx9_ISLA_C_Reserved, 10=CxA_ISLA_C_Reserved, 11=CxB_ISLA_C_Reserved, 12=CxC_ISLA_C_Reserved, 13=CxD_ISLA_C_Reserved, 14=CxE_ISLA_C_Reserved, 15=CxF_ISLA_C_Initial_Value_default_ (Initial Value (default))}
    ISLA_IcyWrn: category=VALUE, base-type=DataType/uint8, compu {0=Cx0_ISLA_IW_No_Warning (No Warning), 1=Cx1_ISLA_IW_Warning, 2=Cx2_ISLA_IW_Reserved, 3=Cx3_ISLA_IW_Reserved}
    ISLA_OffstUsmSta:
      category=VALUE
      base-type=DataType/uint8
      compu {0=Cx0_ISLA_OffstUS_None_Offset_Function (None Offset Function), 1=Cx1_ISLA_OffstUS_10kph_or_5mph (-10kph or -5mph), 2=Cx2_ISLA_OffstUS_5kph_or_3mph (-5kph or -3mph), 3=Cx3_ISLA_OffstUS_0kph_or_0mph (0kph or 0mph), 4=Cx4_ISLA_OffstUS_5kph_or_3mph (+5kph or +3mph), 5=Cx5_ISLA_OffstUS_10kph_or_5mph (+10kph or +5mph), 6=Cx6_ISLA_OffstUS_Reserved, 7=Cx7_ISLA_OffstUS_Invalid_GRAY_ (Invalid (GRAY))}
    ISLA_OptUsmSta: category=VALUE, base-type=DataType/uint8, compu {0=Cx0_ISLA_OptUS_None_ISLA_Option_ (None ISLA Option (속도 제한 메뉴 삭제)), 1=Cx1_ISLA_OptUS_Off, 2=Cx2_ISLA_OptUS_Warning, 3=Cx3_ISLA_OptUS_Assist, 4=Cx4_ISLA_OptUS_Reserved, 5=Cx5_ISLA_OptUS_Reserved, 6=Cx6_ISLA_OptUS_Reserved, 7=Cx7_ISLA_OptUS_Invalid_GRAY_ (Invalid (GRAY))}
    ISLA_Popup:
      category=VALUE
      base-type=DataType/uint8
      compu {0=Cx0_ISLA_P_No_Popup (No Popup), 1=Cx1_ISLA_P_MSLA_Speed_will_Change (MSLA Speed will Change), 2=Cx2_ISLA_P_MSLA_Speed_has_Changed (MSLA Speed has Changed), 3=Cx3_ISLA_P_CC_SCC_Speed_will_Change (CC_SCC Speed will Change), 4=Cx4_ISLA_P_CC_SCC_Speed_has_Changed (CC_SCC Speed has Changed), 5=Cx5_ISLA_P_Reserved, 6=Cx6_ISLA_P_Reserved, 7=Cx7_ISLA_P_Reserved}
    ISLA_SchoolZone: category=VALUE, base-type=DataType/uint8, compu {0=Cx0_ISLA_SZ_No_School_Zone (No School Zone), 1=Cx1_ISLA_SZ_School_Zone (School Zone), 2=Cx2_ISLA_SZ_Reserved, 3=Cx3_ISLA_SZ_Reserved}
    ISLA_SpdChgReq: category=VALUE, base-type=DataType/uint8, compu {0=Cx0_ISLA_SCR_Default, 1=Cx1_ISLA_SCR_Speed_Change_Request (Speed Change Request), 2=Cx2_ISLA_SCR_Reserved, 3=Cx3_ISLA_SCR_Reserved}
    ISLA_SpdwOffst:
      category=VALUE
      base-type=DataType/uint8
      compu {0=Cx00_ISLA_SO_No_Recognition (No Recognition), 1=Cx01_1_252_kph_or_mph (1~252 kph or mph), 2=Cx02_1_252_kph_or_mph (1~252 kph or mph), 3=Cx03_1_252_kph_or_mph (1~252 kph or mph), 4=Cx04_1_252_kph_or_mph (1~252 kph or mph), 5=Cx05_1_252_kph_or_mph (1~252 kph or mph), 6=Cx06_1_252_kph_or_mph (1~252 kph or mph), 7=Cx07_1_252_kph_or_mph (1~252 kph or mph), 8=Cx08_1_252_kph_or_mph (1~252 kph or mph), 9=Cx09_1_252_kph_or_mph (1~252 kph or mph), 10=Cx0A_1_252_kph_or_mph (1~252 kph or mph), 11=Cx0B_1_252_kph_or_mph (1~252 kph or mph), 12=Cx0C_1_252_kph_or_mph (1~252 kph or mph), 13=Cx0D_1_252_kph_or_mph (1~252 kph or mph), 14=Cx0E_1_252_kph_or_mph (1~252 kph or mph), 15=Cx0F_1_252_kph_or_mph (1~252 kph or mph), 16=Cx10_1_252_kph_or_mph (1~252 kph or mph), 17=Cx11_1_252_kph_or_mph (1~252 kph or mph), 18=Cx12_1_252_kph_or_mph (1~252 kph or mph), 19=Cx13_1_252_kph_or_mph (1~252 kph or mph), 20=Cx14_1_252_kph_or_mph (1~252 kph or mph), 21=Cx15_1_252_kph_or_mph (1~252 kph or mph), 22=Cx16_1_252_kph_or_mph (1~252 kph or mph), 23=Cx17_1_252_kph_or_mph (1~252 kph or mph), 24=Cx18_1_252_kph_or_mph (1~252 kph or mph), 25=Cx19_1_252_kph_or_mph (1~252 kph or mph), 26=Cx1A_1_252_kph_or_mph (1~252 kph or mph), 27=Cx1B_1_252_kph_or_mph (1~252 kph or mph), 28=Cx1C_1_252_kph_or_mph (1~252 kph or mph), 29=Cx1D_1_252_kph_or_mph (1~252 kph or mph), 30=Cx1E_1_252_kph_or_mph (1~252 kph or mph), 31=Cx1F_1_252_kph_or_mph (1~252 kph or mph), 32=Cx20_1_252_kph_or_mph (1~252 kph or mph), 33=Cx21_1_252_kph_or_mph (1~252 kph or mph), 34=Cx22_1_252_kph_or_mph (1~252 kph or mph), 35=Cx23_1_252_kph_or_mph (1~252 kph or mph), 36=Cx24_1_252_kph_or_mph (1~252 kph or mph), 37=Cx25_1_252_kph_or_mph (1~252 kph or mph), 38=Cx26_1_252_kph_or_mph (1~252 kph or mph), 39=Cx27_1_252_kph_or_mph (1~252 kph or mph), 40=Cx28_1_252_kph_or_mph (1~252 kph or mph), 41=Cx29_1_252_kph_or_mph (1~252 kph or mph), 42=Cx2A_1_252_kph_or_mph (1~252 kph or mph), 43=Cx2B_1_252_kph_or_mph (1~252 kph or mph), 44=Cx2C_1_252_kph_or_mph (1~252 kph or mph), 45=Cx2D_1_252_kph_or_mph (1~252 kph or mph), 46=Cx2E_1_252_kph_or_mph (1~252 kph or mph), 47=Cx2F_1_252_kph_or_mph (1~252 kph or mph), 48=Cx30_1_252_kph_or_mph (1~252 kph or mph), 49=Cx31_1_252_kph_or_mph (1~252 kph or mph), 50=Cx32_1_252_kph_or_mph (1~252 kph or mph), 51=Cx33_1_252_kph_or_mph (1~252 kph or mph), 52=Cx34_1_252_kph_or_mph (1~252 kph or mph), 53=Cx35_1_252_kph_or_mph (1~252 kph or mph), 54=Cx36_1_252_kph_or_mph (1~252 kph or mph), 55=Cx37_1_252_kph_or_mph (1~252 kph or mph), 56=Cx38_1_252_kph_or_mph (1~252 kph or mph), 57=Cx39_1_252_kph_or_mph (1~252 kph or mph), 58=Cx3A_1_252_kph_or_mph (1~252 kph or mph), 59=Cx3B_1_252_kph_or_mph (1~252 kph or mph), 60=Cx3C_1_252_kph_or_mph (1~252 kph or mph), 61=Cx3D_1_252_kph_or_mph (1~252 kph or mph), 62=Cx3E_1_252_kph_or_mph (1~252 kph or mph), 63=Cx3F_1_252_kph_or_mph (1~252 kph or mph), 64=Cx40_1_252_kph_or_mph (1~252 kph or mph), 65=Cx41_1_252_kph_or_mph (1~252 kph or mph), 66=Cx42_1_252_kph_or_mph (1~252 kph or mph), 67=Cx43_1_252_kph_or_mph (1~252 kph or mph), 68=Cx44_1_252_kph_or_mph (1~252 kph or mph), 69=Cx45_1_252_kph_or_mph (1~252 kph or mph), 70=Cx46_1_252_kph_or_mph (1~252 kph or mph), 71=Cx47_1_252_kph_or_mph (1~252 kph or mph), 72=Cx48_1_252_kph_or_mph (1~252 kph or mph), 73=Cx49_1_252_kph_or_mph (1~252 kph or mph), 74=Cx4A_1_252_kph_or_mph (1~252 kph or mph), 75=Cx4B_1_252_kph_or_mph (1~252 kph or mph), 76=Cx4C_1_252_kph_or_mph (1~252 kph or mph), 77=Cx4D_1_252_kph_or_mph (1~252 kph or mph), 78=Cx4E_1_252_kph_or_mph (1~252 kph or mph), 79=Cx4F_1_252_kph_or_mph (1~252 kph or mph), 80=Cx50_1_252_kph_or_mph (1~252 kph or mph), 81=Cx51_1_252_kph_or_mph (1~252 kph or mph), 82=Cx52_1_252_kph_or_mph (1~252 kph or mph), 83=Cx53_1_252_kph_or_mph (1~252 kph or mph), 84=Cx54_1_252_kph_or_mph (1~252 kph or mph), 85=Cx55_1_252_kph_or_mph (1~252 kph or mph), 86=Cx56_1_252_kph_or_mph (1~252 kph or mph), 87=Cx57_1_252_kph_or_mph (1~252 kph or mph), 88=Cx58_1_252_kph_or_mph (1~252 kph or mph), 89=Cx59_1_252_kph_or_mph (1~252 kph or mph), 90=Cx5A_1_252_kph_or_mph (1~252 kph or mph), 91=Cx5B_1_252_kph_or_mph (1~252 kph or mph), 92=Cx5C_1_252_kph_or_mph (1~252 kph or mph), 93=Cx5D_1_252_kph_or_mph (1~252 kph or mph), 94=Cx5E_1_252_kph_or_mph (1~252 kph or mph), 95=Cx5F_1_252_kph_or_mph (1~252 kph or mph), 96=Cx60_1_252_kph_or_mph (1~252 kph or mph), 97=Cx61_1_252_kph_or_mph (1~252 kph or mph), 98=Cx62_1_252_kph_or_mph (1~252 kph or mph), 99=Cx63_1_252_kph_or_mph (1~252 kph or mph), 100=Cx64_1_252_kph_or_mph (1~252 kph or mph), 101=Cx65_1_252_kph_or_mph (1~252 kph or mph), 102=Cx66_1_252_kph_or_mph (1~252 kph or mph), 103=Cx67_1_252_kph_or_mph (1~252 kph or mph), 104=Cx68_1_252_kph_or_mph (1~252 kph or mph), 105=Cx69_1_252_kph_or_mph (1~252 kph or mph), 106=Cx6A_1_252_kph_or_mph (1~252 kph or mph), 107=Cx6B_1_252_kph_or_mph (1~252 kph or mph), 108=Cx6C_1_252_kph_or_mph (1~252 kph or mph), 109=Cx6D_1_252_kph_or_mph (1~252 kph or mph), 110=Cx6E_1_252_kph_or_mph (1~252 kph or mph), 111=Cx6F_1_252_kph_or_mph (1~252 kph or mph), 112=Cx70_1_252_kph_or_mph (1~252 kph or mph), 113=Cx71_1_252_kph_or_mph (1~252 kph or mph), 114=Cx72_1_252_kph_or_mph (1~252 kph or mph), 115=Cx73_1_252_kph_or_mph (1~252 kph or mph), 116=Cx74_1_252_kph_or_mph (1~252 kph or mph), 117=Cx75_1_252_kph_or_mph (1~252 kph or mph), 118=Cx76_1_252_kph_or_mph (1~252 kph or mph), 119=Cx77_1_252_kph_or_mph (1~252 kph or mph), 120=Cx78_1_252_kph_or_mph (1~252 kph or mph), 121=Cx79_1_252_kph_or_mph (1~252 kph or mph), 122=Cx7A_1_252_kph_or_mph (1~252 kph or mph), 123=Cx7B_1_252_kph_or_mph (1~252 kph or mph), 124=Cx7C_1_252_kph_or_mph (1~252 kph or mph), 125=Cx7D_1_252_kph_or_mph (1~252 kph or mph), 126=Cx7E_1_252_kph_or_mph (1~252 kph or mph), 127=Cx7F_1_252_kph_or_mph (1~252 kph or mph), 128=Cx80_1_252_kph_or_mph (1~252 kph or mph), 129=Cx81_1_252_kph_or_mph (1~252 kph or mph), 130=Cx82_1_252_kph_or_mph (1~252 kph or mph), 131=Cx83_1_252_kph_or_mph (1~252 kph or mph), 132=Cx84_1_252_kph_or_mph (1~252 kph or mph), 133=Cx85_1_252_kph_or_mph (1~252 kph or mph), 134=Cx86_1_252_kph_or_mph (1~252 kph or mph), 135=Cx87_1_252_kph_or_mph (1~252 kph or mph), 136=Cx88_1_252_kph_or_mph (1~252 kph or mph), 137=Cx89_1_252_kph_or_mph (1~252 kph or mph), 138=Cx8A_1_252_kph_or_mph (1~252 kph or mph), 139=Cx8B_1_252_kph_or_mph (1~252 kph or mph), 140=Cx8C_1_252_kph_or_mph (1~252 kph or mph), 141=Cx8D_1_252_kph_or_mph (1~252 kph or mph), 142=Cx8E_1_252_kph_or_mph (1~252 kph or mph), 143=Cx8F_1_252_kph_or_mph (1~252 kph or mph), 144=Cx90_1_252_kph_or_mph (1~252 kph or mph), 145=Cx91_1_252_kph_or_mph (1~252 kph or mph), 146=Cx92_1_252_kph_or_mph (1~252 kph or mph), 147=Cx93_1_252_kph_or_mph (1~252 kph or mph), 148=Cx94_1_252_kph_or_mph (1~252 kph or mph), 149=Cx95_1_252_kph_or_mph (1~252 kph or mph), 150=Cx96_1_252_kph_or_mph (1~252 kph or mph), 151=Cx97_1_252_kph_or_mph (1~252 kph or mph), 152=Cx98_1_252_kph_or_mph (1~252 kph or mph), 153=Cx99_1_252_kph_or_mph (1~252 kph or mph), 154=Cx9A_1_252_kph_or_mph (1~252 kph or mph), 155=Cx9B_1_252_kph_or_mph (1~252 kph or mph), 156=Cx9C_1_252_kph_or_mph (1~252 kph or mph), 157=Cx9D_1_252_kph_or_mph (1~252 kph or mph), 158=Cx9E_1_252_kph_or_mph (1~252 kph or mph), 159=Cx9F_1_252_kph_or_mph (1~252 kph or mph), 160=CxA0_1_252_kph_or_mph (1~252 kph or mph), 161=CxA1_1_252_kph_or_mph (1~252 kph or mph), 162=CxA2_1_252_kph_or_mph (1~252 kph or mph), 163=CxA3_1_252_kph_or_mph (1~252 kph or mph), 164=CxA4_1_252_kph_or_mph (1~252 kph or mph), 165=CxA5_1_252_kph_or_mph (1~252 kph or mph), 166=CxA6_1_252_kph_or_mph (1~252 kph or mph), 167=CxA7_1_252_kph_or_mph (1~252 kph or mph), 168=CxA8_1_252_kph_or_mph (1~252 kph or mph), 169=CxA9_1_252_kph_or_mph (1~252 kph or mph), 170=CxAA_1_252_kph_or_mph (1~252 kph or mph), 171=CxAB_1_252_kph_or_mph (1~252 kph or mph), 172=CxAC_1_252_kph_or_mph (1~252 kph or mph), 173=CxAD_1_252_kph_or_mph (1~252 kph or mph), 174=CxAE_1_252_kph_or_mph (1~252 kph or mph), 175=CxAF_1_252_kph_or_mph (1~252 kph or mph), 176=CxB0_1_252_kph_or_mph (1~252 kph or mph), 177=CxB1_1_252_kph_or_mph (1~252 kph or mph), 178=CxB2_1_252_kph_or_mph (1~252 kph or mph), 179=CxB3_1_252_kph_or_mph (1~252 kph or mph), 180=CxB4_1_252_kph_or_mph (1~252 kph or mph), 181=CxB5_1_252_kph_or_mph (1~252 kph or mph), 182=CxB6_1_252_kph_or_mph (1~252 kph or mph), 183=CxB7_1_252_kph_or_mph (1~252 kph or mph), 184=CxB8_1_252_kph_or_mph (1~252 kph or mph), 185=CxB9_1_252_kph_or_mph (1~252 kph or mph), 186=CxBA_1_252_kph_or_mph (1~252 kph or mph), 187=CxBB_1_252_kph_or_mph (1~252 kph or mph), 188=CxBC_1_252_kph_or_mph (1~252 kph or mph), 189=CxBD_1_252_kph_or_mph (1~252 kph or mph), 190=CxBE_1_252_kph_or_mph (1~252 kph or mph), 191=CxBF_1_252_kph_or_mph (1~252 kph or mph), 192=CxC0_1_252_kph_or_mph (1~252 kph or mph), 193=CxC1_1_252_kph_or_mph (1~252 kph or mph), 194=CxC2_1_252_kph_or_mph (1~252 kph or mph), 195=CxC3_1_252_kph_or_mph (1~252 kph or mph), 196=CxC4_1_252_kph_or_mph (1~252 kph or mph), 197=CxC5_1_252_kph_or_mph (1~252 kph or mph), 198=CxC6_1_252_kph_or_mph (1~252 kph or mph), 199=CxC7_1_252_kph_or_mph (1~252 kph or mph), 200=CxC8_1_252_kph_or_mph (1~252 kph or mph), 201=CxC9_1_252_kph_or_mph (1~252 kph or mph), 202=CxCA_1_252_kph_or_mph (1~252 kph or mph), 203=CxCB_1_252_kph_or_mph (1~252 kph or mph), 204=CxCC_1_252_kph_or_mph (1~252 kph or mph), 205=CxCD_1_252_kph_or_mph (1~252 kph or mph), 206=CxCE_1_252_kph_or_mph (1~252 kph or mph), 207=CxCF_1_252_kph_or_mph (1~252 kph or mph), 208=CxD0_1_252_kph_or_mph (1~252 kph or mph), 209=CxD1_1_252_kph_or_mph (1~252 kph or mph), 210=CxD2_1_252_kph_or_mph (1~252 kph or mph), 211=CxD3_1_252_kph_or_mph (1~252 kph or mph), 212=CxD4_1_252_kph_or_mph (1~252 kph or mph), 213=CxD5_1_252_kph_or_mph (1~252 kph or mph), 214=CxD6_1_252_kph_or_mph (1~252 kph or mph), 215=CxD7_1_252_kph_or_mph (1~252 kph or mph), 216=CxD8_1_252_kph_or_mph (1~252 kph or mph), 217=CxD9_1_252_kph_or_mph (1~252 kph or mph), 218=CxDA_1_252_kph_or_mph (1~252 kph or mph), 219=CxDB_1_252_kph_or_mph (1~252 kph or mph), 220=CxDC_1_252_kph_or_mph (1~252 kph or mph), 221=CxDD_1_252_kph_or_mph (1~252 kph or mph), 222=CxDE_1_252_kph_or_mph (1~252 kph or mph), 223=CxDF_1_252_kph_or_mph (1~252 kph or mph), 224=CxE0_1_252_kph_or_mph (1~252 kph or mph), 225=CxE1_1_252_kph_or_mph (1~252 kph or mph), 226=CxE2_1_252_kph_or_mph (1~252 kph or mph), 227=CxE3_1_252_kph_or_mph (1~252 kph or mph), 228=CxE4_1_252_kph_or_mph (1~252 kph or mph), 229=CxE5_1_252_kph_or_mph (1~252 kph or mph), 230=CxE6_1_252_kph_or_mph (1~252 kph or mph), 231=CxE7_1_252_kph_or_mph (1~252 kph or mph), 232=CxE8_1_252_kph_or_mph (1~252 kph or mph), 233=CxE9_1_252_kph_or_mph (1~252 kph or mph), 234=CxEA_1_252_kph_or_mph (1~252 kph or mph), 235=CxEB_1_252_kph_or_mph (1~252 kph or mph), 236=CxEC_1_252_kph_or_mph (1~252 kph or mph), 237=CxED_1_252_kph_or_mph (1~252 kph or mph), 238=CxEE_1_252_kph_or_mph (1~252 kph or mph), 239=CxEF_1_252_kph_or_mph (1~252 kph or mph), 240=CxF0_1_252_kph_or_mph (1~252 kph or mph), 241=CxF1_1_252_kph_or_mph (1~252 kph or mph), 242=CxF2_1_252_kph_or_mph (1~252 kph or mph), 243=CxF3_1_252_kph_or_mph (1~252 kph or mph), 244=CxF4_1_252_kph_or_mph (1~252 kph or mph), 245=CxF5_1_252_kph_or_mph (1~252 kph or mph), 246=CxF6_1_252_kph_or_mph (1~252 kph or mph), 247=CxF7_1_252_kph_or_mph (1~252 kph or mph), 248=CxF8_1_252_kph_or_mph (1~252 kph or mph), 249=CxF9_1_252_kph_or_mph (1~252 kph or mph), 250=CxFA_1_252_kph_or_mph (1~252 kph or mph), 251=CxFB_1_252_kph_or_mph (1~252 kph or mph), 252=CxFC_1_252_kph_or_mph (1~252 kph or mph), 253=CxFD_ISLA_SO_Unlimited_Speed (Unlimited Speed), 254=CxFE_ISLA_SO_Reserved, 255=CxFF_ISLA_SO_Invalid}
    ISLA_SpdWrn: category=VALUE, base-type=DataType/uint8, compu {0=Cx0_ISLA_SW_No_Warning (No Warning), 1=Cx1_ISLA_SW_Warning, 2=Cx2_ISLA_SW_Reserved, 3=Cx3_ISLA_SW_Reserved}
    ISLA_SwIgnoreReq: category=VALUE, base-type=DataType/uint8, compu {0=Cx0_ISLA_SIR_Allow_All_Switch_Inputs_default_ (Allow All Switch Inputs (default)), 1=Cx1_ISLA_SIR_SET_Switch_Input_Ignore (-(SET) Switch Input Ignore), 2=Cx2_ISLA_SIR_SET_Switch_Input_Ignore (+(SET) Switch Input Ignore), 3=Cx3_ISLA_SIR_SET_SET_Switch_Inputs_Ignore (-(SET) & +(SET) Switch Inputs Ignore)}
    ISLA_SymFlashMod: category=VALUE, base-type=DataType/uint8, compu {0=Cx0_ISLA_SFM_No_Flasing (No Flasing), 1=Cx1_ISLA_SFM_Flashing_Sign (Flashing Sign), 2=Cx2_ISLA_SFM_Flashing_Arrow_Symbol (Flashing - Arrow Symbol), 3=Cx3_ISLA_SFM_Flashing_Arrow_Symbol (Flashing + Arrow Symbol), 4=Cx4_ISLA_SFM_Flashing_Auto_Symbol (Flashing Auto Symbol), 5=Cx5_ISLA_SFM_Reserved, 6=Cx6_ISLA_SFM_Reserved, 7=Cx7_ISLA_SFM_Reserved}
    ISLW_NoPassingInfoDis: category=VALUE, base-type=DataType/uint8, compu {0=Cx0_ISLW_NPID_None_Display_Default_ (None Display (Default)), 1=Cx1_ISLW_NPID_LHD_No_Passing_Zone_Display (LHD No Passing Zone Display), 2=Cx2_RHD_ISLW_NPID_No_Passing_Zone_Display (RHD No Passing Zone Display), 3=Cx3_ISLW_NPID_Reserved, 4=Cx4_ISLW_NPID_Reserved, 5=Cx5_ISLW_NPID_Reserved, 6=Cx6_ISLW_NPID_Reserved, 7=Cx7_ISLW_NPID_Invalid}
    ISLW_OptUsmSta: category=VALUE, base-type=DataType/uint8, compu {0=Cx0_ISLW_OptUS_None_ISLW_Option_Default_ (None ISLW Option (Default)), 1=Cx1_ISLW_OptUS_System_Disabled_by_USM (System Disabled by USM), 2=Cx2_ISLW_OptUS_System_Enable_by_USM (System Enable by USM), 3=Cx3_ISLW_OptUS_Invalid_}
    ISLW_OvrlpSignDis: category=VALUE, base-type=DataType/uint8, compu {0=Cx0_ISLW_OvrSD_None_Default_ (None (Default)), 1=Cx1_ISLW_OvrSD_Overlap_Sign (Overlap Sign), 2=Cx2_ISLW_OvrSD_Reserved, 3=Cx3_ISLW_OvrSD_Error_indicator (Error indicator)}
    ISLW_SpdCluDisSubCond1:
      category=VALUE
      base-type=DataType/uint8
      compu {0=Cx00_ISLW_SCDSC1_No_Recognition_Default_ (No Recognition (Default)), 1=Cx01_1_252 (1~252), 2=Cx02_1_252 (1~252), 3=Cx03_1_252 (1~252), 4=Cx04_1_252 (1~252), 5=Cx05_1_252 (1~252), 6=Cx06_1_252 (1~252), 7=Cx07_1_252 (1~252), 8=Cx08_1_252 (1~252), 9=Cx09_1_252 (1~252), 10=Cx0A_1_252 (1~252), 11=Cx0B_1_252 (1~252), 12=Cx0C_1_252 (1~252), 13=Cx0D_1_252 (1~252), 14=Cx0E_1_252 (1~252), 15=Cx0F_1_252 (1~252), 16=Cx10_1_252 (1~252), 17=Cx11_1_252 (1~252), 18=Cx12_1_252 (1~252), 19=Cx13_1_252 (1~252), 20=Cx14_1_252 (1~252), 21=Cx15_1_252 (1~252), 22=Cx16_1_252 (1~252), 23=Cx17_1_252 (1~252), 24=Cx18_1_252 (1~252), 25=Cx19_1_252 (1~252), 26=Cx1A_1_252 (1~252), 27=Cx1B_1_252 (1~252), 28=Cx1C_1_252 (1~252), 29=Cx1D_1_252 (1~252), 30=Cx1E_1_252 (1~252), 31=Cx1F_1_252 (1~252), 32=Cx20_1_252 (1~252), 33=Cx21_1_252 (1~252), 34=Cx22_1_252 (1~252), 35=Cx23_1_252 (1~252), 36=Cx24_1_252 (1~252), 37=Cx25_1_252 (1~252), 38=Cx26_1_252 (1~252), 39=Cx27_1_252 (1~252), 40=Cx28_1_252 (1~252), 41=Cx29_1_252 (1~252), 42=Cx2A_1_252 (1~252), 43=Cx2B_1_252 (1~252), 44=Cx2C_1_252 (1~252), 45=Cx2D_1_252 (1~252), 46=Cx2E_1_252 (1~252), 47=Cx2F_1_252 (1~252), 48=Cx30_1_252 (1~252), 49=Cx31_1_252 (1~252), 50=Cx32_1_252 (1~252), 51=Cx33_1_252 (1~252), 52=Cx34_1_252 (1~252), 53=Cx35_1_252 (1~252), 54=Cx36_1_252 (1~252), 55=Cx37_1_252 (1~252), 56=Cx38_1_252 (1~252), 57=Cx39_1_252 (1~252), 58=Cx3A_1_252 (1~252), 59=Cx3B_1_252 (1~252), 60=Cx3C_1_252 (1~252), 61=Cx3D_1_252 (1~252), 62=Cx3E_1_252 (1~252), 63=Cx3F_1_252 (1~252), 64=Cx40_1_252 (1~252), 65=Cx41_1_252 (1~252), 66=Cx42_1_252 (1~252), 67=Cx43_1_252 (1~252), 68=Cx44_1_252 (1~252), 69=Cx45_1_252 (1~252), 70=Cx46_1_252 (1~252), 71=Cx47_1_252 (1~252), 72=Cx48_1_252 (1~252), 73=Cx49_1_252 (1~252), 74=Cx4A_1_252 (1~252), 75=Cx4B_1_252 (1~252), 76=Cx4C_1_252 (1~252), 77=Cx4D_1_252 (1~252), 78=Cx4E_1_252 (1~252), 79=Cx4F_1_252 (1~252), 80=Cx50_1_252 (1~252), 81=Cx51_1_252 (1~252), 82=Cx52_1_252 (1~252), 83=Cx53_1_252 (1~252), 84=Cx54_1_252 (1~252), 85=Cx55_1_252 (1~252), 86=Cx56_1_252 (1~252), 87=Cx57_1_252 (1~252), 88=Cx58_1_252 (1~252), 89=Cx59_1_252 (1~252), 90=Cx5A_1_252 (1~252), 91=Cx5B_1_252 (1~252), 92=Cx5C_1_252 (1~252), 93=Cx5D_1_252 (1~252), 94=Cx5E_1_252 (1~252), 95=Cx5F_1_252 (1~252), 96=Cx60_1_252 (1~252), 97=Cx61_1_252 (1~252), 98=Cx62_1_252 (1~252), 99=Cx63_1_252 (1~252), 100=Cx64_1_252 (1~252), 101=Cx65_1_252 (1~252), 102=Cx66_1_252 (1~252), 103=Cx67_1_252 (1~252), 104=Cx68_1_252 (1~252), 105=Cx69_1_252 (1~252), 106=Cx6A_1_252 (1~252), 107=Cx6B_1_252 (1~252), 108=Cx6C_1_252 (1~252), 109=Cx6D_1_252 (1~252), 110=Cx6E_1_252 (1~252), 111=Cx6F_1_252 (1~252), 112=Cx70_1_252 (1~252), 113=Cx71_1_252 (1~252), 114=Cx72_1_252 (1~252), 115=Cx73_1_252 (1~252), 116=Cx74_1_252 (1~252), 117=Cx75_1_252 (1~252), 118=Cx76_1_252 (1~252), 119=Cx77_1_252 (1~252), 120=Cx78_1_252 (1~252), 121=Cx79_1_252 (1~252), 122=Cx7A_1_252 (1~252), 123=Cx7B_1_252 (1~252), 124=Cx7C_1_252 (1~252), 125=Cx7D_1_252 (1~252), 126=Cx7E_1_252 (1~252), 127=Cx7F_1_252 (1~252), 128=Cx80_1_252 (1~252), 129=Cx81_1_252 (1~252), 130=Cx82_1_252 (1~252), 131=Cx83_1_252 (1~252), 132=Cx84_1_252 (1~252), 133=Cx85_1_252 (1~252), 134=Cx86_1_252 (1~252), 135=Cx87_1_252 (1~252), 136=Cx88_1_252 (1~252), 137=Cx89_1_252 (1~252), 138=Cx8A_1_252 (1~252), 139=Cx8B_1_252 (1~252), 140=Cx8C_1_252 (1~252), 141=Cx8D_1_252 (1~252), 142=Cx8E_1_252 (1~252), 143=Cx8F_1_252 (1~252), 144=Cx90_1_252 (1~252), 145=Cx91_1_252 (1~252), 146=Cx92_1_252 (1~252), 147=Cx93_1_252 (1~252), 148=Cx94_1_252 (1~252), 149=Cx95_1_252 (1~252), 150=Cx96_1_252 (1~252), 151=Cx97_1_252 (1~252), 152=Cx98_1_252 (1~252), 153=Cx99_1_252 (1~252), 154=Cx9A_1_252 (1~252), 155=Cx9B_1_252 (1~252), 156=Cx9C_1_252 (1~252), 157=Cx9D_1_252 (1~252), 158=Cx9E_1_252 (1~252), 159=Cx9F_1_252 (1~252), 160=CxA0_1_252 (1~252), 161=CxA1_1_252 (1~252), 162=CxA2_1_252 (1~252), 163=CxA3_1_252 (1~252), 164=CxA4_1_252 (1~252), 165=CxA5_1_252 (1~252), 166=CxA6_1_252 (1~252), 167=CxA7_1_252 (1~252), 168=CxA8_1_252 (1~252), 169=CxA9_1_252 (1~252), 170=CxAA_1_252 (1~252), 171=CxAB_1_252 (1~252), 172=CxAC_1_252 (1~252), 173=CxAD_1_252 (1~252), 174=CxAE_1_252 (1~252), 175=CxAF_1_252 (1~252), 176=CxB0_1_252 (1~252), 177=CxB1_1_252 (1~252), 178=CxB2_1_252 (1~252), 179=CxB3_1_252 (1~252), 180=CxB4_1_252 (1~252), 181=CxB5_1_252 (1~252), 182=CxB6_1_252 (1~252), 183=CxB7_1_252 (1~252), 184=CxB8_1_252 (1~252), 185=CxB9_1_252 (1~252), 186=CxBA_1_252 (1~252), 187=CxBB_1_252 (1~252), 188=CxBC_1_252 (1~252), 189=CxBD_1_252 (1~252), 190=CxBE_1_252 (1~252), 191=CxBF_1_252 (1~252), 192=CxC0_1_252 (1~252), 193=CxC1_1_252 (1~252), 194=CxC2_1_252 (1~252), 195=CxC3_1_252 (1~252), 196=CxC4_1_252 (1~252), 197=CxC5_1_252 (1~252), 198=CxC6_1_252 (1~252), 199=CxC7_1_252 (1~252), 200=CxC8_1_252 (1~252), 201=CxC9_1_252 (1~252), 202=CxCA_1_252 (1~252), 203=CxCB_1_252 (1~252), 204=CxCC_1_252 (1~252), 205=CxCD_1_252 (1~252), 206=CxCE_1_252 (1~252), 207=CxCF_1_252 (1~252), 208=CxD0_1_252 (1~252), 209=CxD1_1_252 (1~252), 210=CxD2_1_252 (1~252), 211=CxD3_1_252 (1~252), 212=CxD4_1_252 (1~252), 213=CxD5_1_252 (1~252), 214=CxD6_1_252 (1~252), 215=CxD7_1_252 (1~252), 216=CxD8_1_252 (1~252), 217=CxD9_1_252 (1~252), 218=CxDA_1_252 (1~252), 219=CxDB_1_252 (1~252), 220=CxDC_1_252 (1~252), 221=CxDD_1_252 (1~252), 222=CxDE_1_252 (1~252), 223=CxDF_1_252 (1~252), 224=CxE0_1_252 (1~252), 225=CxE1_1_252 (1~252), 226=CxE2_1_252 (1~252), 227=CxE3_1_252 (1~252), 228=CxE4_1_252 (1~252), 229=CxE5_1_252 (1~252), 230=CxE6_1_252 (1~252), 231=CxE7_1_252 (1~252), 232=CxE8_1_252 (1~252), 233=CxE9_1_252 (1~252), 234=CxEA_1_252 (1~252), 235=CxEB_1_252 (1~252), 236=CxEC_1_252 (1~252), 237=CxED_1_252 (1~252), 238=CxEE_1_252 (1~252), 239=CxEF_1_252 (1~252), 240=CxF0_1_252 (1~252), 241=CxF1_1_252 (1~252), 242=CxF2_1_252 (1~252), 243=CxF3_1_252 (1~252), 244=CxF4_1_252 (1~252), 245=CxF5_1_252 (1~252), 246=CxF6_1_252 (1~252), 247=CxF7_1_252 (1~252), 248=CxF8_1_252 (1~252), 249=CxF9_1_252 (1~252), 250=CxFA_1_252 (1~252), 251=CxFB_1_252 (1~252), 252=CxFC_1_252 (1~252), 253=CxFD_ISLW_SCDSC1_LHD_Conditional_No_Passing_ZONE (LHD Conditional No Passing ZONE), 254=CxFE_RHD_ISLW_SCDSC1_Conditional_No_Passing_ZONE (RHD Conditional No Passing ZONE), 255=CxFF_ISLW_SCDSC1_Invalid}
    ISLW_SpdCluDisSubCond2:
      category=VALUE
      base-type=DataType/uint8
      compu {0=Cx00_ISLW_SCDSC2_No_Recognition_Default_ (No Recognition (Default)), 1=Cx01_1_252 (1~252), 2=Cx02_1_252 (1~252), 3=Cx03_1_252 (1~252), 4=Cx04_1_252 (1~252), 5=Cx05_1_252 (1~252), 6=Cx06_1_252 (1~252), 7=Cx07_1_252 (1~252), 8=Cx08_1_252 (1~252), 9=Cx09_1_252 (1~252), 10=Cx0A_1_252 (1~252), 11=Cx0B_1_252 (1~252), 12=Cx0C_1_252 (1~252), 13=Cx0D_1_252 (1~252), 14=Cx0E_1_252 (1~252), 15=Cx0F_1_252 (1~252), 16=Cx10_1_252 (1~252), 17=Cx11_1_252 (1~252), 18=Cx12_1_252 (1~252), 19=Cx13_1_252 (1~252), 20=Cx14_1_252 (1~252), 21=Cx15_1_252 (1~252), 22=Cx16_1_252 (1~252), 23=Cx17_1_252 (1~252), 24=Cx18_1_252 (1~252), 25=Cx19_1_252 (1~252), 26=Cx1A_1_252 (1~252), 27=Cx1B_1_252 (1~252), 28=Cx1C_1_252 (1~252), 29=Cx1D_1_252 (1~252), 30=Cx1E_1_252 (1~252), 31=Cx1F_1_252 (1~252), 32=Cx20_1_252 (1~252), 33=Cx21_1_252 (1~252), 34=Cx22_1_252 (1~252), 35=Cx23_1_252 (1~252), 36=Cx24_1_252 (1~252), 37=Cx25_1_252 (1~252), 38=Cx26_1_252 (1~252), 39=Cx27_1_252 (1~252), 40=Cx28_1_252 (1~252), 41=Cx29_1_252 (1~252), 42=Cx2A_1_252 (1~252), 43=Cx2B_1_252 (1~252), 44=Cx2C_1_252 (1~252), 45=Cx2D_1_252 (1~252), 46=Cx2E_1_252 (1~252), 47=Cx2F_1_252 (1~252), 48=Cx30_1_252 (1~252), 49=Cx31_1_252 (1~252), 50=Cx32_1_252 (1~252), 51=Cx33_1_252 (1~252), 52=Cx34_1_252 (1~252), 53=Cx35_1_252 (1~252), 54=Cx36_1_252 (1~252), 55=Cx37_1_252 (1~252), 56=Cx38_1_252 (1~252), 57=Cx39_1_252 (1~252), 58=Cx3A_1_252 (1~252), 59=Cx3B_1_252 (1~252), 60=Cx3C_1_252 (1~252), 61=Cx3D_1_252 (1~252), 62=Cx3E_1_252 (1~252), 63=Cx3F_1_252 (1~252), 64=Cx40_1_252 (1~252), 65=Cx41_1_252 (1~252), 66=Cx42_1_252 (1~252), 67=Cx43_1_252 (1~252), 68=Cx44_1_252 (1~252), 69=Cx45_1_252 (1~252), 70=Cx46_1_252 (1~252), 71=Cx47_1_252 (1~252), 72=Cx48_1_252 (1~252), 73=Cx49_1_252 (1~252), 74=Cx4A_1_252 (1~252), 75=Cx4B_1_252 (1~252), 76=Cx4C_1_252 (1~252), 77=Cx4D_1_252 (1~252), 78=Cx4E_1_252 (1~252), 79=Cx4F_1_252 (1~252), 80=Cx50_1_252 (1~252), 81=Cx51_1_252 (1~252), 82=Cx52_1_252 (1~252), 83=Cx53_1_252 (1~252), 84=Cx54_1_252 (1~252), 85=Cx55_1_252 (1~252), 86=Cx56_1_252 (1~252), 87=Cx57_1_252 (1~252), 88=Cx58_1_252 (1~252), 89=Cx59_1_252 (1~252), 90=Cx5A_1_252 (1~252), 91=Cx5B_1_252 (1~252), 92=Cx5C_1_252 (1~252), 93=Cx5D_1_252 (1~252), 94=Cx5E_1_252 (1~252), 95=Cx5F_1_252 (1~252), 96=Cx60_1_252 (1~252), 97=Cx61_1_252 (1~252), 98=Cx62_1_252 (1~252), 99=Cx63_1_252 (1~252), 100=Cx64_1_252 (1~252), 101=Cx65_1_252 (1~252), 102=Cx66_1_252 (1~252), 103=Cx67_1_252 (1~252), 104=Cx68_1_252 (1~252), 105=Cx69_1_252 (1~252), 106=Cx6A_1_252 (1~252), 107=Cx6B_1_252 (1~252), 108=Cx6C_1_252 (1~252), 109=Cx6D_1_252 (1~252), 110=Cx6E_1_252 (1~252), 111=Cx6F_1_252 (1~252), 112=Cx70_1_252 (1~252), 113=Cx71_1_252 (1~252), 114=Cx72_1_252 (1~252), 115=Cx73_1_252 (1~252), 116=Cx74_1_252 (1~252), 117=Cx75_1_252 (1~252), 118=Cx76_1_252 (1~252), 119=Cx77_1_252 (1~252), 120=Cx78_1_252 (1~252), 121=Cx79_1_252 (1~252), 122=Cx7A_1_252 (1~252), 123=Cx7B_1_252 (1~252), 124=Cx7C_1_252 (1~252), 125=Cx7D_1_252 (1~252), 126=Cx7E_1_252 (1~252), 127=Cx7F_1_252 (1~252), 128=Cx80_1_252 (1~252), 129=Cx81_1_252 (1~252), 130=Cx82_1_252 (1~252), 131=Cx83_1_252 (1~252), 132=Cx84_1_252 (1~252), 133=Cx85_1_252 (1~252), 134=Cx86_1_252 (1~252), 135=Cx87_1_252 (1~252), 136=Cx88_1_252 (1~252), 137=Cx89_1_252 (1~252), 138=Cx8A_1_252 (1~252), 139=Cx8B_1_252 (1~252), 140=Cx8C_1_252 (1~252), 141=Cx8D_1_252 (1~252), 142=Cx8E_1_252 (1~252), 143=Cx8F_1_252 (1~252), 144=Cx90_1_252 (1~252), 145=Cx91_1_252 (1~252), 146=Cx92_1_252 (1~252), 147=Cx93_1_252 (1~252), 148=Cx94_1_252 (1~252), 149=Cx95_1_252 (1~252), 150=Cx96_1_252 (1~252), 151=Cx97_1_252 (1~252), 152=Cx98_1_252 (1~252), 153=Cx99_1_252 (1~252), 154=Cx9A_1_252 (1~252), 155=Cx9B_1_252 (1~252), 156=Cx9C_1_252 (1~252), 157=Cx9D_1_252 (1~252), 158=Cx9E_1_252 (1~252), 159=Cx9F_1_252 (1~252), 160=CxA0_1_252 (1~252), 161=CxA1_1_252 (1~252), 162=CxA2_1_252 (1~252), 163=CxA3_1_252 (1~252), 164=CxA4_1_252 (1~252), 165=CxA5_1_252 (1~252), 166=CxA6_1_252 (1~252), 167=CxA7_1_252 (1~252), 168=CxA8_1_252 (1~252), 169=CxA9_1_252 (1~252), 170=CxAA_1_252 (1~252), 171=CxAB_1_252 (1~252), 172=CxAC_1_252 (1~252), 173=CxAD_1_252 (1~252), 174=CxAE_1_252 (1~252), 175=CxAF_1_252 (1~252), 176=CxB0_1_252 (1~252), 177=CxB1_1_252 (1~252), 178=CxB2_1_252 (1~252), 179=CxB3_1_252 (1~252), 180=CxB4_1_252 (1~252), 181=CxB5_1_252 (1~252), 182=CxB6_1_252 (1~252), 183=CxB7_1_252 (1~252), 184=CxB8_1_252 (1~252), 185=CxB9_1_252 (1~252), 186=CxBA_1_252 (1~252), 187=CxBB_1_252 (1~252), 188=CxBC_1_252 (1~252), 189=CxBD_1_252 (1~252), 190=CxBE_1_252 (1~252), 191=CxBF_1_252 (1~252), 192=CxC0_1_252 (1~252), 193=CxC1_1_252 (1~252), 194=CxC2_1_252 (1~252), 195=CxC3_1_252 (1~252), 196=CxC4_1_252 (1~252), 197=CxC5_1_252 (1~252), 198=CxC6_1_252 (1~252), 199=CxC7_1_252 (1~252), 200=CxC8_1_252 (1~252), 201=CxC9_1_252 (1~252), 202=CxCA_1_252 (1~252), 203=CxCB_1_252 (1~252), 204=CxCC_1_252 (1~252), 205=CxCD_1_252 (1~252), 206=CxCE_1_252 (1~252), 207=CxCF_1_252 (1~252), 208=CxD0_1_252 (1~252), 209=CxD1_1_252 (1~252), 210=CxD2_1_252 (1~252), 211=CxD3_1_252 (1~252), 212=CxD4_1_252 (1~252), 213=CxD5_1_252 (1~252), 214=CxD6_1_252 (1~252), 215=CxD7_1_252 (1~252), 216=CxD8_1_252 (1~252), 217=CxD9_1_252 (1~252), 218=CxDA_1_252 (1~252), 219=CxDB_1_252 (1~252), 220=CxDC_1_252 (1~252), 221=CxDD_1_252 (1~252), 222=CxDE_1_252 (1~252), 223=CxDF_1_252 (1~252), 224=CxE0_1_252 (1~252), 225=CxE1_1_252 (1~252), 226=CxE2_1_252 (1~252), 227=CxE3_1_252 (1~252), 228=CxE4_1_252 (1~252), 229=CxE5_1_252 (1~252), 230=CxE6_1_252 (1~252), 231=CxE7_1_252 (1~252), 232=CxE8_1_252 (1~252), 233=CxE9_1_252 (1~252), 234=CxEA_1_252 (1~252), 235=CxEB_1_252 (1~252), 236=CxEC_1_252 (1~252), 237=CxED_1_252 (1~252), 238=CxEE_1_252 (1~252), 239=CxEF_1_252 (1~252), 240=CxF0_1_252 (1~252), 241=CxF1_1_252 (1~252), 242=CxF2_1_252 (1~252), 243=CxF3_1_252 (1~252), 244=CxF4_1_252 (1~252), 245=CxF5_1_252 (1~252), 246=CxF6_1_252 (1~252), 247=CxF7_1_252 (1~252), 248=CxF8_1_252 (1~252), 249=CxF9_1_252 (1~252), 250=CxFA_1_252 (1~252), 251=CxFB_1_252 (1~252), 252=CxFC_1_252 (1~252), 253=CxFD_ISLW_SCDSC2_LHD_Conditional_No_Passing_ZONE (LHD Conditional No Passing ZONE), 254=CxFE_ISLW_SCDSC2_RHD_Conditional_No_Passing_ZONE (RHD Conditional No Passing ZONE), 255=CxFF_ISLW_SCDSC2_Invalid}
    ISLW_SpdCluMainDis:
      category=VALUE
      base-type=DataType/uint8
      compu {0=Cx00_ISLW_SCMD_No_Recognition_Default_ (No Recognition (Default)), 1=Cx01_1_252 (1~252), 2=Cx02_1_252 (1~252), 3=Cx03_1_252 (1~252), 4=Cx04_1_252 (1~252), 5=Cx05_1_252 (1~252), 6=Cx06_1_252 (1~252), 7=Cx07_1_252 (1~252), 8=Cx08_1_252 (1~252), 9=Cx09_1_252 (1~252), 10=Cx0A_1_252 (1~252), 11=Cx0B_1_252 (1~252), 12=Cx0C_1_252 (1~252), 13=Cx0D_1_252 (1~252), 14=Cx0E_1_252 (1~252), 15=Cx0F_1_252 (1~252), 16=Cx10_1_252 (1~252), 17=Cx11_1_252 (1~252), 18=Cx12_1_252 (1~252), 19=Cx13_1_252 (1~252), 20=Cx14_1_252 (1~252), 21=Cx15_1_252 (1~252), 22=Cx16_1_252 (1~252), 23=Cx17_1_252 (1~252), 24=Cx18_1_252 (1~252), 25=Cx19_1_252 (1~252), 26=Cx1A_1_252 (1~252), 27=Cx1B_1_252 (1~252), 28=Cx1C_1_252 (1~252), 29=Cx1D_1_252 (1~252), 30=Cx1E_1_252 (1~252), 31=Cx1F_1_252 (1~252), 32=Cx20_1_252 (1~252), 33=Cx21_1_252 (1~252), 34=Cx22_1_252 (1~252), 35=Cx23_1_252 (1~252), 36=Cx24_1_252 (1~252), 37=Cx25_1_252 (1~252), 38=Cx26_1_252 (1~252), 39=Cx27_1_252 (1~252), 40=Cx28_1_252 (1~252), 41=Cx29_1_252 (1~252), 42=Cx2A_1_252 (1~252), 43=Cx2B_1_252 (1~252), 44=Cx2C_1_252 (1~252), 45=Cx2D_1_252 (1~252), 46=Cx2E_1_252 (1~252), 47=Cx2F_1_252 (1~252), 48=Cx30_1_252 (1~252), 49=Cx31_1_252 (1~252), 50=Cx32_1_252 (1~252), 51=Cx33_1_252 (1~252), 52=Cx34_1_252 (1~252), 53=Cx35_1_252 (1~252), 54=Cx36_1_252 (1~252), 55=Cx37_1_252 (1~252), 56=Cx38_1_252 (1~252), 57=Cx39_1_252 (1~252), 58=Cx3A_1_252 (1~252), 59=Cx3B_1_252 (1~252), 60=Cx3C_1_252 (1~252), 61=Cx3D_1_252 (1~252), 62=Cx3E_1_252 (1~252), 63=Cx3F_1_252 (1~252), 64=Cx40_1_252 (1~252), 65=Cx41_1_252 (1~252), 66=Cx42_1_252 (1~252), 67=Cx43_1_252 (1~252), 68=Cx44_1_252 (1~252), 69=Cx45_1_252 (1~252), 70=Cx46_1_252 (1~252), 71=Cx47_1_252 (1~252), 72=Cx48_1_252 (1~252), 73=Cx49_1_252 (1~252), 74=Cx4A_1_252 (1~252), 75=Cx4B_1_252 (1~252), 76=Cx4C_1_252 (1~252), 77=Cx4D_1_252 (1~252), 78=Cx4E_1_252 (1~252), 79=Cx4F_1_252 (1~252), 80=Cx50_1_252 (1~252), 81=Cx51_1_252 (1~252), 82=Cx52_1_252 (1~252), 83=Cx53_1_252 (1~252), 84=Cx54_1_252 (1~252), 85=Cx55_1_252 (1~252), 86=Cx56_1_252 (1~252), 87=Cx57_1_252 (1~252), 88=Cx58_1_252 (1~252), 89=Cx59_1_252 (1~252), 90=Cx5A_1_252 (1~252), 91=Cx5B_1_252 (1~252), 92=Cx5C_1_252 (1~252), 93=Cx5D_1_252 (1~252), 94=Cx5E_1_252 (1~252), 95=Cx5F_1_252 (1~252), 96=Cx60_1_252 (1~252), 97=Cx61_1_252 (1~252), 98=Cx62_1_252 (1~252), 99=Cx63_1_252 (1~252), 100=Cx64_1_252 (1~252), 101=Cx65_1_252 (1~252), 102=Cx66_1_252 (1~252), 103=Cx67_1_252 (1~252), 104=Cx68_1_252 (1~252), 105=Cx69_1_252 (1~252), 106=Cx6A_1_252 (1~252), 107=Cx6B_1_252 (1~252), 108=Cx6C_1_252 (1~252), 109=Cx6D_1_252 (1~252), 110=Cx6E_1_252 (1~252), 111=Cx6F_1_252 (1~252), 112=Cx70_1_252 (1~252), 113=Cx71_1_252 (1~252), 114=Cx72_1_252 (1~252), 115=Cx73_1_252 (1~252), 116=Cx74_1_252 (1~252), 117=Cx75_1_252 (1~252), 118=Cx76_1_252 (1~252), 119=Cx77_1_252 (1~252), 120=Cx78_1_252 (1~252), 121=Cx79_1_252 (1~252), 122=Cx7A_1_252 (1~252), 123=Cx7B_1_252 (1~252), 124=Cx7C_1_252 (1~252), 125=Cx7D_1_252 (1~252), 126=Cx7E_1_252 (1~252), 127=Cx7F_1_252 (1~252), 128=Cx80_1_252 (1~252), 129=Cx81_1_252 (1~252), 130=Cx82_1_252 (1~252), 131=Cx83_1_252 (1~252), 132=Cx84_1_252 (1~252), 133=Cx85_1_252 (1~252), 134=Cx86_1_252 (1~252), 135=Cx87_1_252 (1~252), 136=Cx88_1_252 (1~252), 137=Cx89_1_252 (1~252), 138=Cx8A_1_252 (1~252), 139=Cx8B_1_252 (1~252), 140=Cx8C_1_252 (1~252), 141=Cx8D_1_252 (1~252), 142=Cx8E_1_252 (1~252), 143=Cx8F_1_252 (1~252), 144=Cx90_1_252 (1~252), 145=Cx91_1_252 (1~252), 146=Cx92_1_252 (1~252), 147=Cx93_1_252 (1~252), 148=Cx94_1_252 (1~252), 149=Cx95_1_252 (1~252), 150=Cx96_1_252 (1~252), 151=Cx97_1_252 (1~252), 152=Cx98_1_252 (1~252), 153=Cx99_1_252 (1~252), 154=Cx9A_1_252 (1~252), 155=Cx9B_1_252 (1~252), 156=Cx9C_1_252 (1~252), 157=Cx9D_1_252 (1~252), 158=Cx9E_1_252 (1~252), 159=Cx9F_1_252 (1~252), 160=CxA0_1_252 (1~252), 161=CxA1_1_252 (1~252), 162=CxA2_1_252 (1~252), 163=CxA3_1_252 (1~252), 164=CxA4_1_252 (1~252), 165=CxA5_1_252 (1~252), 166=CxA6_1_252 (1~252), 167=CxA7_1_252 (1~252), 168=CxA8_1_252 (1~252), 169=CxA9_1_252 (1~252), 170=CxAA_1_252 (1~252), 171=CxAB_1_252 (1~252), 172=CxAC_1_252 (1~252), 173=CxAD_1_252 (1~252), 174=CxAE_1_252 (1~252), 175=CxAF_1_252 (1~252), 176=CxB0_1_252 (1~252), 177=CxB1_1_252 (1~252), 178=CxB2_1_252 (1~252), 179=CxB3_1_252 (1~252), 180=CxB4_1_252 (1~252), 181=CxB5_1_252 (1~252), 182=CxB6_1_252 (1~252), 183=CxB7_1_252 (1~252), 184=CxB8_1_252 (1~252), 185=CxB9_1_252 (1~252), 186=CxBA_1_252 (1~252), 187=CxBB_1_252 (1~252), 188=CxBC_1_252 (1~252), 189=CxBD_1_252 (1~252), 190=CxBE_1_252 (1~252), 191=CxBF_1_252 (1~252), 192=CxC0_1_252 (1~252), 193=CxC1_1_252 (1~252), 194=CxC2_1_252 (1~252), 195=CxC3_1_252 (1~252), 196=CxC4_1_252 (1~252), 197=CxC5_1_252 (1~252), 198=CxC6_1_252 (1~252), 199=CxC7_1_252 (1~252), 200=CxC8_1_252 (1~252), 201=CxC9_1_252 (1~252), 202=CxCA_1_252 (1~252), 203=CxCB_1_252 (1~252), 204=CxCC_1_252 (1~252), 205=CxCD_1_252 (1~252), 206=CxCE_1_252 (1~252), 207=CxCF_1_252 (1~252), 208=CxD0_1_252 (1~252), 209=CxD1_1_252 (1~252), 210=CxD2_1_252 (1~252), 211=CxD3_1_252 (1~252), 212=CxD4_1_252 (1~252), 213=CxD5_1_252 (1~252), 214=CxD6_1_252 (1~252), 215=CxD7_1_252 (1~252), 216=CxD8_1_252 (1~252), 217=CxD9_1_252 (1~252), 218=CxDA_1_252 (1~252), 219=CxDB_1_252 (1~252), 220=CxDC_1_252 (1~252), 221=CxDD_1_252 (1~252), 222=CxDE_1_252 (1~252), 223=CxDF_1_252 (1~252), 224=CxE0_1_252 (1~252), 225=CxE1_1_252 (1~252), 226=CxE2_1_252 (1~252), 227=CxE3_1_252 (1~252), 228=CxE4_1_252 (1~252), 229=CxE5_1_252 (1~252), 230=CxE6_1_252 (1~252), 231=CxE7_1_252 (1~252), 232=CxE8_1_252 (1~252), 233=CxE9_1_252 (1~252), 234=CxEA_1_252 (1~252), 235=CxEB_1_252 (1~252), 236=CxEC_1_252 (1~252), 237=CxED_1_252 (1~252), 238=CxEE_1_252 (1~252), 239=CxEF_1_252 (1~252), 240=CxF0_1_252 (1~252), 241=CxF1_1_252 (1~252), 242=CxF2_1_252 (1~252), 243=CxF3_1_252 (1~252), 244=CxF4_1_252 (1~252), 245=CxF5_1_252 (1~252), 246=CxF6_1_252 (1~252), 247=CxF7_1_252 (1~252), 248=CxF8_1_252 (1~252), 249=CxF9_1_252 (1~252), 250=CxFA_1_252 (1~252), 251=CxFB_1_252 (1~252), 252=CxFC_1_252 (1~252), 253=CxFD_ISLW_SCMD_Unlimited_Speed (Unlimited Speed), 254=CxFE_ISLW_SCMD_Reserved, 255=CxFF_ISLW_SCMD_Invalid}
    ISLW_SpdCluSubMainDis:
      category=VALUE
      base-type=DataType/uint8
      compu {0=Cx00_ISLW_SCSMD_No_Recognition_Default_ (No Recognition (Default)), 1=Cx01_1_252 (1~252), 2=Cx02_1_252 (1~252), 3=Cx03_1_252 (1~252), 4=Cx04_1_252 (1~252), 5=Cx05_1_252 (1~252), 6=Cx06_1_252 (1~252), 7=Cx07_1_252 (1~252), 8=Cx08_1_252 (1~252), 9=Cx09_1_252 (1~252), 10=Cx0A_1_252 (1~252), 11=Cx0B_1_252 (1~252), 12=Cx0C_1_252 (1~252), 13=Cx0D_1_252 (1~252), 14=Cx0E_1_252 (1~252), 15=Cx0F_1_252 (1~252), 16=Cx10_1_252 (1~252), 17=Cx11_1_252 (1~252), 18=Cx12_1_252 (1~252), 19=Cx13_1_252 (1~252), 20=Cx14_1_252 (1~252), 21=Cx15_1_252 (1~252), 22=Cx16_1_252 (1~252), 23=Cx17_1_252 (1~252), 24=Cx18_1_252 (1~252), 25=Cx19_1_252 (1~252), 26=Cx1A_1_252 (1~252), 27=Cx1B_1_252 (1~252), 28=Cx1C_1_252 (1~252), 29=Cx1D_1_252 (1~252), 30=Cx1E_1_252 (1~252), 31=Cx1F_1_252 (1~252), 32=Cx20_1_252 (1~252), 33=Cx21_1_252 (1~252), 34=Cx22_1_252 (1~252), 35=Cx23_1_252 (1~252), 36=Cx24_1_252 (1~252), 37=Cx25_1_252 (1~252), 38=Cx26_1_252 (1~252), 39=Cx27_1_252 (1~252), 40=Cx28_1_252 (1~252), 41=Cx29_1_252 (1~252), 42=Cx2A_1_252 (1~252), 43=Cx2B_1_252 (1~252), 44=Cx2C_1_252 (1~252), 45=Cx2D_1_252 (1~252), 46=Cx2E_1_252 (1~252), 47=Cx2F_1_252 (1~252), 48=Cx30_1_252 (1~252), 49=Cx31_1_252 (1~252), 50=Cx32_1_252 (1~252), 51=Cx33_1_252 (1~252), 52=Cx34_1_252 (1~252), 53=Cx35_1_252 (1~252), 54=Cx36_1_252 (1~252), 55=Cx37_1_252 (1~252), 56=Cx38_1_252 (1~252), 57=Cx39_1_252 (1~252), 58=Cx3A_1_252 (1~252), 59=Cx3B_1_252 (1~252), 60=Cx3C_1_252 (1~252), 61=Cx3D_1_252 (1~252), 62=Cx3E_1_252 (1~252), 63=Cx3F_1_252 (1~252), 64=Cx40_1_252 (1~252), 65=Cx41_1_252 (1~252), 66=Cx42_1_252 (1~252), 67=Cx43_1_252 (1~252), 68=Cx44_1_252 (1~252), 69=Cx45_1_252 (1~252), 70=Cx46_1_252 (1~252), 71=Cx47_1_252 (1~252), 72=Cx48_1_252 (1~252), 73=Cx49_1_252 (1~252), 74=Cx4A_1_252 (1~252), 75=Cx4B_1_252 (1~252), 76=Cx4C_1_252 (1~252), 77=Cx4D_1_252 (1~252), 78=Cx4E_1_252 (1~252), 79=Cx4F_1_252 (1~252), 80=Cx50_1_252 (1~252), 81=Cx51_1_252 (1~252), 82=Cx52_1_252 (1~252), 83=Cx53_1_252 (1~252), 84=Cx54_1_252 (1~252), 85=Cx55_1_252 (1~252), 86=Cx56_1_252 (1~252), 87=Cx57_1_252 (1~252), 88=Cx58_1_252 (1~252), 89=Cx59_1_252 (1~252), 90=Cx5A_1_252 (1~252), 91=Cx5B_1_252 (1~252), 92=Cx5C_1_252 (1~252), 93=Cx5D_1_252 (1~252), 94=Cx5E_1_252 (1~252), 95=Cx5F_1_252 (1~252), 96=Cx60_1_252 (1~252), 97=Cx61_1_252 (1~252), 98=Cx62_1_252 (1~252), 99=Cx63_1_252 (1~252), 100=Cx64_1_252 (1~252), 101=Cx65_1_252 (1~252), 102=Cx66_1_252 (1~252), 103=Cx67_1_252 (1~252), 104=Cx68_1_252 (1~252), 105=Cx69_1_252 (1~252), 106=Cx6A_1_252 (1~252), 107=Cx6B_1_252 (1~252), 108=Cx6C_1_252 (1~252), 109=Cx6D_1_252 (1~252), 110=Cx6E_1_252 (1~252), 111=Cx6F_1_252 (1~252), 112=Cx70_1_252 (1~252), 113=Cx71_1_252 (1~252), 114=Cx72_1_252 (1~252), 115=Cx73_1_252 (1~252), 116=Cx74_1_252 (1~252), 117=Cx75_1_252 (1~252), 118=Cx76_1_252 (1~252), 119=Cx77_1_252 (1~252), 120=Cx78_1_252 (1~252), 121=Cx79_1_252 (1~252), 122=Cx7A_1_252 (1~252), 123=Cx7B_1_252 (1~252), 124=Cx7C_1_252 (1~252), 125=Cx7D_1_252 (1~252), 126=Cx7E_1_252 (1~252), 127=Cx7F_1_252 (1~252), 128=Cx80_1_252 (1~252), 129=Cx81_1_252 (1~252), 130=Cx82_1_252 (1~252), 131=Cx83_1_252 (1~252), 132=Cx84_1_252 (1~252), 133=Cx85_1_252 (1~252), 134=Cx86_1_252 (1~252), 135=Cx87_1_252 (1~252), 136=Cx88_1_252 (1~252), 137=Cx89_1_252 (1~252), 138=Cx8A_1_252 (1~252), 139=Cx8B_1_252 (1~252), 140=Cx8C_1_252 (1~252), 141=Cx8D_1_252 (1~252), 142=Cx8E_1_252 (1~252), 143=Cx8F_1_252 (1~252), 144=Cx90_1_252 (1~252), 145=Cx91_1_252 (1~252), 146=Cx92_1_252 (1~252), 147=Cx93_1_252 (1~252), 148=Cx94_1_252 (1~252), 149=Cx95_1_252 (1~252), 150=Cx96_1_252 (1~252), 151=Cx97_1_252 (1~252), 152=Cx98_1_252 (1~252), 153=Cx99_1_252 (1~252), 154=Cx9A_1_252 (1~252), 155=Cx9B_1_252 (1~252), 156=Cx9C_1_252 (1~252), 157=Cx9D_1_252 (1~252), 158=Cx9E_1_252 (1~252), 159=Cx9F_1_252 (1~252), 160=CxA0_1_252 (1~252), 161=CxA1_1_252 (1~252), 162=CxA2_1_252 (1~252), 163=CxA3_1_252 (1~252), 164=CxA4_1_252 (1~252), 165=CxA5_1_252 (1~252), 166=CxA6_1_252 (1~252), 167=CxA7_1_252 (1~252), 168=CxA8_1_252 (1~252), 169=CxA9_1_252 (1~252), 170=CxAA_1_252 (1~252), 171=CxAB_1_252 (1~252), 172=CxAC_1_252 (1~252), 173=CxAD_1_252 (1~252), 174=CxAE_1_252 (1~252), 175=CxAF_1_252 (1~252), 176=CxB0_1_252 (1~252), 177=CxB1_1_252 (1~252), 178=CxB2_1_252 (1~252), 179=CxB3_1_252 (1~252), 180=CxB4_1_252 (1~252), 181=CxB5_1_252 (1~252), 182=CxB6_1_252 (1~252), 183=CxB7_1_252 (1~252), 184=CxB8_1_252 (1~252), 185=CxB9_1_252 (1~252), 186=CxBA_1_252 (1~252), 187=CxBB_1_252 (1~252), 188=CxBC_1_252 (1~252), 189=CxBD_1_252 (1~252), 190=CxBE_1_252 (1~252), 191=CxBF_1_252 (1~252), 192=CxC0_1_252 (1~252), 193=CxC1_1_252 (1~252), 194=CxC2_1_252 (1~252), 195=CxC3_1_252 (1~252), 196=CxC4_1_252 (1~252), 197=CxC5_1_252 (1~252), 198=CxC6_1_252 (1~252), 199=CxC7_1_252 (1~252), 200=CxC8_1_252 (1~252), 201=CxC9_1_252 (1~252), 202=CxCA_1_252 (1~252), 203=CxCB_1_252 (1~252), 204=CxCC_1_252 (1~252), 205=CxCD_1_252 (1~252), 206=CxCE_1_252 (1~252), 207=CxCF_1_252 (1~252), 208=CxD0_1_252 (1~252), 209=CxD1_1_252 (1~252), 210=CxD2_1_252 (1~252), 211=CxD3_1_252 (1~252), 212=CxD4_1_252 (1~252), 213=CxD5_1_252 (1~252), 214=CxD6_1_252 (1~252), 215=CxD7_1_252 (1~252), 216=CxD8_1_252 (1~252), 217=CxD9_1_252 (1~252), 218=CxDA_1_252 (1~252), 219=CxDB_1_252 (1~252), 220=CxDC_1_252 (1~252), 221=CxDD_1_252 (1~252), 222=CxDE_1_252 (1~252), 223=CxDF_1_252 (1~252), 224=CxE0_1_252 (1~252), 225=CxE1_1_252 (1~252), 226=CxE2_1_252 (1~252), 227=CxE3_1_252 (1~252), 228=CxE4_1_252 (1~252), 229=CxE5_1_252 (1~252), 230=CxE6_1_252 (1~252), 231=CxE7_1_252 (1~252), 232=CxE8_1_252 (1~252), 233=CxE9_1_252 (1~252), 234=CxEA_1_252 (1~252), 235=CxEB_1_252 (1~252), 236=CxEC_1_252 (1~252), 237=CxED_1_252 (1~252), 238=CxEE_1_252 (1~252), 239=CxEF_1_252 (1~252), 240=CxF0_1_252 (1~252), 241=CxF1_1_252 (1~252), 242=CxF2_1_252 (1~252), 243=CxF3_1_252 (1~252), 244=CxF4_1_252 (1~252), 245=CxF5_1_252 (1~252), 246=CxF6_1_252 (1~252), 247=CxF7_1_252 (1~252), 248=CxF8_1_252 (1~252), 249=CxF9_1_252 (1~252), 250=CxFA_1_252 (1~252), 251=CxFB_1_252 (1~252), 252=CxFC_1_252 (1~252), 253=CxFD_ISLW_SCSMD_Unlimited_Speed (Unlimited Speed), 254=CxFE_ISLW_SCSMD_Reserved, 255=CxFF_ISLW_SCSMD_Invalid}
    ISLW_SpdNaviDisSubCond1:
      category=VALUE
      base-type=DataType/uint8
      compu {0=Cx00_ISLW_SNDSC1_No_Recognition_Default_ (No Recognition (Default)), 1=Cx01_1_252 (1~252), 2=Cx02_1_252 (1~252), 3=Cx03_1_252 (1~252), 4=Cx04_1_252 (1~252), 5=Cx05_1_252 (1~252), 6=Cx06_1_252 (1~252), 7=Cx07_1_252 (1~252), 8=Cx08_1_252 (1~252), 9=Cx09_1_252 (1~252), 10=Cx0A_1_252 (1~252), 11=Cx0B_1_252 (1~252), 12=Cx0C_1_252 (1~252), 13=Cx0D_1_252 (1~252), 14=Cx0E_1_252 (1~252), 15=Cx0F_1_252 (1~252), 16=Cx10_1_252 (1~252), 17=Cx11_1_252 (1~252), 18=Cx12_1_252 (1~252), 19=Cx13_1_252 (1~252), 20=Cx14_1_252 (1~252), 21=Cx15_1_252 (1~252), 22=Cx16_1_252 (1~252), 23=Cx17_1_252 (1~252), 24=Cx18_1_252 (1~252), 25=Cx19_1_252 (1~252), 26=Cx1A_1_252 (1~252), 27=Cx1B_1_252 (1~252), 28=Cx1C_1_252 (1~252), 29=Cx1D_1_252 (1~252), 30=Cx1E_1_252 (1~252), 31=Cx1F_1_252 (1~252), 32=Cx20_1_252 (1~252), 33=Cx21_1_252 (1~252), 34=Cx22_1_252 (1~252), 35=Cx23_1_252 (1~252), 36=Cx24_1_252 (1~252), 37=Cx25_1_252 (1~252), 38=Cx26_1_252 (1~252), 39=Cx27_1_252 (1~252), 40=Cx28_1_252 (1~252), 41=Cx29_1_252 (1~252), 42=Cx2A_1_252 (1~252), 43=Cx2B_1_252 (1~252), 44=Cx2C_1_252 (1~252), 45=Cx2D_1_252 (1~252), 46=Cx2E_1_252 (1~252), 47=Cx2F_1_252 (1~252), 48=Cx30_1_252 (1~252), 49=Cx31_1_252 (1~252), 50=Cx32_1_252 (1~252), 51=Cx33_1_252 (1~252), 52=Cx34_1_252 (1~252), 53=Cx35_1_252 (1~252), 54=Cx36_1_252 (1~252), 55=Cx37_1_252 (1~252), 56=Cx38_1_252 (1~252), 57=Cx39_1_252 (1~252), 58=Cx3A_1_252 (1~252), 59=Cx3B_1_252 (1~252), 60=Cx3C_1_252 (1~252), 61=Cx3D_1_252 (1~252), 62=Cx3E_1_252 (1~252), 63=Cx3F_1_252 (1~252), 64=Cx40_1_252 (1~252), 65=Cx41_1_252 (1~252), 66=Cx42_1_252 (1~252), 67=Cx43_1_252 (1~252), 68=Cx44_1_252 (1~252), 69=Cx45_1_252 (1~252), 70=Cx46_1_252 (1~252), 71=Cx47_1_252 (1~252), 72=Cx48_1_252 (1~252), 73=Cx49_1_252 (1~252), 74=Cx4A_1_252 (1~252), 75=Cx4B_1_252 (1~252), 76=Cx4C_1_252 (1~252), 77=Cx4D_1_252 (1~252), 78=Cx4E_1_252 (1~252), 79=Cx4F_1_252 (1~252), 80=Cx50_1_252 (1~252), 81=Cx51_1_252 (1~252), 82=Cx52_1_252 (1~252), 83=Cx53_1_252 (1~252), 84=Cx54_1_252 (1~252), 85=Cx55_1_252 (1~252), 86=Cx56_1_252 (1~252), 87=Cx57_1_252 (1~252), 88=Cx58_1_252 (1~252), 89=Cx59_1_252 (1~252), 90=Cx5A_1_252 (1~252), 91=Cx5B_1_252 (1~252), 92=Cx5C_1_252 (1~252), 93=Cx5D_1_252 (1~252), 94=Cx5E_1_252 (1~252), 95=Cx5F_1_252 (1~252), 96=Cx60_1_252 (1~252), 97=Cx61_1_252 (1~252), 98=Cx62_1_252 (1~252), 99=Cx63_1_252 (1~252), 100=Cx64_1_252 (1~252), 101=Cx65_1_252 (1~252), 102=Cx66_1_252 (1~252), 103=Cx67_1_252 (1~252), 104=Cx68_1_252 (1~252), 105=Cx69_1_252 (1~252), 106=Cx6A_1_252 (1~252), 107=Cx6B_1_252 (1~252), 108=Cx6C_1_252 (1~252), 109=Cx6D_1_252 (1~252), 110=Cx6E_1_252 (1~252), 111=Cx6F_1_252 (1~252), 112=Cx70_1_252 (1~252), 113=Cx71_1_252 (1~252), 114=Cx72_1_252 (1~252), 115=Cx73_1_252 (1~252), 116=Cx74_1_252 (1~252), 117=Cx75_1_252 (1~252), 118=Cx76_1_252 (1~252), 119=Cx77_1_252 (1~252), 120=Cx78_1_252 (1~252), 121=Cx79_1_252 (1~252), 122=Cx7A_1_252 (1~252), 123=Cx7B_1_252 (1~252), 124=Cx7C_1_252 (1~252), 125=Cx7D_1_252 (1~252), 126=Cx7E_1_252 (1~252), 127=Cx7F_1_252 (1~252), 128=Cx80_1_252 (1~252), 129=Cx81_1_252 (1~252), 130=Cx82_1_252 (1~252), 131=Cx83_1_252 (1~252), 132=Cx84_1_252 (1~252), 133=Cx85_1_252 (1~252), 134=Cx86_1_252 (1~252), 135=Cx87_1_252 (1~252), 136=Cx88_1_252 (1~252), 137=Cx89_1_252 (1~252), 138=Cx8A_1_252 (1~252), 139=Cx8B_1_252 (1~252), 140=Cx8C_1_252 (1~252), 141=Cx8D_1_252 (1~252), 142=Cx8E_1_252 (1~252), 143=Cx8F_1_252 (1~252), 144=Cx90_1_252 (1~252), 145=Cx91_1_252 (1~252), 146=Cx92_1_252 (1~252), 147=Cx93_1_252 (1~252), 148=Cx94_1_252 (1~252), 149=Cx95_1_252 (1~252), 150=Cx96_1_252 (1~252), 151=Cx97_1_252 (1~252), 152=Cx98_1_252 (1~252), 153=Cx99_1_252 (1~252), 154=Cx9A_1_252 (1~252), 155=Cx9B_1_252 (1~252), 156=Cx9C_1_252 (1~252), 157=Cx9D_1_252 (1~252), 158=Cx9E_1_252 (1~252), 159=Cx9F_1_252 (1~252), 160=CxA0_1_252 (1~252), 161=CxA1_1_252 (1~252), 162=CxA2_1_252 (1~252), 163=CxA3_1_252 (1~252), 164=CxA4_1_252 (1~252), 165=CxA5_1_252 (1~252), 166=CxA6_1_252 (1~252), 167=CxA7_1_252 (1~252), 168=CxA8_1_252 (1~252), 169=CxA9_1_252 (1~252), 170=CxAA_1_252 (1~252), 171=CxAB_1_252 (1~252), 172=CxAC_1_252 (1~252), 173=CxAD_1_252 (1~252), 174=CxAE_1_252 (1~252), 175=CxAF_1_252 (1~252), 176=CxB0_1_252 (1~252), 177=CxB1_1_252 (1~252), 178=CxB2_1_252 (1~252), 179=CxB3_1_252 (1~252), 180=CxB4_1_252 (1~252), 181=CxB5_1_252 (1~252), 182=CxB6_1_252 (1~252), 183=CxB7_1_252 (1~252), 184=CxB8_1_252 (1~252), 185=CxB9_1_252 (1~252), 186=CxBA_1_252 (1~252), 187=CxBB_1_252 (1~252), 188=CxBC_1_252 (1~252), 189=CxBD_1_252 (1~252), 190=CxBE_1_252 (1~252), 191=CxBF_1_252 (1~252), 192=CxC0_1_252 (1~252), 193=CxC1_1_252 (1~252), 194=CxC2_1_252 (1~252), 195=CxC3_1_252 (1~252), 196=CxC4_1_252 (1~252), 197=CxC5_1_252 (1~252), 198=CxC6_1_252 (1~252), 199=CxC7_1_252 (1~252), 200=CxC8_1_252 (1~252), 201=CxC9_1_252 (1~252), 202=CxCA_1_252 (1~252), 203=CxCB_1_252 (1~252), 204=CxCC_1_252 (1~252), 205=CxCD_1_252 (1~252), 206=CxCE_1_252 (1~252), 207=CxCF_1_252 (1~252), 208=CxD0_1_252 (1~252), 209=CxD1_1_252 (1~252), 210=CxD2_1_252 (1~252), 211=CxD3_1_252 (1~252), 212=CxD4_1_252 (1~252), 213=CxD5_1_252 (1~252), 214=CxD6_1_252 (1~252), 215=CxD7_1_252 (1~252), 216=CxD8_1_252 (1~252), 217=CxD9_1_252 (1~252), 218=CxDA_1_252 (1~252), 219=CxDB_1_252 (1~252), 220=CxDC_1_252 (1~252), 221=CxDD_1_252 (1~252), 222=CxDE_1_252 (1~252), 223=CxDF_1_252 (1~252), 224=CxE0_1_252 (1~252), 225=CxE1_1_252 (1~252), 226=CxE2_1_252 (1~252), 227=CxE3_1_252 (1~252), 228=CxE4_1_252 (1~252), 229=CxE5_1_252 (1~252), 230=CxE6_1_252 (1~252), 231=CxE7_1_252 (1~252), 232=CxE8_1_252 (1~252), 233=CxE9_1_252 (1~252), 234=CxEA_1_252 (1~252), 235=CxEB_1_252 (1~252), 236=CxEC_1_252 (1~252), 237=CxED_1_252 (1~252), 238=CxEE_1_252 (1~252), 239=CxEF_1_252 (1~252), 240=CxF0_1_252 (1~252), 241=CxF1_1_252 (1~252), 242=CxF2_1_252 (1~252), 243=CxF3_1_252 (1~252), 244=CxF4_1_252 (1~252), 245=CxF5_1_252 (1~252), 246=CxF6_1_252 (1~252), 247=CxF7_1_252 (1~252), 248=CxF8_1_252 (1~252), 249=CxF9_1_252 (1~252), 250=CxFA_1_252 (1~252), 251=CxFB_1_252 (1~252), 252=CxFC_1_252 (1~252), 253=CxFD_ISLW_SNDSC1_LHD_Conditional_No_Passing_ZONE (LHD Conditional No Passing ZONE), 254=CxFE_ISLW_SNDSC1_RHD_Conditional_No_Passing_ZONE (RHD Conditional No Passing ZONE), 255=CxFF_ISLW_SNDSC1_Invalid}
    ISLW_SpdNaviDisSubCond2:
      category=VALUE
      base-type=DataType/uint8
      compu {0=Cx00_ISLW_SNDSC2_No_Recognition_Default_ (No Recognition (Default)), 1=Cx01_1_252 (1~252), 2=Cx02_1_252 (1~252), 3=Cx03_1_252 (1~252), 4=Cx04_1_252 (1~252), 5=Cx05_1_252 (1~252), 6=Cx06_1_252 (1~252), 7=Cx07_1_252 (1~252), 8=Cx08_1_252 (1~252), 9=Cx09_1_252 (1~252), 10=Cx0A_1_252 (1~252), 11=Cx0B_1_252 (1~252), 12=Cx0C_1_252 (1~252), 13=Cx0D_1_252 (1~252), 14=Cx0E_1_252 (1~252), 15=Cx0F_1_252 (1~252), 16=Cx10_1_252 (1~252), 17=Cx11_1_252 (1~252), 18=Cx12_1_252 (1~252), 19=Cx13_1_252 (1~252), 20=Cx14_1_252 (1~252), 21=Cx15_1_252 (1~252), 22=Cx16_1_252 (1~252), 23=Cx17_1_252 (1~252), 24=Cx18_1_252 (1~252), 25=Cx19_1_252 (1~252), 26=Cx1A_1_252 (1~252), 27=Cx1B_1_252 (1~252), 28=Cx1C_1_252 (1~252), 29=Cx1D_1_252 (1~252), 30=Cx1E_1_252 (1~252), 31=Cx1F_1_252 (1~252), 32=Cx20_1_252 (1~252), 33=Cx21_1_252 (1~252), 34=Cx22_1_252 (1~252), 35=Cx23_1_252 (1~252), 36=Cx24_1_252 (1~252), 37=Cx25_1_252 (1~252), 38=Cx26_1_252 (1~252), 39=Cx27_1_252 (1~252), 40=Cx28_1_252 (1~252), 41=Cx29_1_252 (1~252), 42=Cx2A_1_252 (1~252), 43=Cx2B_1_252 (1~252), 44=Cx2C_1_252 (1~252), 45=Cx2D_1_252 (1~252), 46=Cx2E_1_252 (1~252), 47=Cx2F_1_252 (1~252), 48=Cx30_1_252 (1~252), 49=Cx31_1_252 (1~252), 50=Cx32_1_252 (1~252), 51=Cx33_1_252 (1~252), 52=Cx34_1_252 (1~252), 53=Cx35_1_252 (1~252), 54=Cx36_1_252 (1~252), 55=Cx37_1_252 (1~252), 56=Cx38_1_252 (1~252), 57=Cx39_1_252 (1~252), 58=Cx3A_1_252 (1~252), 59=Cx3B_1_252 (1~252), 60=Cx3C_1_252 (1~252), 61=Cx3D_1_252 (1~252), 62=Cx3E_1_252 (1~252), 63=Cx3F_1_252 (1~252), 64=Cx40_1_252 (1~252), 65=Cx41_1_252 (1~252), 66=Cx42_1_252 (1~252), 67=Cx43_1_252 (1~252), 68=Cx44_1_252 (1~252), 69=Cx45_1_252 (1~252), 70=Cx46_1_252 (1~252), 71=Cx47_1_252 (1~252), 72=Cx48_1_252 (1~252), 73=Cx49_1_252 (1~252), 74=Cx4A_1_252 (1~252), 75=Cx4B_1_252 (1~252), 76=Cx4C_1_252 (1~252), 77=Cx4D_1_252 (1~252), 78=Cx4E_1_252 (1~252), 79=Cx4F_1_252 (1~252), 80=Cx50_1_252 (1~252), 81=Cx51_1_252 (1~252), 82=Cx52_1_252 (1~252), 83=Cx53_1_252 (1~252), 84=Cx54_1_252 (1~252), 85=Cx55_1_252 (1~252), 86=Cx56_1_252 (1~252), 87=Cx57_1_252 (1~252), 88=Cx58_1_252 (1~252), 89=Cx59_1_252 (1~252), 90=Cx5A_1_252 (1~252), 91=Cx5B_1_252 (1~252), 92=Cx5C_1_252 (1~252), 93=Cx5D_1_252 (1~252), 94=Cx5E_1_252 (1~252), 95=Cx5F_1_252 (1~252), 96=Cx60_1_252 (1~252), 97=Cx61_1_252 (1~252), 98=Cx62_1_252 (1~252), 99=Cx63_1_252 (1~252), 100=Cx64_1_252 (1~252), 101=Cx65_1_252 (1~252), 102=Cx66_1_252 (1~252), 103=Cx67_1_252 (1~252), 104=Cx68_1_252 (1~252), 105=Cx69_1_252 (1~252), 106=Cx6A_1_252 (1~252), 107=Cx6B_1_252 (1~252), 108=Cx6C_1_252 (1~252), 109=Cx6D_1_252 (1~252), 110=Cx6E_1_252 (1~252), 111=Cx6F_1_252 (1~252), 112=Cx70_1_252 (1~252), 113=Cx71_1_252 (1~252), 114=Cx72_1_252 (1~252), 115=Cx73_1_252 (1~252), 116=Cx74_1_252 (1~252), 117=Cx75_1_252 (1~252), 118=Cx76_1_252 (1~252), 119=Cx77_1_252 (1~252), 120=Cx78_1_252 (1~252), 121=Cx79_1_252 (1~252), 122=Cx7A_1_252 (1~252), 123=Cx7B_1_252 (1~252), 124=Cx7C_1_252 (1~252), 125=Cx7D_1_252 (1~252), 126=Cx7E_1_252 (1~252), 127=Cx7F_1_252 (1~252), 128=Cx80_1_252 (1~252), 129=Cx81_1_252 (1~252), 130=Cx82_1_252 (1~252), 131=Cx83_1_252 (1~252), 132=Cx84_1_252 (1~252), 133=Cx85_1_252 (1~252), 134=Cx86_1_252 (1~252), 135=Cx87_1_252 (1~252), 136=Cx88_1_252 (1~252), 137=Cx89_1_252 (1~252), 138=Cx8A_1_252 (1~252), 139=Cx8B_1_252 (1~252), 140=Cx8C_1_252 (1~252), 141=Cx8D_1_252 (1~252), 142=Cx8E_1_252 (1~252), 143=Cx8F_1_252 (1~252), 144=Cx90_1_252 (1~252), 145=Cx91_1_252 (1~252), 146=Cx92_1_252 (1~252), 147=Cx93_1_252 (1~252), 148=Cx94_1_252 (1~252), 149=Cx95_1_252 (1~252), 150=Cx96_1_252 (1~252), 151=Cx97_1_252 (1~252), 152=Cx98_1_252 (1~252), 153=Cx99_1_252 (1~252), 154=Cx9A_1_252 (1~252), 155=Cx9B_1_252 (1~252), 156=Cx9C_1_252 (1~252), 157=Cx9D_1_252 (1~252), 158=Cx9E_1_252 (1~252), 159=Cx9F_1_252 (1~252), 160=CxA0_1_252 (1~252), 161=CxA1_1_252 (1~252), 162=CxA2_1_252 (1~252), 163=CxA3_1_252 (1~252), 164=CxA4_1_252 (1~252), 165=CxA5_1_252 (1~252), 166=CxA6_1_252 (1~252), 167=CxA7_1_252 (1~252), 168=CxA8_1_252 (1~252), 169=CxA9_1_252 (1~252), 170=CxAA_1_252 (1~252), 171=CxAB_1_252 (1~252), 172=CxAC_1_252 (1~252), 173=CxAD_1_252 (1~252), 174=CxAE_1_252 (1~252), 175=CxAF_1_252 (1~252), 176=CxB0_1_252 (1~252), 177=CxB1_1_252 (1~252), 178=CxB2_1_252 (1~252), 179=CxB3_1_252 (1~252), 180=CxB4_1_252 (1~252), 181=CxB5_1_252 (1~252), 182=CxB6_1_252 (1~252), 183=CxB7_1_252 (1~252), 184=CxB8_1_252 (1~252), 185=CxB9_1_252 (1~252), 186=CxBA_1_252 (1~252), 187=CxBB_1_252 (1~252), 188=CxBC_1_252 (1~252), 189=CxBD_1_252 (1~252), 190=CxBE_1_252 (1~252), 191=CxBF_1_252 (1~252), 192=CxC0_1_252 (1~252), 193=CxC1_1_252 (1~252), 194=CxC2_1_252 (1~252), 195=CxC3_1_252 (1~252), 196=CxC4_1_252 (1~252), 197=CxC5_1_252 (1~252), 198=CxC6_1_252 (1~252), 199=CxC7_1_252 (1~252), 200=CxC8_1_252 (1~252), 201=CxC9_1_252 (1~252), 202=CxCA_1_252 (1~252), 203=CxCB_1_252 (1~252), 204=CxCC_1_252 (1~252), 205=CxCD_1_252 (1~252), 206=CxCE_1_252 (1~252), 207=CxCF_1_252 (1~252), 208=CxD0_1_252 (1~252), 209=CxD1_1_252 (1~252), 210=CxD2_1_252 (1~252), 211=CxD3_1_252 (1~252), 212=CxD4_1_252 (1~252), 213=CxD5_1_252 (1~252), 214=CxD6_1_252 (1~252), 215=CxD7_1_252 (1~252), 216=CxD8_1_252 (1~252), 217=CxD9_1_252 (1~252), 218=CxDA_1_252 (1~252), 219=CxDB_1_252 (1~252), 220=CxDC_1_252 (1~252), 221=CxDD_1_252 (1~252), 222=CxDE_1_252 (1~252), 223=CxDF_1_252 (1~252), 224=CxE0_1_252 (1~252), 225=CxE1_1_252 (1~252), 226=CxE2_1_252 (1~252), 227=CxE3_1_252 (1~252), 228=CxE4_1_252 (1~252), 229=CxE5_1_252 (1~252), 230=CxE6_1_252 (1~252), 231=CxE7_1_252 (1~252), 232=CxE8_1_252 (1~252), 233=CxE9_1_252 (1~252), 234=CxEA_1_252 (1~252), 235=CxEB_1_252 (1~252), 236=CxEC_1_252 (1~252), 237=CxED_1_252 (1~252), 238=CxEE_1_252 (1~252), 239=CxEF_1_252 (1~252), 240=CxF0_1_252 (1~252), 241=CxF1_1_252 (1~252), 242=CxF2_1_252 (1~252), 243=CxF3_1_252 (1~252), 244=CxF4_1_252 (1~252), 245=CxF5_1_252 (1~252), 246=CxF6_1_252 (1~252), 247=CxF7_1_252 (1~252), 248=CxF8_1_252 (1~252), 249=CxF9_1_252 (1~252), 250=CxFA_1_252 (1~252), 251=CxFB_1_252 (1~252), 252=CxFC_1_252 (1~252), 253=CxFD_ISLW_SNDSC2_LHD_Conditional_No_Passing_ZONE (LHD Conditional No Passing ZONE), 254=CxFE_ISLW_SNDSC2_RHD_Conditional_No_Passing_ZONE (RHD Conditional No Passing ZONE), 255=CxFF_ISLW_SNDSC2_Invalid}
    ISLW_SpdNaviMainDis:
      category=VALUE
      base-type=DataType/uint8
      compu {0=Cx00_ISLW_SNMD_No_Recognition_Default_ (No Recognition (Default)), 1=Cx01_1_252 (1~252), 2=Cx02_1_252 (1~252), 3=Cx03_1_252 (1~252), 4=Cx04_1_252 (1~252), 5=Cx05_1_252 (1~252), 6=Cx06_1_252 (1~252), 7=Cx07_1_252 (1~252), 8=Cx08_1_252 (1~252), 9=Cx09_1_252 (1~252), 10=Cx0A_1_252 (1~252), 11=Cx0B_1_252 (1~252), 12=Cx0C_1_252 (1~252), 13=Cx0D_1_252 (1~252), 14=Cx0E_1_252 (1~252), 15=Cx0F_1_252 (1~252), 16=Cx10_1_252 (1~252), 17=Cx11_1_252 (1~252), 18=Cx12_1_252 (1~252), 19=Cx13_1_252 (1~252), 20=Cx14_1_252 (1~252), 21=Cx15_1_252 (1~252), 22=Cx16_1_252 (1~252), 23=Cx17_1_252 (1~252), 24=Cx18_1_252 (1~252), 25=Cx19_1_252 (1~252), 26=Cx1A_1_252 (1~252), 27=Cx1B_1_252 (1~252), 28=Cx1C_1_252 (1~252), 29=Cx1D_1_252 (1~252), 30=Cx1E_1_252 (1~252), 31=Cx1F_1_252 (1~252), 32=Cx20_1_252 (1~252), 33=Cx21_1_252 (1~252), 34=Cx22_1_252 (1~252), 35=Cx23_1_252 (1~252), 36=Cx24_1_252 (1~252), 37=Cx25_1_252 (1~252), 38=Cx26_1_252 (1~252), 39=Cx27_1_252 (1~252), 40=Cx28_1_252 (1~252), 41=Cx29_1_252 (1~252), 42=Cx2A_1_252 (1~252), 43=Cx2B_1_252 (1~252), 44=Cx2C_1_252 (1~252), 45=Cx2D_1_252 (1~252), 46=Cx2E_1_252 (1~252), 47=Cx2F_1_252 (1~252), 48=Cx30_1_252 (1~252), 49=Cx31_1_252 (1~252), 50=Cx32_1_252 (1~252), 51=Cx33_1_252 (1~252), 52=Cx34_1_252 (1~252), 53=Cx35_1_252 (1~252), 54=Cx36_1_252 (1~252), 55=Cx37_1_252 (1~252), 56=Cx38_1_252 (1~252), 57=Cx39_1_252 (1~252), 58=Cx3A_1_252 (1~252), 59=Cx3B_1_252 (1~252), 60=Cx3C_1_252 (1~252), 61=Cx3D_1_252 (1~252), 62=Cx3E_1_252 (1~252), 63=Cx3F_1_252 (1~252), 64=Cx40_1_252 (1~252), 65=Cx41_1_252 (1~252), 66=Cx42_1_252 (1~252), 67=Cx43_1_252 (1~252), 68=Cx44_1_252 (1~252), 69=Cx45_1_252 (1~252), 70=Cx46_1_252 (1~252), 71=Cx47_1_252 (1~252), 72=Cx48_1_252 (1~252), 73=Cx49_1_252 (1~252), 74=Cx4A_1_252 (1~252), 75=Cx4B_1_252 (1~252), 76=Cx4C_1_252 (1~252), 77=Cx4D_1_252 (1~252), 78=Cx4E_1_252 (1~252), 79=Cx4F_1_252 (1~252), 80=Cx50_1_252 (1~252), 81=Cx51_1_252 (1~252), 82=Cx52_1_252 (1~252), 83=Cx53_1_252 (1~252), 84=Cx54_1_252 (1~252), 85=Cx55_1_252 (1~252), 86=Cx56_1_252 (1~252), 87=Cx57_1_252 (1~252), 88=Cx58_1_252 (1~252), 89=Cx59_1_252 (1~252), 90=Cx5A_1_252 (1~252), 91=Cx5B_1_252 (1~252), 92=Cx5C_1_252 (1~252), 93=Cx5D_1_252 (1~252), 94=Cx5E_1_252 (1~252), 95=Cx5F_1_252 (1~252), 96=Cx60_1_252 (1~252), 97=Cx61_1_252 (1~252), 98=Cx62_1_252 (1~252), 99=Cx63_1_252 (1~252), 100=Cx64_1_252 (1~252), 101=Cx65_1_252 (1~252), 102=Cx66_1_252 (1~252), 103=Cx67_1_252 (1~252), 104=Cx68_1_252 (1~252), 105=Cx69_1_252 (1~252), 106=Cx6A_1_252 (1~252), 107=Cx6B_1_252 (1~252), 108=Cx6C_1_252 (1~252), 109=Cx6D_1_252 (1~252), 110=Cx6E_1_252 (1~252), 111=Cx6F_1_252 (1~252), 112=Cx70_1_252 (1~252), 113=Cx71_1_252 (1~252), 114=Cx72_1_252 (1~252), 115=Cx73_1_252 (1~252), 116=Cx74_1_252 (1~252), 117=Cx75_1_252 (1~252), 118=Cx76_1_252 (1~252), 119=Cx77_1_252 (1~252), 120=Cx78_1_252 (1~252), 121=Cx79_1_252 (1~252), 122=Cx7A_1_252 (1~252), 123=Cx7B_1_252 (1~252), 124=Cx7C_1_252 (1~252), 125=Cx7D_1_252 (1~252), 126=Cx7E_1_252 (1~252), 127=Cx7F_1_252 (1~252), 128=Cx80_1_252 (1~252), 129=Cx81_1_252 (1~252), 130=Cx82_1_252 (1~252), 131=Cx83_1_252 (1~252), 132=Cx84_1_252 (1~252), 133=Cx85_1_252 (1~252), 134=Cx86_1_252 (1~252), 135=Cx87_1_252 (1~252), 136=Cx88_1_252 (1~252), 137=Cx89_1_252 (1~252), 138=Cx8A_1_252 (1~252), 139=Cx8B_1_252 (1~252), 140=Cx8C_1_252 (1~252), 141=Cx8D_1_252 (1~252), 142=Cx8E_1_252 (1~252), 143=Cx8F_1_252 (1~252), 144=Cx90_1_252 (1~252), 145=Cx91_1_252 (1~252), 146=Cx92_1_252 (1~252), 147=Cx93_1_252 (1~252), 148=Cx94_1_252 (1~252), 149=Cx95_1_252 (1~252), 150=Cx96_1_252 (1~252), 151=Cx97_1_252 (1~252), 152=Cx98_1_252 (1~252), 153=Cx99_1_252 (1~252), 154=Cx9A_1_252 (1~252), 155=Cx9B_1_252 (1~252), 156=Cx9C_1_252 (1~252), 157=Cx9D_1_252 (1~252), 158=Cx9E_1_252 (1~252), 159=Cx9F_1_252 (1~252), 160=CxA0_1_252 (1~252), 161=CxA1_1_252 (1~252), 162=CxA2_1_252 (1~252), 163=CxA3_1_252 (1~252), 164=CxA4_1_252 (1~252), 165=CxA5_1_252 (1~252), 166=CxA6_1_252 (1~252), 167=CxA7_1_252 (1~252), 168=CxA8_1_252 (1~252), 169=CxA9_1_252 (1~252), 170=CxAA_1_252 (1~252), 171=CxAB_1_252 (1~252), 172=CxAC_1_252 (1~252), 173=CxAD_1_252 (1~252), 174=CxAE_1_252 (1~252), 175=CxAF_1_252 (1~252), 176=CxB0_1_252 (1~252), 177=CxB1_1_252 (1~252), 178=CxB2_1_252 (1~252), 179=CxB3_1_252 (1~252), 180=CxB4_1_252 (1~252), 181=CxB5_1_252 (1~252), 182=CxB6_1_252 (1~252), 183=CxB7_1_252 (1~252), 184=CxB8_1_252 (1~252), 185=CxB9_1_252 (1~252), 186=CxBA_1_252 (1~252), 187=CxBB_1_252 (1~252), 188=CxBC_1_252 (1~252), 189=CxBD_1_252 (1~252), 190=CxBE_1_252 (1~252), 191=CxBF_1_252 (1~252), 192=CxC0_1_252 (1~252), 193=CxC1_1_252 (1~252), 194=CxC2_1_252 (1~252), 195=CxC3_1_252 (1~252), 196=CxC4_1_252 (1~252), 197=CxC5_1_252 (1~252), 198=CxC6_1_252 (1~252), 199=CxC7_1_252 (1~252), 200=CxC8_1_252 (1~252), 201=CxC9_1_252 (1~252), 202=CxCA_1_252 (1~252), 203=CxCB_1_252 (1~252), 204=CxCC_1_252 (1~252), 205=CxCD_1_252 (1~252), 206=CxCE_1_252 (1~252), 207=CxCF_1_252 (1~252), 208=CxD0_1_252 (1~252), 209=CxD1_1_252 (1~252), 210=CxD2_1_252 (1~252), 211=CxD3_1_252 (1~252), 212=CxD4_1_252 (1~252), 213=CxD5_1_252 (1~252), 214=CxD6_1_252 (1~252), 215=CxD7_1_252 (1~252), 216=CxD8_1_252 (1~252), 217=CxD9_1_252 (1~252), 218=CxDA_1_252 (1~252), 219=CxDB_1_252 (1~252), 220=CxDC_1_252 (1~252), 221=CxDD_1_252 (1~252), 222=CxDE_1_252 (1~252), 223=CxDF_1_252 (1~252), 224=CxE0_1_252 (1~252), 225=CxE1_1_252 (1~252), 226=CxE2_1_252 (1~252), 227=CxE3_1_252 (1~252), 228=CxE4_1_252 (1~252), 229=CxE5_1_252 (1~252), 230=CxE6_1_252 (1~252), 231=CxE7_1_252 (1~252), 232=CxE8_1_252 (1~252), 233=CxE9_1_252 (1~252), 234=CxEA_1_252 (1~252), 235=CxEB_1_252 (1~252), 236=CxEC_1_252 (1~252), 237=CxED_1_252 (1~252), 238=CxEE_1_252 (1~252), 239=CxEF_1_252 (1~252), 240=CxF0_1_252 (1~252), 241=CxF1_1_252 (1~252), 242=CxF2_1_252 (1~252), 243=CxF3_1_252 (1~252), 244=CxF4_1_252 (1~252), 245=CxF5_1_252 (1~252), 246=CxF6_1_252 (1~252), 247=CxF7_1_252 (1~252), 248=CxF8_1_252 (1~252), 249=CxF9_1_252 (1~252), 250=CxFA_1_252 (1~252), 251=CxFB_1_252 (1~252), 252=CxFC_1_252 (1~252), 253=CxFD_ISLW_SNMD_Unlimited_Speed (Unlimited Speed), 254=CxFE_ISLW_SNMD_Reserved, 255=CxFF_ISLW_SNMD_Invalid}
    ISLW_SpdNaviSubMainDis:
      category=VALUE
      base-type=DataType/uint8
      compu {0=Cx00_ISLW_SNSMD_No_Recognition_Default_ (No Recognition (Default)), 1=Cx01_1_252 (1~252), 2=Cx02_1_252 (1~252), 3=Cx03_1_252 (1~252), 4=Cx04_1_252 (1~252), 5=Cx05_1_252 (1~252), 6=Cx06_1_252 (1~252), 7=Cx07_1_252 (1~252), 8=Cx08_1_252 (1~252), 9=Cx09_1_252 (1~252), 10=Cx0A_1_252 (1~252), 11=Cx0B_1_252 (1~252), 12=Cx0C_1_252 (1~252), 13=Cx0D_1_252 (1~252), 14=Cx0E_1_252 (1~252), 15=Cx0F_1_252 (1~252), 16=Cx10_1_252 (1~252), 17=Cx11_1_252 (1~252), 18=Cx12_1_252 (1~252), 19=Cx13_1_252 (1~252), 20=Cx14_1_252 (1~252), 21=Cx15_1_252 (1~252), 22=Cx16_1_252 (1~252), 23=Cx17_1_252 (1~252), 24=Cx18_1_252 (1~252), 25=Cx19_1_252 (1~252), 26=Cx1A_1_252 (1~252), 27=Cx1B_1_252 (1~252), 28=Cx1C_1_252 (1~252), 29=Cx1D_1_252 (1~252), 30=Cx1E_1_252 (1~252), 31=Cx1F_1_252 (1~252), 32=Cx20_1_252 (1~252), 33=Cx21_1_252 (1~252), 34=Cx22_1_252 (1~252), 35=Cx23_1_252 (1~252), 36=Cx24_1_252 (1~252), 37=Cx25_1_252 (1~252), 38=Cx26_1_252 (1~252), 39=Cx27_1_252 (1~252), 40=Cx28_1_252 (1~252), 41=Cx29_1_252 (1~252), 42=Cx2A_1_252 (1~252), 43=Cx2B_1_252 (1~252), 44=Cx2C_1_252 (1~252), 45=Cx2D_1_252 (1~252), 46=Cx2E_1_252 (1~252), 47=Cx2F_1_252 (1~252), 48=Cx30_1_252 (1~252), 49=Cx31_1_252 (1~252), 50=Cx32_1_252 (1~252), 51=Cx33_1_252 (1~252), 52=Cx34_1_252 (1~252), 53=Cx35_1_252 (1~252), 54=Cx36_1_252 (1~252), 55=Cx37_1_252 (1~252), 56=Cx38_1_252 (1~252), 57=Cx39_1_252 (1~252), 58=Cx3A_1_252 (1~252), 59=Cx3B_1_252 (1~252), 60=Cx3C_1_252 (1~252), 61=Cx3D_1_252 (1~252), 62=Cx3E_1_252 (1~252), 63=Cx3F_1_252 (1~252), 64=Cx40_1_252 (1~252), 65=Cx41_1_252 (1~252), 66=Cx42_1_252 (1~252), 67=Cx43_1_252 (1~252), 68=Cx44_1_252 (1~252), 69=Cx45_1_252 (1~252), 70=Cx46_1_252 (1~252), 71=Cx47_1_252 (1~252), 72=Cx48_1_252 (1~252), 73=Cx49_1_252 (1~252), 74=Cx4A_1_252 (1~252), 75=Cx4B_1_252 (1~252), 76=Cx4C_1_252 (1~252), 77=Cx4D_1_252 (1~252), 78=Cx4E_1_252 (1~252), 79=Cx4F_1_252 (1~252), 80=Cx50_1_252 (1~252), 81=Cx51_1_252 (1~252), 82=Cx52_1_252 (1~252), 83=Cx53_1_252 (1~252), 84=Cx54_1_252 (1~252), 85=Cx55_1_252 (1~252), 86=Cx56_1_252 (1~252), 87=Cx57_1_252 (1~252), 88=Cx58_1_252 (1~252), 89=Cx59_1_252 (1~252), 90=Cx5A_1_252 (1~252), 91=Cx5B_1_252 (1~252), 92=Cx5C_1_252 (1~252), 93=Cx5D_1_252 (1~252), 94=Cx5E_1_252 (1~252), 95=Cx5F_1_252 (1~252), 96=Cx60_1_252 (1~252), 97=Cx61_1_252 (1~252), 98=Cx62_1_252 (1~252), 99=Cx63_1_252 (1~252), 100=Cx64_1_252 (1~252), 101=Cx65_1_252 (1~252), 102=Cx66_1_252 (1~252), 103=Cx67_1_252 (1~252), 104=Cx68_1_252 (1~252), 105=Cx69_1_252 (1~252), 106=Cx6A_1_252 (1~252), 107=Cx6B_1_252 (1~252), 108=Cx6C_1_252 (1~252), 109=Cx6D_1_252 (1~252), 110=Cx6E_1_252 (1~252), 111=Cx6F_1_252 (1~252), 112=Cx70_1_252 (1~252), 113=Cx71_1_252 (1~252), 114=Cx72_1_252 (1~252), 115=Cx73_1_252 (1~252), 116=Cx74_1_252 (1~252), 117=Cx75_1_252 (1~252), 118=Cx76_1_252 (1~252), 119=Cx77_1_252 (1~252), 120=Cx78_1_252 (1~252), 121=Cx79_1_252 (1~252), 122=Cx7A_1_252 (1~252), 123=Cx7B_1_252 (1~252), 124=Cx7C_1_252 (1~252), 125=Cx7D_1_252 (1~252), 126=Cx7E_1_252 (1~252), 127=Cx7F_1_252 (1~252), 128=Cx80_1_252 (1~252), 129=Cx81_1_252 (1~252), 130=Cx82_1_252 (1~252), 131=Cx83_1_252 (1~252), 132=Cx84_1_252 (1~252), 133=Cx85_1_252 (1~252), 134=Cx86_1_252 (1~252), 135=Cx87_1_252 (1~252), 136=Cx88_1_252 (1~252), 137=Cx89_1_252 (1~252), 138=Cx8A_1_252 (1~252), 139=Cx8B_1_252 (1~252), 140=Cx8C_1_252 (1~252), 141=Cx8D_1_252 (1~252), 142=Cx8E_1_252 (1~252), 143=Cx8F_1_252 (1~252), 144=Cx90_1_252 (1~252), 145=Cx91_1_252 (1~252), 146=Cx92_1_252 (1~252), 147=Cx93_1_252 (1~252), 148=Cx94_1_252 (1~252), 149=Cx95_1_252 (1~252), 150=Cx96_1_252 (1~252), 151=Cx97_1_252 (1~252), 152=Cx98_1_252 (1~252), 153=Cx99_1_252 (1~252), 154=Cx9A_1_252 (1~252), 155=Cx9B_1_252 (1~252), 156=Cx9C_1_252 (1~252), 157=Cx9D_1_252 (1~252), 158=Cx9E_1_252 (1~252), 159=Cx9F_1_252 (1~252), 160=CxA0_1_252 (1~252), 161=CxA1_1_252 (1~252), 162=CxA2_1_252 (1~252), 163=CxA3_1_252 (1~252), 164=CxA4_1_252 (1~252), 165=CxA5_1_252 (1~252), 166=CxA6_1_252 (1~252), 167=CxA7_1_252 (1~252), 168=CxA8_1_252 (1~252), 169=CxA9_1_252 (1~252), 170=CxAA_1_252 (1~252), 171=CxAB_1_252 (1~252), 172=CxAC_1_252 (1~252), 173=CxAD_1_252 (1~252), 174=CxAE_1_252 (1~252), 175=CxAF_1_252 (1~252), 176=CxB0_1_252 (1~252), 177=CxB1_1_252 (1~252), 178=CxB2_1_252 (1~252), 179=CxB3_1_252 (1~252), 180=CxB4_1_252 (1~252), 181=CxB5_1_252 (1~252), 182=CxB6_1_252 (1~252), 183=CxB7_1_252 (1~252), 184=CxB8_1_252 (1~252), 185=CxB9_1_252 (1~252), 186=CxBA_1_252 (1~252), 187=CxBB_1_252 (1~252), 188=CxBC_1_252 (1~252), 189=CxBD_1_252 (1~252), 190=CxBE_1_252 (1~252), 191=CxBF_1_252 (1~252), 192=CxC0_1_252 (1~252), 193=CxC1_1_252 (1~252), 194=CxC2_1_252 (1~252), 195=CxC3_1_252 (1~252), 196=CxC4_1_252 (1~252), 197=CxC5_1_252 (1~252), 198=CxC6_1_252 (1~252), 199=CxC7_1_252 (1~252), 200=CxC8_1_252 (1~252), 201=CxC9_1_252 (1~252), 202=CxCA_1_252 (1~252), 203=CxCB_1_252 (1~252), 204=CxCC_1_252 (1~252), 205=CxCD_1_252 (1~252), 206=CxCE_1_252 (1~252), 207=CxCF_1_252 (1~252), 208=CxD0_1_252 (1~252), 209=CxD1_1_252 (1~252), 210=CxD2_1_252 (1~252), 211=CxD3_1_252 (1~252), 212=CxD4_1_252 (1~252), 213=CxD5_1_252 (1~252), 214=CxD6_1_252 (1~252), 215=CxD7_1_252 (1~252), 216=CxD8_1_252 (1~252), 217=CxD9_1_252 (1~252), 218=CxDA_1_252 (1~252), 219=CxDB_1_252 (1~252), 220=CxDC_1_252 (1~252), 221=CxDD_1_252 (1~252), 222=CxDE_1_252 (1~252), 223=CxDF_1_252 (1~252), 224=CxE0_1_252 (1~252), 225=CxE1_1_252 (1~252), 226=CxE2_1_252 (1~252), 227=CxE3_1_252 (1~252), 228=CxE4_1_252 (1~252), 229=CxE5_1_252 (1~252), 230=CxE6_1_252 (1~252), 231=CxE7_1_252 (1~252), 232=CxE8_1_252 (1~252), 233=CxE9_1_252 (1~252), 234=CxEA_1_252 (1~252), 235=CxEB_1_252 (1~252), 236=CxEC_1_252 (1~252), 237=CxED_1_252 (1~252), 238=CxEE_1_252 (1~252), 239=CxEF_1_252 (1~252), 240=CxF0_1_252 (1~252), 241=CxF1_1_252 (1~252), 242=CxF2_1_252 (1~252), 243=CxF3_1_252 (1~252), 244=CxF4_1_252 (1~252), 245=CxF5_1_252 (1~252), 246=CxF6_1_252 (1~252), 247=CxF7_1_252 (1~252), 248=CxF8_1_252 (1~252), 249=CxF9_1_252 (1~252), 250=CxFA_1_252 (1~252), 251=CxFB_1_252 (1~252), 252=CxFC_1_252 (1~252), 253=CxFD_ISLW_SNSMD_Unlimited_Speed (Unlimited Speed), 254=CxFE_ISLW_SNSMD_Reserved, 255=CxFF_ISLW_SNSMD_Invalid}
    ISLW_SubCondinfoSta1:
      category=VALUE
      base-type=DataType/uint8
      compu {0=Cx0_ISLW_SCIS1_None_Default_ (None (Default)), 1=Cx1_ISLW_SCIS1_Rain, 2=Cx2_ISLW_SCIS1_Snow, 3=Cx3_ISLW_SCIS1_Snow_Rain (Snow&Rain), 4=Cx4_ISLW_SCIS1_Trailer, 5=Cx5_ISLW_SCIS1_Reserved, 6=Cx6_ISLW_SCIS1_Reserved, 7=Cx7_ISLW_SCIS1_Reserved, 8=Cx8_ISLW_SCIS1_Reserved, 9=Cx9_ISLW_SCIS1_Reserved, 10=CxA_ISLW_SCIS1_Reserved, 11=CxB_ISLW_SCIS1_Reserved, 12=CxC_ISLW_SCIS1_Reserved, 13=CxD_ISLW_SCIS1_Reserved, 14=CxE_ISLW_SCIS1_Generic, 15=CxF_ISLW_SCIS1_Invalid}
    ISLW_SubCondinfoSta2:
      category=VALUE
      base-type=DataType/uint8
      compu {0=Cx0_ISLW_SCIS2_None_Default_ (None (Default)), 1=Cx1_ISLW_SCIS2_Rain, 2=Cx2_ISLW_SCIS2_Snow, 3=Cx3_ISLW_SCIS2_Snow_Rain (Snow&Rain), 4=Cx4_ISLW_SCIS2_Trailer, 5=Cx5_ISLW_SCIS2_Reserved, 6=Cx6_ISLW_SCIS2_Reserved, 7=Cx7_ISLW_SCIS2_Reserved, 8=Cx8_ISLW_SCIS2_Reserved, 9=Cx9_ISLW_SCIS2_Reserved, 10=CxA_ISLW_SCIS2_Reserved, 11=CxB_ISLW_SCIS2_Reserved, 12=CxC_ISLW_SCIS2_Reserved, 13=CxD_ISLW_SCIS2_Reserved, 14=CxE_ISLW_SCIS2_Generic, 15=CxF_ISLW_SCIS2_Invalid}
    ISLW_SysSta: category=VALUE, base-type=DataType/uint8, compu {0=Cx0_ISLW_SysS_Normal_Default_ (Normal (Default)), 1=Cx1_ISLW_SysS_System_Fail (System Fail), 2=Cx2_ISLW_SysS_Temporary_Unavailable (ISLW Temporary Unavailable), 3=Cx3_ISLW_SysS_Reserved}
    LKA_HndsoffSnd: category=VALUE, base-type=DataType/uint8, compu {0=Cx0_LKA_HndS_Off, 1=Cx1_LKA_HndS_Hands_off_Sound_Warning (Hands-off Sound Warning), 2=Cx2_LKA_HndS_Reserved, 3=Cx3_LKA_HndS_Reserved}
    LKA_LHLnWrnSta: category=VALUE, base-type=DataType/uint8, compu {0=Cx0_LKA_LHLWS_No_Warning (No Warning), 1=Cx1_LKA_LHLWS_Lane_Departure_Warning (Lane Departure Warning), 2=Cx2_LKA_LHLWS_Reserved, 3=Cx3_LKA_LHLWS_Reserved}
    LKA_OptUsmSta: category=VALUE, base-type=DataType/uint8, compu {0=Cx0_LKA_OptUS_None_LKA_LDW_Option_Default_ (None LKA/LDW Option (Default)), 1=Cx1_LKA_OptUS_LDW, 2=Cx2_LKA_OptUS_LKA, 3=Cx3_LKA_OptUS_Reserved, 4=Cx4_LKA_OptUS_LDW_Only_None_LKA_ (LDW Only (None LKA)), 5=Cx5_LKA_OptUS_LDW_only_OFF_None_LKA_ (LDW only OFF (None LKA)), 6=Cx6_LKA_OptUS_LDW_LKA_OFF (LDW/LKA OFF), 7=Cx7_LKA_OptUS_Invalid}
    LKA_RcgSta: category=VALUE, base-type=DataType/uint8, compu {0=Cx0_LKA_RcgS_Not_Recognized (Not Recognized), 1=Cx1_LKA_RcgS_Left_Lane_Recognition (Left Lane Recognition), 2=Cx2_LKA_RcgS_Right_Lane_Recognition (Right Lane Recognition), 3=Cx3_LKA_RcgS_Full_Lane_Recognition (Full Lane Recognition), 4=Cx4_LKA_RcgS_Reserved, 5=Cx5_LKA_RcgS_Reserved, 6=Cx6_LKA_RcgS_Reserved, 7=Cx7_LKA_RcgS_Reserved}
    LKA_RHLnWrnSta: category=VALUE, base-type=DataType/uint8, compu {0=Cx0_LKA_RHLWS_No_Warning (No Warning), 1=Cx1_LKA_RHLWS_Lane_Departure_Warning (Lane Departure Warning), 2=Cx2_LKA_RHLWS_Reserved, 3=Cx3_LKA_RHLWS_Reserved}
    LKA_StrSnd: category=VALUE, base-type=DataType/uint8, compu {0=Cx0_LKA_StrS_Off, 1=Cx1_LKA_StrS_Warning, 2=Cx2_LKA_StrS_Reserved, 3=Cx3_LKA_StrS_Reserved}
    LKA_SysIndReq:
      category=VALUE
      base-type=DataType/uint8
      compu {0=Cx0_LKA_SysIR_Off, 1=Cx1_LKA_SysIR_Unavailable_Grey_On_ (Unavailable_(Grey On)), 2=Cx2_LKA_SysIR_Lane_Recognized_Green_On_ (Lane Recognized_(Green On)), 3=Cx3_LKA_SysIR_Lane_Departure_Green_Blink_ (Lane Departure_(Green Blink)), 4=Cx4_LKA_SysIR_System_Fail_Orange_On_ (System Fail_(Orange On)), 5=Cx5_LKA_SysIR_Not_Calibrated_Orange_Blink_ (Not Calibrated_(Orange Blink)), 6=Cx6_LKA_SysIR_Regulation_Orange_On_ (Regulation_(Orange On)), 7=Cx7_LKA_SysIR_Reserved}
    LKA_SysWrn:
      category=VALUE
      base-type=DataType/uint8
      compu {0=Cx0_LKA_SysW_No_Info (No Info), 1=Cx1_LKA_SysW_Reserved, 2=Cx2_LKA_SysW_Reserved, 3=Cx3_LKA_SysW_Reserved, 4=Cx4_LKA_SysW_Hands_Off_Warning_1 (Hands-Off Warning 1), 5=Cx5_LKA_SysW_Hands_Off_Warning_2 (Hands-Off Warning 2), 6=Cx6_LKA_SysW_Hands_Off_Warning_3 (Hands-Off Warning 3), 7=Cx7_LKA_SysW_Reserved, 8=Cx8_LKA_SysW_Reserved, 9=Cx9_LKA_SysW_System_Automatic_off (System Automatic off), 10=CxA_LKA_SysW_Reserved, 11=CxB_LKA_SysW_Reserved, 12=CxC_LKA_SysW_Reserved, 13=CxD_LKA_SysW_Reserved, 14=CxE_LKA_SysW_Reserved, 15=CxF_LKA_SysW_System_Fail (System Fail)}
    LKA_UsmMod: category=VALUE, base-type=DataType/uint8, compu {0=Cx0_LKA_UsmM_NONE, 1=Cx1_LKA_UsmM_LKA_1_mode (LKA 1 mode), 2=Cx2_LKA_UsmM_Reserved, 3=Cx3_LKA_UsmM_LDW}
package /ComponentTypes/HkmcComponent/HkmcVehicleOutputAdap/PortInterfaces
  9 x sender receiver interface:
    IF_HVOA_ADAS_CMD_10_20ms: invalidation-policy{data-element=DE_HVOA_ADAS_CMD_10_20ms, handle-invalid=DONT-INVALIDATE}
      data DE_HVOA_ADAS_CMD_10_20ms: type=HVOA_ADAS_CMD_10_20ms_T
    IF_HVOA_ADAS_CMD_30_10ms: invalidation-policy{data-element=DE_HVOA_ADAS_CMD_30_10ms, handle-invalid=DONT-INVALIDATE}
      data DE_HVOA_ADAS_CMD_30_10ms: type=HVOA_ADAS_CMD_30_10ms_T
    IF_HVOA_FCA11_FS: invalidation-policy{data-element=DE_HVOA_FCA11_FS, handle-invalid=DONT-INVALIDATE}
      data DE_HVOA_FCA11_FS: type=HVOA_FCA11_FS_T
    IF_HVOA_FCA12: invalidation-policy{data-element=DE_HVOA_FCA12, handle-invalid=DONT-INVALIDATE}
      data DE_HVOA_FCA12: type=HVOA_FCA12_T
    IF_HVOA_FR_CMR_01_10ms: invalidation-policy{data-element=DE_HVOA_FR_CMR_01_10ms, handle-invalid=DONT-INVALIDATE}
      data DE_HVOA_FR_CMR_01_10ms: type=HVOA_FR_CMR_01_10ms_T
    IF_HVOA_FR_CMR_02_100ms: invalidation-policy{data-element=DE_HVOA_FR_CMR_02_100ms, handle-invalid=DONT-INVALIDATE}
      data DE_HVOA_FR_CMR_02_100ms: type=HVOA_FR_CMR_02_100ms_T
    IF_HVOA_LKA11_FS: invalidation-policy{data-element=DE_HVOA_LKA11_FS, handle-invalid=DONT-INVALIDATE}
      data DE_HVOA_LKA11_FS: type=HVOA_LKA11_FS_T
    IF_HVOA_LKA12: invalidation-policy{data-element=DE_HVOA_LKA12, handle-invalid=DONT-INVALIDATE}
      data DE_HVOA_LKA12: type=HVOA_LKA12_T
    IF_HVOA_LKA13: invalidation-policy{data-element=DE_HVOA_LKA13, handle-invalid=DONT-INVALIDATE}
      data DE_HVOA_LKA13: type=HVOA_LKA13_T
