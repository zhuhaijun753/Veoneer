VERSION ""

NS_ :

BS_:

BU_: EMS FR_CMR TCU vBDM AFS ILCU_LH ILCU_RH VCU BMS CLU EPB ESC H_U_MM IBU IBU_HS LDC MCU MDPS OBC RR_C_RDR SVM DATC ADAS_DRV ADAS_PRK AWD RWS AMP APSU DAU DVRS Dummy FCS HUD IAU ICSC ICU MLM PFSU PTGM SBW ACU ADM ECS TPMS HCU OPU PSB eCall AHLS ODS VESS AHV DHV DLBCU DPSS DPSU PSM RLHV RRHV SHVU_FR SHVU_RR DIBOX SAS FPCM SCM AFCU_DRV ESC_C CGW SCU WPC MFSW SWRC ESU AFCU_AST AFCU_RL AFCU_RR APSM ARS BCM BCW CCM DSS ECW FCU FICU GST HFKS HSWS LPI OPI PSD PSU RDC RLPSM RRPSM RWPC SLB SMK YRS SML CTM FR_C_RDR_LH FR_C_RDR_RH RR_C_RDR_LH CLU_MM HUD_MM LSD MKBD MM_CGW SBW_FF eCall_MM H_U_ETH FR_RDR

BO_ 3221225472 VECTOR__INDEPENDENT_SIG_MSG: 0 Vector__XXX
 SG_ New_Signal_693 : 0|8@1+ (1,0) [0|0] "" Vector__XXX
 SG_ USM_SccDrvSetReq : 0|3@1+ (1,0) [0|0] "" Vector__XXX

BO_ 2679898134 MEAS_5: 8 FR_CMR
 SG_ Meas5Data : 0|64@1+ (1,0) [0|1.84467440737096E+019] "" Vector__XXX

BO_ 2679898133 MEAS_4: 8 FR_CMR
 SG_ Meas4Data : 0|64@1+ (1,0) [0|1.84467440737096E+019] "" Vector__XXX

BO_ 2679898132 MEAS_3: 8 FR_CMR
 SG_ Meas3Data : 0|64@1+ (1,0) [0|1.84467440737096E+019] "" Vector__XXX

BO_ 2679898131 MEAS_2: 8 FR_CMR
 SG_ Meas2Data : 0|64@1+ (1,0) [0|1.84467440737096E+019] "" Vector__XXX

BO_ 2679898130 MEAS_1: 8 FR_CMR
 SG_ Meas1Data : 0|64@1+ (1,0) [0|1.84467440737096E+019] "" Vector__XXX

BO_ 453 EMS_11_10ms: 32 CGW
 SG_ HEV_EngSpdErrSta : 24|2@1+ (1,0) [0|3] ""  CLU,FR_CMR
 SG_ EMS_AliveCounter11Value : 16|8@1+ (1,0) [0|255] ""  FR_CMR
 SG_ EMS_CyclicRedundancyCheck11Value : 0|16@1+ (1,0) [0|65535] ""  FR_CMR

BO_ 1729 Xcp_Tx_Pdu: 8 FR_CMR
 SG_ Xcp_Tx_Data : 0|64@1+ (1,0) [0|1.84467440737096E+019] "" Vector__XXX

BO_ 1728 Xcp_Rx_Pdu: 8 Vector__XXX
 SG_ Xcp_Rx_Data : 0|64@1+ (1,0) [0|1.84467440737096E+019] ""  FR_CMR

BO_ 48 EMS_03_10ms: 24 EMS
 SG_ EMS_SCCIsgEna : 40|2@1+ (1,0) [0|3] ""  FR_CMR
 SG_ CF_ECU_SSC_STAT : 38|2@1+ (1,0) [0|3] ""  DATC,RR_C_RDR,FR_CMR
 SG_ DCT_AccelPdlVal : 64|10@1+ (0.09784,1) [1|101.09032] "%"  FR_CMR,TCU,vBDM
 SG_ DCT_EngSpdVal : 80|16@1+ (0.25,0) [0|16383.75] "rpm"  AFS,FR_CMR,ILCU_LH,ILCU_RH,TCU,vBDM
 SG_ DCT_EngSpdErrSta : 120|2@1+ (1,0) [0|3] ""  FR_CMR,TCU,vBDM
 SG_ DCT_CrctEngTqVal : 128|12@1- (1,0) [-2048|2047] "Nm"  FR_CMR,TCU,vBDM

BO_ 53 VCU_01_10ms: 24 VCU
 SG_ VCU_GearSelDis : 35|4@1+ (1,0) [0|0] ""  BMS,CLU,EPB,ESC,FR_CMR,H_U_MM,IBU,IBU_HS,LDC,MCU,MDPS,OBC,RR_C_RDR,SVM,vBDM
 SG_ VCU_AccelPdlDpthPcVal : 56|8@1+ (0.3921568627,0) [0|0] "%"  ESC,FR_CMR,H_U_MM,MCU,vBDM
 SG_ VCU_EVRdySta : 74|2@1+ (1,0) [0|0] ""  BMS,CLU,DATC,EPB,ESC,FR_CMR,H_U_MM,IBU,IBU_HS,LDC,MCU,OBC,vBDM

BO_ 64 TCU_01_10ms: 32 TCU
 SG_ TCU_Crc1Val : 0|16@1+ (1,0) [0|0] ""  ADAS_DRV,ADAS_PRK,AWD,EMS,ESC,FR_CMR,H_U_MM,IBU,RWS,vBDM
 SG_ TCU_AlvCnt1Val : 16|8@1+ (1,0) [0|0] ""  ADAS_DRV,ADAS_PRK,AWD,EMS,ESC,FR_CMR,H_U_MM,IBU,RWS,vBDM
 SG_ TCU_GearSlctDis : 32|4@1+ (1,0) [0|0] ""  ADAS_DRV,ADAS_PRK,AFS,AMP,APSU,AWD,CLU,DATC,DAU,DVRS,Dummy,EMS,EPB,ESC,FCS,FR_CMR,HUD,H_U_MM,IAU,IBU,IBU_HS,ICSC,ICU,MLM,PFSU,PTGM,RR_C_RDR,RWS,SBW,SVM,vBDM
 SG_ TCU_CurrGearSta : 64|4@1+ (1,0) [0|0] ""  ADAS_PRK,AWD,CLU,EMS,ESC,FR_CMR,H_U_MM,ICSC,MDPS,vBDM
 SG_ TCU_TrgtGearSta : 68|4@1+ (1,0) [0|0] ""  ADAS_DRV,AWD,CLU,DATC,EMS,ESC,FCS,FR_CMR,H_U_MM,vBDM
 SG_ TCH_EngTrgtGearSta : 76|4@1+ (1,0) [0|0] ""  EMS,FR_CMR,H_U_MM,vBDM
 SG_ TCU_GearLmpBlnkngReq : 122|2@1+ (1,0) [0|0] ""  ACU,ADAS_PRK,ADM,AFS,BMS,CLU,DATC,ECS,EMS,ESC,FR_CMR,H_U_MM,ICSC,SBW,SVM,TPMS,vBDM
 SG_ TCU_SmrtShftSta : 166|2@1+ (1,0) [0|0] ""  CLU,DATC,EMS,EPB,ESC,FR_CMR,H_U_MM,vBDM

BO_ 69 HTCU_04_10ms: 24 TCU
 SG_ HTCU_GearSlctrDis : 44|4@1+ (1,0) [0|0] ""  AFS,BMS,CLU,EMS,EPB,ESC,FCS,FR_CMR,HCU,H_U_MM,IBU_HS,LDC,MCU,MDPS,OBC,OPU,RR_C_RDR,SVM,TPMS,vBDM

BO_ 74 YRS_01_10ms: 32 ACU
 SG_ YRS_Crc1Val : 0|16@1+ (1,0) [0|0] ""  ADAS_DRV,ADAS_PRK,AWD,ESC,FR_CMR,H_U_MM,MDPS,RWS,vBDM
 SG_ YRS_AlvCnt1Val : 16|8@1+ (1,0) [0|0] ""  ADAS_DRV,ADAS_PRK,AWD,ESC,FR_CMR,H_U_MM,MDPS,RWS
 SG_ YRS_YawSigSta : 24|4@1+ (1,0) [0|0] ""  ADAS_DRV,ADAS_PRK,AWD,ESC,FR_CMR,H_U_MM,MDPS,PSB,RWS,TCU
 SG_ YRS_LatAccelSigSta : 28|4@1+ (1,0) [0|0] ""  ADAS_DRV,AWD,ECS,ESC,FR_CMR,H_U_MM,MDPS,PSB,RWS,TCU
 SG_ YRS_LongAccelSigSta : 32|4@1+ (1,0) [0|0] ""  ADAS_DRV,ADAS_PRK,ESC,FR_CMR,H_U_MM,PSB,RWS,TCU
 SG_ YRS_YawRtVal : 64|16@1+ (0.005,-163.84) [0|0] "Deg/s"  ADAS_DRV,ADAS_PRK,AWD,ESC,FR_CMR,H_U_MM,ICSC,MDPS,PSB,RR_C_RDR,RWS,TCU
 SG_ YRS_LatAccelVal : 80|16@1+ (0.000127465,-4.17677312) [0|0] "g"  ADAS_DRV,AWD,ECS,ESC,FR_CMR,H_U_MM,ICSC,MDPS,PSB,RWS,TCU
 SG_ YRS_LongAccelVal : 96|16@1+ (0.000127465,-4.17677312) [0|0] "g"  ADAS_DRV,ADAS_PRK,ESC,FR_CMR,H_U_MM,PSB,RWS,TCU

BO_ 80 L_ADAS_CMD_30_10ms: 16 FR_CMR
 SG_ ADAS_CMD_30_Crc01Val : 0|16@1+ (1,0) [0|65535] ""  ADAS_DRV
 SG_ ADAS_CMD_30_AlvCnt01Val : 16|8@1+ (1,0) [0|255] ""  ADAS_DRV
 SG_ LKA_OptUsmSta_Copy_1 : 24|3@1+ (1,0) [0|7] ""  ADAS_DRV
 SG_ LKA_RcgSta_Copy_1 : 27|3@1+ (1,0) [0|7] ""  ADAS_DRV
 SG_ LKA_LHLnWrnSta_Copy_1 : 30|2@1+ (1,0) [0|3] ""  ADAS_DRV
 SG_ LKA_RHLnWrnSta_Copy_1 : 32|2@1+ (1,0) [0|3] ""  ADAS_DRV
 SG_ LKA_HndsoffSnd_Copy_1 : 34|2@1+ (1,0) [0|3] ""  ADAS_DRV
 SG_ LKA_StrSnd_Copy_1 : 36|2@1+ (1,0) [0|3] ""  ADAS_DRV
 SG_ LKA_SysIndReq_Copy_1 : 38|3@1+ (1,0) [0|7] ""  ADAS_DRV
 SG_ LKA_StrTqReqVal_Copy_1 : 41|11@1+ (0.0078125,-8) [-8|7.9921875] "Nm"  ADAS_DRV
 SG_ LKA_ActToiSta_Copy_1 : 52|2@1+ (1,0) [0|3] ""  ADAS_DRV
 SG_ LKA_ToiFltSta_Copy_1 : 54|2@1+ (1,0) [0|3] ""  ADAS_DRV
 SG_ LKA_SysWrn_Copy_1 : 60|4@1+ (1,0) [0|15] ""  ADAS_DRV
 SG_ LKA_UsmMod_Copy_1 : 80|2@1+ (1,0) [0|3] ""  ADAS_DRV
 SG_ Info_PedtrnDst_Copy_1 : 84|3@1+ (1,0) [0|7] ""  ADAS_DRV

BO_ 96 ESC_01_10ms: 32 ESC
 SG_ ABS_DfctvSta : 26|2@1+ (1,0) [0|3] ""  ACU,ADAS_PRK,AWD,ECS,EMS,EPB,FR_CMR,H_U_MM,ICSC,TCU,vBDM
 SG_ ABS_ActvSta : 28|2@1+ (1,0) [0|3] ""  ACU,ADAS_DRV,ADAS_PRK,AWD,ECS,EMS,EPB,FR_CMR,HCU,H_U_MM,ICSC,MCU,RR_C_RDR,RWS,TCU,vBDM
 SG_ ABS_DiagSta : 30|2@1+ (1,0) [0|3] ""  ADAS_DRV,AWD,CLU,Dummy,EMS,EPB,FR_CMR,H_U_MM,TCU,vBDM
 SG_ EBD_DfctvSta : 34|2@1+ (1,0) [0|3] ""  ADAS_PRK,AWD,EMS,EPB,FR_CMR,H_U_MM,TCU,vBDM
 SG_ TCS_LmpSta : 40|2@1+ (1,0) [0|3] ""  ADAS_DRV,AWD,CLU,FR_CMR,H_U_MM,ICSC,VCU,vBDM
 SG_ TCS_DisableSta : 64|2@1+ (1,0) [0|3] ""  ADAS_DRV,ADAS_PRK,AWD,CLU,EMS,FR_CMR,H_U_MM,TCU,vBDM
 SG_ TCS_DfctvSta : 66|2@1+ (1,0) [0|3] ""  ADAS_PRK,AWD,EMS,EPB,FR_CMR,H_U_MM,ICSC,TCU,vBDM
 SG_ TCS_CtrlSta : 68|2@1+ (1,0) [0|3] ""  ADAS_DRV,ADAS_PRK,AWD,EMS,EPB,FR_CMR,HCU,H_U_MM,ICSC,MCU,MDPS,RR_C_RDR,TCU,vBDM
 SG_ ESC_DisableSta : 72|2@1+ (1,0) [0|3] ""  ACU,ADAS_DRV,ADAS_PRK,AWD,CLU,EMS,EPB,FR_CMR,HCU,H_U_MM,TCU,vBDM
 SG_ ESC_DfctvSta : 74|2@1+ (1,0) [0|3] ""  ACU,ADAS_PRK,AWD,EMS,EPB,FR_CMR,H_U_MM,ICSC,RR_C_RDR,RWS,TCU,vBDM
 SG_ ESC_CtrlSta : 76|2@1+ (1,0) [0|3] ""  ACU,ADAS_DRV,ADAS_PRK,AWD,EMS,EPB,FR_CMR,HCU,H_U_MM,ICSC,RR_C_RDR,RWS,TCU,vBDM
 SG_ TCS_Req : 96|2@1+ (1,0) [0|3] ""  ADAS_PRK,AWD,EMS,EPB,FR_CMR,HCU,H_U_MM,TCU,vBDM
 SG_ MSR_FuncReq : 98|2@1+ (1,0) [0|3] ""  AWD,EMS,EPB,FR_CMR,HCU,H_U_MM,TCU,vBDM
 SG_ ESC_CylPrsrVal : 128|12@1+ (0.1,0) [0|409.5] "Bar"  ADAS_DRV,ADAS_PRK,AWD,ECS,EMS,EPB,FR_CMR,H_U_MM,ICSC,PSB,RWS,TCU,vBDM
 SG_ ESC_CylPrsrSta : 144|2@1+ (1,0) [0|3] ""  ADAS_DRV,ADAS_PRK,AWD,ECS,EMS,EPB,FR_CMR,H_U_MM,IBU,IBU_HS,ICU,PSB,RWS,TCU,vBDM
 SG_ ESC_CylPrsrDiagSta : 146|2@1+ (1,0) [0|3] ""  ADAS_DRV,AWD,ECS,EMS,EPB,FR_CMR,H_U_MM,PSB,TCU,vBDM
 SG_ ESC_CylPrsrFlagSta : 148|2@1+ (1,0) [0|3] ""  CLU,Dummy,EMS,FR_CMR,H_U_MM,IBU,IBU_HS,ICU,TCU,TPMS,vBDM
 SG_ ESC_VsmActvSta : 152|2@1+ (1,0) [0|3] ""  ADAS_DRV,FR_CMR,H_U_MM,MDPS,vBDM
 SG_ ESC_LongAccelOffstCalibPrmtr : 176|9@1+ (0.001,-0.255) [-0.255|0.256] "g"  ADAS_DRV,ADAS_PRK,EMS,FR_CMR,RR_C_RDR,RWS,TCU,vBDM
 SG_ AVH_Sta : 192|2@1+ (1,0) [0|3] ""  EMS,EPB,FR_CMR,HCU,H_U_MM,MCU,TCU,VCU,vBDM

BO_ 106 TCU_02_10ms: 32 TCU
 SG_ TCU_Crc2Val : 0|16@1+ (1,0) [0|0] ""  ADAS_PRK,AWD,EMS,ESC,FR_CMR,H_U_MM,vBDM
 SG_ TCU_AlvCnt2Val : 16|8@1+ (1,0) [0|0] ""  ADAS_PRK,AWD,EMS,ESC,FR_CMR,H_U_MM,vBDM
 SG_ TCU_AtTempCVal : 40|8@1+ (1,-40) [0|0] "Deg C"  CLU,EMS,ESC,FR_CMR,H_U_MM,vBDM
 SG_ TCU_TqCnvrtrSpdVal : 48|16@1+ (0.25,0) [0|0] "rpm"  AWD,EMS,EPB,ESC,FR_CMR,H_U_MM,ICSC,TPMS,vBDM

BO_ 160 WHL_01_10ms: 24 ESC
 SG_ WHL_PlsFLVal : 24|8@1+ (0.5,0) [0|127.5] "pulse count"  ADAS_PRK,EPB,FR_CMR,H_U_MM,IBU,RR_C_RDR,TPMS,eCall,vBDM
 SG_ WHL_PlsFRVal : 32|8@1+ (0.5,0) [0|127.5] "pulse count"  ADAS_PRK,EPB,FR_CMR,H_U_MM,IBU,RR_C_RDR,TPMS,eCall,vBDM
 SG_ WHL_PlsRLVal : 40|8@1+ (0.5,0) [0|127.5] "pulse count"  ADAS_PRK,EPB,FR_CMR,H_U_MM,IBU,RR_C_RDR,TPMS,eCall,vBDM
 SG_ WHL_PlsRRVal : 48|8@1+ (0.5,0) [0|127.5] "pulse count"  ADAS_PRK,EPB,FR_CMR,H_U_MM,IBU,RR_C_RDR,TPMS,eCall,vBDM
 SG_ WHL_DirFLVal : 56|2@1+ (1,0) [0|3] ""  ADAS_DRV,ADAS_PRK,EPB,FR_CMR,H_U_MM,IBU,TPMS,vBDM
 SG_ WHL_DirFRVal : 58|2@1+ (1,0) [0|3] ""  ADAS_DRV,ADAS_PRK,EPB,FR_CMR,H_U_MM,IBU,TPMS,vBDM
 SG_ WHL_DirRLVal : 60|2@1+ (1,0) [0|3] ""  ADAS_DRV,ADAS_PRK,EPB,FR_CMR,H_U_MM,IBU,TPMS,vBDM
 SG_ WHL_DirRRVal : 62|2@1+ (1,0) [0|3] ""  ADAS_DRV,ADAS_PRK,EPB,FR_CMR,H_U_MM,IBU,TPMS,vBDM
 SG_ WHL_SpdFLVal : 64|14@1+ (0.03125,0) [0|511.96875] "km^h"  ACU,ADAS_DRV,ADAS_PRK,AFS,AHLS,AWD,BMS,CLU,DATC,ECS,EMS,EPB,FR_CMR,HCU,H_U_MM,IBU,ILCU_LH,ILCU_RH,MCU,MDPS,ODS,OPU,PSB,RR_C_RDR,RWS,SBW,SVM,TCU,TPMS,VCU,VESS,vBDM
 SG_ WHL_SpdFRVal : 80|14@1+ (0.03125,0) [0|511.96875] "km^h"  ACU,ADAS_DRV,ADAS_PRK,AFS,AHLS,AWD,BMS,CLU,DATC,ECS,EMS,EPB,FR_CMR,HCU,H_U_MM,IBU,ILCU_LH,ILCU_RH,MCU,MDPS,ODS,OPU,PSB,RR_C_RDR,RWS,SVM,TCU,TPMS,VCU,VESS,vBDM
 SG_ WHL_SpdRLVal : 96|14@1+ (0.03125,0) [0|511.96875] "km^h"  ACU,ADAS_DRV,ADAS_PRK,AFS,AHLS,AWD,BMS,CLU,DATC,ECS,EMS,EPB,FR_CMR,HCU,H_U_MM,IBU,ILCU_LH,ILCU_RH,MCU,MDPS,OBC,ODS,OPU,PSB,RR_C_RDR,RWS,SVM,TCU,TPMS,VCU,VESS,vBDM
 SG_ WHL_SpdRRVal : 112|14@1+ (0.03125,0) [0|511.96875] "km^h"  ACU,ADAS_DRV,ADAS_PRK,AFS,AHLS,AWD,BMS,CLU,DATC,ECS,EMS,EPB,FR_CMR,HCU,H_U_MM,IBU,ILCU_LH,ILCU_RH,MCU,MDPS,OBC,ODS,OPU,PSB,RR_C_RDR,RWS,SVM,TCU,TPMS,VCU,VESS,vBDM

BO_ 181 EMS_01_10ms: 32 EMS
 SG_ ENG_EngSpdErrSta : 96|2@1+ (1,0) [0|3] ""  ACU,ADAS_DRV,AFS,AWD,CLU,DATC,ECS,EPB,ESC,FR_CMR,H_U_MM,ILCU_LH,ILCU_RH,TCU,vBDM
 SG_ ENG_IsgSta : 123|3@1+ (1,0) [0|7] ""  ADAS_DRV,AFS,AHV,AMP,APSU,AWD,CLU,DATC,DHV,DLBCU,DPSS,DPSU,EPB,ESC,FR_CMR,H_U_MM,IAU,IBU,IBU_HS,ICU,ILCU_LH,ILCU_RH,MDPS,PSM,RLHV,RRHV,SHVU_FR,SHVU_RR,SVM,TCU,vBDM
 SG_ ENG_IgnOnSta : 162|2@1+ (1,0) [0|3] ""  ACU,AHLS,AWD,DIBOX,ECS,EPB,ESC,FR_CMR,H_U_MM,ILCU_LH,ILCU_RH,SAS,TCU,vBDM
 SG_ ENG_EngSpdVal : 176|16@1+ (0.25,0) [0|16383.75] "rpm"  ACU,ADAS_DRV,ADAS_PRK,AFS,AMP,AWD,CLU,DATC,ECS,EPB,ESC,FPCM,FR_CMR,H_U_MM,ICSC,ILCU_LH,ILCU_RH,TCU,vBDM
 SG_ ENG_VehSpdHiVal : 224|9@1+ (1,0) [0|511] "km/h"  ACU,ADAS_PRK,ADM,AFS,AHLS,AMP,AWD,CLU,DATC,ECS,FPCM,FR_CMR,H_U_MM,IBU,IBU_HS,MDPS,RR_C_RDR,RWS,SBW,SVM,TCU,TPMS,vBDM

BO_ 186 HCU_01_10ms: 24 HCU
 SG_ HCU_HevRdySta : 68|2@1+ (1,0) [0|0] ""  AFS,BMS,CLU,DATC,EMS,EPB,ESC,FR_CMR,H_U_MM,IBU_HS,ICU,LDC,MCU,MDPS,OBC,OPU,RR_C_RDR,TCU,VESS
 SG_ HCU_SccEnblSta : 162|2@1+ (1,0) [0|0] ""  ESC,FR_CMR,H_U_MM

BO_ 229 ESC_02_10ms: 32 ESC
 SG_ ESC_YawSigSta : 24|4@1+ (1,0) [0|15] ""  ADAS_DRV,AWD,FR_CMR,H_U_MM,MDPS,PSB,TCU,vBDM
 SG_ ESC_LatAccelSigSta : 28|4@1+ (1,0) [0|15] ""  ADAS_DRV,AWD,ECS,FR_CMR,H_U_MM,MDPS,PSB,TCU,vBDM
 SG_ ESC_LongAccelSigSta : 32|4@1+ (1,0) [0|15] ""  ADAS_DRV,ADAS_PRK,FR_CMR,H_U_MM,PSB,TCU,vBDM
 SG_ ESC_YawRtVal : 64|16@1+ (0.005,-163.84) [-163.84|163.835] "Deg/s"  ADAS_DRV,AWD,FR_CMR,H_U_MM,ICSC,MDPS,PSB,RR_C_RDR,TCU,vBDM
 SG_ ESC_LatAccelVal : 80|16@1+ (0.000127465,-4.17677312) [-4.17677312|4.176645655] "g"  ADAS_DRV,AWD,ECS,FR_CMR,H_U_MM,ICSC,MDPS,PSB,TCU,vBDM
 SG_ ESC_LongAccelVal : 96|16@1+ (0.000127465,-4.17677312) [-4.17677312|4.176645655] "g"  ADAS_DRV,ADAS_PRK,FR_CMR,H_U_MM,PSB,TCU,vBDM

BO_ 234 MDPS_01_10ms: 24 MDPS
 SG_ MDPS_Crc1Val : 0|16@1+ (1,0) [0|0] ""  ADAS_DRV,ADAS_PRK,Dummy,ESC,FR_CMR,ICSC,RWS,vBDM
 SG_ MDPS_AlvCnt1Val : 16|8@1+ (1,0) [0|0] ""  ADAS_DRV,ADAS_PRK,ESC,FR_CMR,H_U_MM,ICSC,RWS,vBDM
 SG_ MDPS_Typ : 27|3@1+ (1,0) [0|0] ""  ADAS_DRV,ADAS_PRK,FR_CMR,H_U_MM,vBDM
 SG_ MDPS_PaModeSta : 40|4@1+ (1,0) [0|0] ""  ADAS_DRV,ADAS_PRK,FR_CMR,H_U_MM,vBDM
 SG_ MDPS_LkaPlgInSta : 46|2@1+ (1,0) [0|0] ""  FR_CMR,H_U_MM,ICSC,vBDM
 SG_ MDPS_LkaToiActvSta : 48|2@1+ (1,0) [0|0] ""  ADAS_DRV,FR_CMR,H_U_MM,vBDM
 SG_ MDPS_LkaToiUnblSta : 50|2@1+ (1,0) [0|0] ""  ADAS_DRV,FR_CMR,H_U_MM,vBDM
 SG_ MDPS_LkaToiFltSta : 52|2@1+ (1,0) [0|0] ""  ADAS_DRV,FR_CMR,H_U_MM,vBDM
 SG_ MDPS_LkaFailSta : 54|2@1+ (1,0) [0|0] ""  ADAS_DRV,FR_CMR,H_U_MM,vBDM
 SG_ MDPS_FlxStrSta : 56|3@1+ (1,0) [0|0] ""  CLU,FR_CMR,H_U_MM,vBDM
 SG_ MDPS_CurrModVal : 61|3@1+ (1,0) [0|0] ""  FR_CMR,H_U_MM,vBDM
 SG_ MDPS_OutTqVal : 64|12@1+ (0.1,-204.8) [0|0] "Nm"  ADAS_DRV,ADAS_PRK,ESC,FR_CMR,H_U_MM,ICSC,RR_C_RDR,vBDM
 SG_ MDPS_StrTqSnsrVal : 80|13@1+ (0.005,-20.48) [0|0] "Nm"  ADAS_DRV,ADAS_PRK,AFS,ESC,FR_CMR,H_U_MM,ICSC,RR_C_RDR,vBDM

BO_ 250 HCU_03_10ms: 24 HCU
 SG_ HCU_EstAccelPdlPcVal : 24|8@1+ (0.3906,0) [0|0] "%"  EMS,ESC,FR_CMR,TCU

BO_ 256 EMS_02_10ms: 32 EMS
 SG_ EMS_Crc2Val : 0|16@1+ (1,0) [0|65535] ""  ADAS_PRK,AWD,Dummy,ESC,FR_CMR,IBU,MDPS,RWS,vBDM
 SG_ EMS_AlvCnt2Val : 16|8@1+ (1,0) [0|255] ""  ADAS_PRK,AWD,Dummy,ESC,FR_CMR,IBU,MDPS,RWS,vBDM
 SG_ ENG_BrkSwSta : 32|2@1+ (1,0) [0|3] ""  ACU,ADAS_DRV,ADAS_PRK,AFS,AWD,CLU,DATC,ECS,EPB,ESC,FR_CMR,H_U_MM,ICSC,ILCU_LH,ILCU_RH,RR_C_RDR,TCU,vBDM
 SG_ ENG_EngSta : 61|3@1+ (1,0) [0|7] ""  ADAS_DRV,ADAS_PRK,AFS,AHLS,AHV,AMP,APSU,AWD,CLU,DHV,DLBCU,DPSS,DPSU,ECS,EPB,ESC,FPCM,FR_CMR,H_U_MM,IBU,IBU_HS,ICSC,ICU,ILCU_LH,ILCU_RH,MDPS,PFSU,PSM,RLHV,RRHV,RR_C_RDR,RWS,SBW,SCM,SHVU_FR,SHVU_RR,SVM,TCU,vBDM
 SG_ ENG_AccActSta : 68|2@1+ (1,0) [0|3] ""  ADAS_DRV,AWD,CLU,ESC,FR_CMR,H_U_MM,ICSC,TCU,vBDM
 SG_ ENG_CltchOpSta : 70|2@1+ (1,0) [0|3] ""  AWD,EPB,ESC,FR_CMR,H_U_MM,ICSC,vBDM
 SG_ ENG_AccelPdlVal : 88|10@1+ (0.09784,0) [0|100.09032] "%"  ACU,ADAS_DRV,ADAS_PRK,AFS,AMP,AWD,CLU,DATC,ECS,EPB,ESC,FPCM,FR_CMR,H_U_MM,ICSC,ILCU_LH,ILCU_RH,MDPS,TCU,vBDM
 SG_ ENG_AppAccelPdlSta : 176|2@1+ (1,0) [0|3] ""  ADAS_DRV,FR_CMR,H_U_MM,vBDM

BO_ 261 EMS_07_10ms: 32 EMS
 SG_ HEV_EngSpdVal : 76|16@1+ (0.25,0) [0|16383.75] "rpm"  AFS,BMS,CLU,DATC,EPB,ESC,FPCM,FR_CMR,HCU,H_U_MM,IBU,ILCU_LH,ILCU_RH,MCU,MDPS,OBC,OPU,TCU
 SG_ HEV_AccelPdlVal : 103|10@1+ (0.3906,0) [0|399.5838] "%"  ACU,BMS,EPB,ESC,FPCM,FR_CMR,HCU,H_U_MM,LDC,MCU,OBC,TCU

BO_ 266 MCU_01_10ms: 32 MCU
 SG_ MCU_VehSpdKphVal : 224|8@1+ (1,0) [0|0] ""  BMS,DATC,FR_CMR,IBU,IBU_HS,LDC,MDPS,OBC,VCU

BO_ 282 FR_CMR_01_10ms: 16 FR_CMR
 SG_ FR_CMR_Crc1Val : 0|16@1+ (1,0) [0|0] ""  Dummy,IBU_HS,vBDM
 SG_ FR_CMR_AlvCnt1Val : 16|8@1+ (1,0) [0|0] ""  CLU,IBU_HS,vBDM
 SG_ HBA_SysOptSta : 24|2@1+ (1,0) [0|3] ""  CLU,IBU_HS,vBDM
 SG_ HBA_SysSta : 26|3@1+ (1,0) [0|7] ""  CLU,IBU_HS,vBDM
 SG_ HBA_IndLmpReq : 29|2@1+ (1,0) [0|3] ""  CLU,vBDM
 SG_ iHBAref_VehLftSta : 31|2@1+ (1,0) [0|3] ""  IBU_HS,ICU,vBDM
 SG_ iHBAref_VehCtrSta : 33|2@1+ (1,0) [0|3] ""  IBU_HS,ICU,vBDM
 SG_ iHBAref_VehRtSta : 35|2@1+ (1,0) [0|3] ""  IBU_HS,ICU,vBDM
 SG_ iHBAref_ILLAmbtSta : 37|2@1+ (1,0) [0|3] ""  IBU_HS,ICU,vBDM
 SG_ FCA_Equip_MFC : 39|3@1+ (1,0) [0|0] ""  ADAS_DRV,RR_C_RDR,vBDM
 SG_ HBA_OptUsmSta : 42|2@1+ (1,0) [0|3] ""  CLU,H_U_MM
 SG_ FCAref_FusSta : 45|3@1+ (1,0) [0|0] ""  vBDM
 SG_ DAW_LVDA_PUDis : 48|2@1+ (1,0) [0|0] ""  CLU,vBDM
 SG_ DAW_LVDA_OptUsmSta : 50|2@1+ (1,0) [0|3] ""  CLU,H_U_MM,vBDM
 SG_ DAW_OptUsmSta : 52|3@1+ (1,0) [0|0] ""  CLU,H_U_MM
 SG_ DAW_SysSta : 55|4@1+ (1,0) [0|0] ""  CLU
 SG_ DAW_WrnMsgSta : 59|3@1+ (1,0) [0|0] ""  CLU
 SG_ DAW_TimeRstReq : 62|2@1+ (1,0) [0|0] ""  CLU
 SG_ DAW_SnstvtyModRetVal : 64|3@1+ (1,0) [0|0] ""  CLU,H_U_MM

BO_ 288 MCU_02_10ms: 32 MCU
 SG_ GCU_VehSpdKphVal : 224|8@1+ (1,0) [0|0] ""  BMS,DATC,FR_CMR,IBU,IBU_HS,LDC,MDPS,OBC,VCU

BO_ 293 SAS_01_10ms: 16 SAS
 SG_ SAS_Crc1Val : 0|16@1+ (1,0) [0|65535] ""  ADAS_DRV,ADAS_PRK,AFCU_DRV,AFS,ECS,ESC,FR_CMR,H_U_MM,MDPS,PSB,RWS,vBDM
 SG_ SAS_AlvCnt1Val : 16|8@1+ (1,0) [0|255] ""  ADAS_DRV,ADAS_PRK,AFS,ECS,ESC,FR_CMR,H_U_MM,MDPS,PSB,RWS,vBDM
 SG_ SAS_AnglVal : 24|16@1- (0.1,0) [-3276.8|3276.7] "Deg"  ACU,ADAS_DRV,ADAS_PRK,AFS,AWD,CLU,ECS,EMS,ESC,FR_CMR,H_U_MM,IBU_HS,ICSC,MDPS,PSB,RR_C_RDR,RWS,SVM,TCU,vBDM
 SG_ SAS_SpdVal : 40|8@1+ (4,0) [0|1020] "Deg/s"  ADAS_DRV,ADAS_PRK,AFS,Dummy,ECS,ESC,FR_CMR,H_U_MM,ICSC,MDPS,RWS,TCU,vBDM
 SG_ SAS_IntSta : 48|8@1+ (1,0) [0|255] ""  ADAS_DRV,ADAS_PRK,AFS,AWD,Dummy,ECS,EMS,ESC,FR_CMR,H_U_MM,MDPS,PSB,RWS,TCU,vBDM

BO_ 314 FR_CMR_05_00ms: 32 FR_CMR
 SG_ FR_CMR_Crc5Val : 0|16@1+ (1,0) [0|0] ""  ECS
 SG_ FR_CMR_AlvCnt5Val : 16|8@1+ (1,0) [0|0] ""  ECS
 SG_ Info_DistL : 24|8@1+ (0.0625,0) [0|0] "m"  ECS
 SG_ Info_HeightL : 32|9@1+ (0.625,-160) [0|0] "mm"  ECS
 SG_ Info_LengthL : 41|7@1+ (0.0625,0) [0|0] "m"  ECS
 SG_ Info_TypeL : 48|2@1+ (1,0) [0|0] ""  ECS
 SG_ Info_ConfL : 50|4@1+ (1,0) [0|0] ""  ECS
 SG_ Info_CyclicCounterL : 54|2@1+ (1,0) [0|0] ""  ECS
 SG_ Info_VariL : 56|7@1+ (1,0) [0|0] ""  ECS
 SG_ Info_DistR : 64|8@1+ (0.0625,0) [0|0] "m"  ECS
 SG_ Info_HeightR : 72|9@1+ (0.625,-160) [0|0] "mm"  ECS
 SG_ Info_LengthR : 81|7@1+ (0.0625,0) [0|0] "m"  ECS
 SG_ Info_TypeR : 88|2@1+ (1,0) [0|0] ""  ECS
 SG_ Info_ConfR : 90|4@1+ (1,0) [0|0] ""  ECS
 SG_ Info_CyclicCounterR : 94|2@1+ (1,0) [0|0] ""  ECS
 SG_ Info_VariR : 96|7@1+ (1,0) [0|0] ""  ECS
 SG_ Info_RdProfSts : 103|2@1+ (1,0) [0|0] ""  ECS

BO_ 352 ADAS_CMD_10_20ms: 16 FR_CMR
 SG_ FCA_WrngSndSta : 61|3@1+ (1,0) [0|7] ""  CLU,CGW
 SG_ ADAS_CMD_Crc10Val : 0|16@1+ (1,0) [0|65535] ""  ESC_C,CGW
 SG_ ADAS_CMD_AlvCnt10Val : 16|8@1+ (1,0) [0|255] ""  ESC_C,CGW
 SG_ FCA_OnOffEquipSta : 24|3@1+ (1,0) [0|7] ""  ACU,ESC_C,CGW
 SG_ FCA_SysFlrSta : 27|3@1+ (1,0) [0|7] ""  ACU,ESC_C,CGW
 SG_ FCA_WrngLvlSta : 30|2@1+ (1,0) [0|3] ""  ACU,ESC_C,CGW
 SG_ FCA_VehStpReq : 32|2@1+ (1,0) [0|3] ""  ESC_C,CGW
 SG_ FCA_StbltActvReq : 34|3@1+ (1,0) [0|7] ""  ESC_C,CGW
 SG_ FCA_HydrlcBstAsstReq : 37|2@1+ (1,0) [0|3] ""  ESC_C,CGW
 SG_ FCA_DclReqVal : 40|8@1+ (0.01,0) [0|2.55] "g"  ESC_C,CGW
 SG_ FCA_PrefillActvReq : 48|2@1+ (1,0) [0|3] ""  ESC_C,CGW
 SG_ FCA_PartialActvReq : 50|2@1+ (1,0) [0|3] ""  ESC_C,CGW
 SG_ FCA_FullActvReq : 52|2@1+ (1,0) [0|3] ""  ESC_C,CGW
 SG_ FCA_SnstvtyModRetVal : 56|3@1+ (1,0) [0|7] ""  ESC_C,CGW
 SG_ FCA_RelVel : 64|9@1+ (0.1,0) [0|51.1] "m/s"  ACU,CGW
 SG_ FCA_TimetoCllsn : 73|8@1+ (10,0) [0|2550] "ms"  ACU,CGW
 SG_ FCA_Jnctn_OnOffEquipSta : 83|2@1+ (1,0) [0|3] ""  ACU,ESC_C,CGW
 SG_ FCA_WrngTrgtDis : 88|5@1+ (1,0) [0|31] ""  CGW

BO_ 362 ADAS_PRK_21_20ms: 32 ADAS_PRK
 SG_ RSPA_Sta : 120|4@1+ (1,0) [0|0] ""  ADAS_DRV,EMS,ESC,FR_CMR,RWS,SCU,TCU,vBDM

BO_ 373 ESC_03_20ms: 24 ESC
 SG_ ESC_Crc3Val : 0|16@1+ (1,0) [0|65535] ""  ADAS_PRK,AWD,Dummy,FR_CMR,vBDM
 SG_ ESC_AlvCnt3Val : 16|8@1+ (1,0) [0|255] ""  ADAS_PRK,AWD,Dummy,FR_CMR,vBDM
 SG_ ESC_VehAccelVal : 32|11@1+ (0.01,-10.23) [-10.23|10.24] "m/s^2"  AWD,Dummy,EMS,FR_CMR,H_U_MM,TCU,vBDM
 SG_ ESC_AccelBasisVal : 48|11@1+ (0.01,-10.23) [-10.23|10.24] "m/s^2"  AWD,Dummy,EMS,FR_CMR,H_U_MM,TCU,vBDM
 SG_ SCC_OptTyp : 64|2@1+ (1,0) [0|0] ""  AWD,EMS,FR_CMR,HCU,H_U_MM,TCU,VCU,vBDM
 SG_ SCC_EnblReq : 66|2@1+ (1,0) [0|0] ""  AWD,Dummy,EMS,FR_CMR,H_U_MM,TCU,vBDM
 SG_ SCC_TqReq : 68|2@1+ (1,0) [0|0] ""  AWD,Dummy,EMS,FR_CMR,HCU,H_U_MM,TCU,VCU,vBDM
 SG_ SCC_ReqLimSta : 70|2@1+ (1,0) [0|0] ""  ADAS_DRV,AWD,Dummy,EMS,FR_CMR,H_U_MM,TCU,vBDM
 SG_ ESC_StdStillVal : 72|2@1+ (1,0) [0|3] ""  ADAS_DRV,AWD,Dummy,EMS,FR_CMR,H_U_MM,TCU,vBDM
 SG_ ESC_BrkLtReq : 74|2@1+ (1,0) [0|3] ""  ADAS_DRV,AWD,CLU,Dummy,EMS,FR_CMR,H_U_MM,TCU,vBDM
 SG_ ESC_DclEnblReq : 76|2@1+ (1,0) [0|3] ""  AWD,Dummy,EMS,FR_CMR,H_U_MM,TCU,vBDM
 SG_ ESC_DrvOvrdSta : 80|2@1+ (1,0) [0|3] ""  ADAS_DRV,ADAS_PRK,AWD,Dummy,EMS,FR_CMR,H_U_MM,TCU,vBDM
 SG_ ESC_DrvBrkSta : 82|2@1+ (1,0) [0|3] ""  Dummy,FR_CMR,H_U_MM,vBDM
 SG_ ESC_DrvBrkActvSta : 84|2@1+ (1,0) [0|3] ""  ADAS_DRV,ADAS_PRK,AFS,AWD,Dummy,EMS,FR_CMR,H_U_MM,ICSC,TCU,vBDM
 SG_ ESC_PrkBrkActvSta : 86|2@1+ (1,0) [0|3] ""  ADAS_DRV,AWD,Dummy,EMS,FR_CMR,H_U_MM,RR_C_RDR,TCU,vBDM
 SG_ FCA_EquipSta : 96|2@1+ (1,0) [0|3] ""  ADAS_DRV,FR_CMR,H_U_MM,vBDM
 SG_ FCA_AvlblSta : 98|2@1+ (1,0) [0|3] ""  ADAS_DRV,AFCU_DRV,CLU,Dummy,FR_CMR,H_U_MM,vBDM

BO_ 384 L_FR_CMR_Obj_01_30ms: 32 FR_CMR
 SG_ FR_CMR_Obj_Crc01Val : 0|16@1+ (1,0) [0|65535] ""  ADAS_DRV
 SG_ FR_CMR_Obj_AlvCnt01Val : 16|8@1+ (1,0) [0|255] ""  ADAS_DRV
 SG_ FR_CMR_Obj_QualLvl01Sta : 24|7@1+ (1,0) [0|100] "%"  ADAS_DRV
 SG_ FR_CMR_Obj_AlvAge01Val : 32|8@1+ (1,0) [0|255] ""  ADAS_DRV
 SG_ FR_CMR_Obj_MvngFlag01Sta : 40|4@1+ (1,0) [0|9] ""  ADAS_DRV
 SG_ FR_CMR_Obj_Id01Val : 44|7@1+ (1,0) [0|127] ""  ADAS_DRV
 SG_ FR_CMR_Obj_Wth01Val : 52|7@1+ (0.05,0) [0|6.35] "m"  ADAS_DRV
 SG_ FR_CMR_Obj_Clfct01Sta : 60|3@1+ (1,0) [0|6] ""  ADAS_DRV
 SG_ FR_CMR_Obj_RelPosX01Val : 64|13@1+ (0.05,0) [0|350] "m"  ADAS_DRV
 SG_ FR_CMR_Obj_RelPosY01Val : 78|12@1+ (0.05,-102.4) [-102.4|102.35] "m"  ADAS_DRV
 SG_ FR_CMR_Obj_RelVelX01Val : 91|12@1+ (0.05,-100) [-100|100] "m/s"  ADAS_DRV
 SG_ FR_CMR_Obj_RelVelY01Val : 104|10@1+ (0.05,-25) [-25|25] "m/s"  ADAS_DRV
 SG_ FR_CMR_Obj_RelAccelX01Val : 115|9@1- (0.05,0) [-12.8|12.75] "m/s^2"  ADAS_DRV
 SG_ FR_CMR_Obj_QualLvl02Sta : 152|7@1+ (1,0) [0|100] "%"  ADAS_DRV
 SG_ FR_CMR_Obj_AlvAge02Val : 160|8@1+ (1,0) [0|255] ""  ADAS_DRV
 SG_ FR_CMR_Obj_MvngFlag02Sta : 168|4@1+ (1,0) [0|9] ""  ADAS_DRV
 SG_ FR_CMR_Obj_Id02Val : 172|7@1+ (1,0) [0|127] ""  ADAS_DRV
 SG_ FR_CMR_Obj_Wth02Val : 180|7@1+ (0.05,0) [0|6.35] "m"  ADAS_DRV
 SG_ FR_CMR_Obj_Clfct02Sta : 188|3@1+ (1,0) [0|6] ""  ADAS_DRV
 SG_ FR_CMR_Obj_RelPosX02Val : 192|13@1+ (0.05,0) [0|350] "m"  ADAS_DRV
 SG_ FR_CMR_Obj_RelPosY02Val : 206|12@1+ (0.05,-102.4) [-102.4|102.35] "m"  ADAS_DRV
 SG_ FR_CMR_Obj_RelVelX02Val : 219|12@1+ (0.05,-100) [-100|100] "m/s"  ADAS_DRV
 SG_ FR_CMR_Obj_RelVelY02Val : 232|10@1+ (0.05,-25) [-25|25] "m/s"  ADAS_DRV
 SG_ FR_CMR_Obj_RelAccelX02Val : 243|9@1- (0.05,0) [-12.8|12.75] "m/s^2"  ADAS_DRV

BO_ 385 L_FR_CMR_Obj_02_30ms: 32 FR_CMR
 SG_ FR_CMR_Obj_Crc02Val : 0|16@1+ (1,0) [0|65535] ""  ADAS_DRV
 SG_ FR_CMR_Obj_AlvCnt02Val : 16|8@1+ (1,0) [0|255] ""  ADAS_DRV
 SG_ FR_CMR_Obj_QualLvl03Sta : 24|7@1+ (1,0) [0|100] "%"  ADAS_DRV
 SG_ FR_CMR_Obj_AlvAge03Val : 32|8@1+ (1,0) [0|255] ""  ADAS_DRV
 SG_ FR_CMR_Obj_MvngFlag03Sta : 40|4@1+ (1,0) [0|9] ""  ADAS_DRV
 SG_ FR_CMR_Obj_Id03Val : 44|7@1+ (1,0) [0|127] ""  ADAS_DRV
 SG_ FR_CMR_Obj_Wth03Val : 52|7@1+ (0.05,0) [0|6.35] "m"  ADAS_DRV
 SG_ FR_CMR_Obj_Clfct03Sta : 60|3@1+ (1,0) [0|6] ""  ADAS_DRV
 SG_ FR_CMR_Obj_RelPosX03Val : 64|13@1+ (0.05,0) [0|350] "m"  ADAS_DRV
 SG_ FR_CMR_Obj_RelPosY03Val : 78|12@1+ (0.05,-102.4) [-102.4|102.35] "m"  ADAS_DRV
 SG_ FR_CMR_Obj_RelVelX03Val : 91|12@1+ (0.05,-100) [-100|100] "m/s"  ADAS_DRV
 SG_ FR_CMR_Obj_RelVelY03Val : 104|10@1+ (0.05,-25) [-25|25] "m/s"  ADAS_DRV
 SG_ FR_CMR_Obj_RelAccelX03Val : 115|9@1- (0.05,0) [-12.8|12.75] "m/s^2"  ADAS_DRV
 SG_ FR_CMR_Obj_QualLvl04Sta : 152|7@1+ (1,0) [0|100] "%"  ADAS_DRV
 SG_ FR_CMR_Obj_AlvAge04Val : 160|8@1+ (1,0) [0|255] ""  ADAS_DRV
 SG_ FR_CMR_Obj_MvngFlag04Sta : 168|4@1+ (1,0) [0|9] ""  ADAS_DRV
 SG_ FR_CMR_Obj_Id04Val : 172|7@1+ (1,0) [0|127] ""  ADAS_DRV
 SG_ FR_CMR_Obj_Wth04Val : 180|7@1+ (0.05,0) [0|6.35] "m"  ADAS_DRV
 SG_ FR_CMR_Obj_Clfct04Sta : 188|3@1+ (1,0) [0|6] ""  ADAS_DRV
 SG_ FR_CMR_Obj_RelPosX04Val : 192|13@1+ (0.05,0) [0|350] "m"  ADAS_DRV
 SG_ FR_CMR_Obj_RelPosY04Val : 206|12@1+ (0.05,-102.4) [-102.4|102.35] "m"  ADAS_DRV
 SG_ FR_CMR_Obj_RelVelX04Val : 219|12@1+ (0.05,-100) [-100|100] "m/s"  ADAS_DRV
 SG_ FR_CMR_Obj_RelVelY04Val : 232|10@1+ (0.05,-25) [-25|25] "m/s"  ADAS_DRV
 SG_ FR_CMR_Obj_RelAccelX04Val : 243|9@1- (0.05,0) [-12.8|12.75] "m/s^2"  ADAS_DRV

BO_ 386 L_FR_CMR_Obj_03_30ms: 32 FR_CMR
 SG_ FR_CMR_Obj_Crc03Val : 0|16@1+ (1,0) [0|65535] ""  ADAS_DRV
 SG_ FR_CMR_Obj_AlvCnt03Val : 16|8@1+ (1,0) [0|255] ""  ADAS_DRV
 SG_ FR_CMR_Obj_QualLvl05Sta : 24|7@1+ (1,0) [0|100] "%"  ADAS_DRV
 SG_ FR_CMR_Obj_AlvAge05Val : 32|8@1+ (1,0) [0|255] ""  ADAS_DRV
 SG_ FR_CMR_Obj_MvngFlag05Sta : 40|4@1+ (1,0) [0|9] ""  ADAS_DRV
 SG_ FR_CMR_Obj_Id05Val : 44|7@1+ (1,0) [0|127] ""  ADAS_DRV
 SG_ FR_CMR_Obj_Wth05Val : 52|7@1+ (0.05,0) [0|6.35] "m"  ADAS_DRV
 SG_ FR_CMR_Obj_Clfct05Sta : 60|3@1+ (1,0) [0|6] ""  ADAS_DRV
 SG_ FR_CMR_Obj_RelPosX05Val : 64|13@1+ (0.05,0) [0|350] "m"  ADAS_DRV
 SG_ FR_CMR_Obj_RelPosY05Val : 78|12@1+ (0.05,-102.4) [-102.4|102.35] "m"  ADAS_DRV
 SG_ FR_CMR_Obj_RelVelX05Val : 91|12@1+ (0.05,-100) [-100|100] "m/s"  ADAS_DRV
 SG_ FR_CMR_Obj_RelVelY05Val : 104|10@1+ (0.05,-25) [-25|25] "m/s"  ADAS_DRV
 SG_ FR_CMR_Obj_RelAccelX05Val : 115|9@1- (0.05,0) [-12.8|12.75] "m/s^2"  ADAS_DRV
 SG_ FR_CMR_Obj_QualLvl06Sta : 152|7@1+ (1,0) [0|100] "%"  ADAS_DRV
 SG_ FR_CMR_Obj_AlvAge06Val : 160|8@1+ (1,0) [0|255] ""  ADAS_DRV
 SG_ FR_CMR_Obj_MvngFlag06Sta : 168|4@1+ (1,0) [0|9] ""  ADAS_DRV
 SG_ FR_CMR_Obj_Id06Val : 172|7@1+ (1,0) [0|127] ""  ADAS_DRV
 SG_ FR_CMR_Obj_Wth06Val : 180|7@1+ (0.05,0) [0|6.35] "m"  ADAS_DRV
 SG_ FR_CMR_Obj_Clfct06Sta : 188|3@1+ (1,0) [0|6] ""  ADAS_DRV
 SG_ FR_CMR_Obj_RelPosX06Val : 192|13@1+ (0.05,0) [0|350] "m"  ADAS_DRV
 SG_ FR_CMR_Obj_RelPosY06Val : 206|12@1+ (0.05,-102.4) [-102.4|102.35] "m"  ADAS_DRV
 SG_ FR_CMR_Obj_RelVelX06Val : 219|12@1+ (0.05,-100) [-100|100] "m/s"  ADAS_DRV
 SG_ FR_CMR_Obj_RelVelY06Val : 232|10@1+ (0.05,-25) [-25|25] "m/s"  ADAS_DRV
 SG_ FR_CMR_Obj_RelAccelX06Val : 243|9@1- (0.05,0) [-12.8|12.75] "m/s^2"  ADAS_DRV

BO_ 387 L_FR_CMR_Obj_04_30ms: 32 FR_CMR
 SG_ FR_CMR_Obj_Crc04Val : 0|16@1+ (1,0) [0|65535] ""  ADAS_DRV
 SG_ FR_CMR_Obj_AlvCnt04Val : 16|8@1+ (1,0) [0|255] ""  ADAS_DRV
 SG_ FR_CMR_Obj_QualLvl07Sta : 24|7@1+ (1,0) [0|100] "%"  ADAS_DRV
 SG_ FR_CMR_Obj_AlvAge07Val : 32|8@1+ (1,0) [0|255] ""  ADAS_DRV
 SG_ FR_CMR_Obj_MvngFlag07Sta : 40|4@1+ (1,0) [0|9] ""  ADAS_DRV
 SG_ FR_CMR_Obj_Id07Val : 44|7@1+ (1,0) [0|127] ""  ADAS_DRV
 SG_ FR_CMR_Obj_Wth07Val : 52|7@1+ (0.05,0) [0|6.35] "m"  ADAS_DRV
 SG_ FR_CMR_Obj_Clfct07Sta : 60|3@1+ (1,0) [0|6] ""  ADAS_DRV
 SG_ FR_CMR_Obj_RelPosX07Val : 64|13@1+ (0.05,0) [0|350] "m"  ADAS_DRV
 SG_ FR_CMR_Obj_RelPosY07Val : 78|12@1+ (0.05,-102.4) [-102.4|102.35] "m"  ADAS_DRV
 SG_ FR_CMR_Obj_RelVelX07Val : 91|12@1+ (0.05,-100) [-100|100] "m/s"  ADAS_DRV
 SG_ FR_CMR_Obj_RelVelY07Val : 104|10@1+ (0.05,-25) [-25|25] "m/s"  ADAS_DRV
 SG_ FR_CMR_Obj_RelAccelX07Val : 115|9@1- (0.05,0) [-12.8|12.75] "m/s^2"  ADAS_DRV
 SG_ FR_CMR_Obj_QualLvl08Sta : 152|7@1+ (1,0) [0|100] "%"  ADAS_DRV
 SG_ FR_CMR_Obj_AlvAge08Val : 160|8@1+ (1,0) [0|255] ""  ADAS_DRV
 SG_ FR_CMR_Obj_MvngFlag08Sta : 168|4@1+ (1,0) [0|9] ""  ADAS_DRV
 SG_ FR_CMR_Obj_Id08Val : 172|7@1+ (1,0) [0|127] ""  ADAS_DRV
 SG_ FR_CMR_Obj_Wth08Val : 180|7@1+ (0.05,0) [0|6.35] "m"  ADAS_DRV
 SG_ FR_CMR_Obj_Clfct08Sta : 188|3@1+ (1,0) [0|6] ""  ADAS_DRV
 SG_ FR_CMR_Obj_RelPosX08Val : 192|13@1+ (0.05,0) [0|350] "m"  ADAS_DRV
 SG_ FR_CMR_Obj_RelPosY08Val : 206|12@1+ (0.05,-102.4) [-102.4|102.35] "m"  ADAS_DRV
 SG_ FR_CMR_Obj_RelVelX08Val : 219|12@1+ (0.05,-100) [-100|100] "m/s"  ADAS_DRV
 SG_ FR_CMR_Obj_RelVelY08Val : 232|10@1+ (0.05,-25) [-25|25] "m/s"  ADAS_DRV
 SG_ FR_CMR_Obj_RelAccelX08Val : 243|9@1- (0.05,0) [-12.8|12.75] "m/s^2"  ADAS_DRV

CM_ BO_ 3221225472 "This is a message for not used signals, created by Vector CANdb++ DBC OLE DB Provider.";
CM_ SG_ 3221225472 USM_SccDrvSetReq "USM_SccDriveSetRequest";
CM_ BO_ 2679898134 "[P] Periodic";
CM_ BO_ 2679898133 "[P] Periodic";
CM_ BO_ 2679898132 "[P] Periodic";
CM_ BO_ 2679898131 "[P] Periodic";
CM_ BO_ 2679898130 "[P] Periodic";
CM_ SG_ 1729 Xcp_Tx_Data "XCP CTO Message Signal";
CM_ SG_ 1728 Xcp_Rx_Data "XCP CTO Message Signal";
CM_ BO_ 48 "[P] Periodic";
CM_ SG_ 48 DCT_AccelPdlVal "DCT_AcceleratorPedalValue";
CM_ SG_ 48 DCT_EngSpdVal "DCT_EngineSpeedValue";
CM_ SG_ 48 DCT_EngSpdErrSta "DCT_EngineSpeedErrorStatus";
CM_ SG_ 48 DCT_CrctEngTqVal "DCT_CorrectedEngineTorqueValue";
CM_ BO_ 53 "[P] Periodic";
CM_ SG_ 53 VCU_GearSelDis "VCU_GearSelectorDisplay";
CM_ SG_ 53 VCU_AccelPdlDpthPcVal "VCU_AcceleratorPedalDepthPcValue";
CM_ SG_ 53 VCU_EVRdySta "VCU_EVReadyStatus";
CM_ BO_ 64 "[P] Periodic";
CM_ SG_ 64 TCU_Crc1Val "TCU_CyclicRedundancyCheck1Value";
CM_ SG_ 64 TCU_AlvCnt1Val "TCU_AliveCounter1Value";
CM_ SG_ 64 TCU_GearSlctDis "TCU_GearSelectDisplay";
CM_ SG_ 64 TCU_CurrGearSta "TCU_CurrentGearStatus";
CM_ SG_ 64 TCU_TrgtGearSta "TCU_TargetGearStatus";
CM_ SG_ 64 TCH_EngTrgtGearSta "TCU_EngineTargetGear";
CM_ SG_ 64 TCU_GearLmpBlnkngReq "TCU_GearLampBlinkingRequest";
CM_ SG_ 64 TCU_SmrtShftSta "TCU_SmartShiftStatus";
CM_ BO_ 69 "[P] Periodic";
CM_ SG_ 69 HTCU_GearSlctrDis "HTCU_GearSelectDisplay";
CM_ BO_ 74 "[P] Periodic";
CM_ SG_ 74 YRS_Crc1Val "YRS_CyclicRedundancyCheck1Value";
CM_ SG_ 74 YRS_AlvCnt1Val "YRS_AliveCounter1Value";
CM_ SG_ 74 YRS_YawSigSta "YRS_YawSignalStatus ##2G##YRS - YRS11 - CF_Yrs_YrStat";
CM_ SG_ 74 YRS_LatAccelSigSta "YRS_LateralAccelerationSignalStatus ##2G##YRS - YRS11 - CF_Yrs_LatAcStat";
CM_ SG_ 74 YRS_LongAccelSigSta "YRS_LongitudinalAccelerationSignalStatus ##2G##YRS - YRS12 - CF_Yrs_LongAcStat";
CM_ SG_ 74 YRS_YawRtVal "YRS_YawRateValue ##2G##YRS - YRS11 - CR_Yrs_Yr";
CM_ SG_ 74 YRS_LatAccelVal "YRS_LateralAccelerationValue ##2G##YRS - YRS11 - CR_Yrs_LatAc";
CM_ SG_ 74 YRS_LongAccelVal "YRS_LongitudinalAccelerationValue ##2G##YRS - YRS12 - CR_Yrs_LongAc";
CM_ BO_ 80 "[P] Periodic";
CM_ SG_ 80 ADAS_CMD_30_Crc01Val "ADAS_CMD_30_CyclicRedundancyCheck01Value";
CM_ SG_ 80 ADAS_CMD_30_AlvCnt01Val "ADAS_CMD_30_AliveCounter01Value";
CM_ SG_ 80 LKA_OptUsmSta_Copy_1 "LKA_OptionUsmStatus ##2G##LDW_LKA - LKA11 - CF_LKA_Opt_USM";
CM_ SG_ 80 LKA_RcgSta_Copy_1 "LKA_RecognitionStatus ##2G##LDW_LKA - LKA11 - CF_LKA_LaneRecogState";
CM_ SG_ 80 LKA_LHLnWrnSta_Copy_1 "LKA_LHLaneWarningStatus ##2G##LDW_LKA - LKA11 - CF_LKA_LHWarning";
CM_ SG_ 80 LKA_RHLnWrnSta_Copy_1 "LKA_RHLaneWarningStatus ##2G##LDW_LKA - LKA11 - CF_LKA_RHWarning";
CM_ SG_ 80 LKA_HndsoffSnd_Copy_1 "LKA_HandsoffSound ##2G##LDW_LKA - LKA11 - CF_LKA_HandsOff_Snd";
CM_ SG_ 80 LKA_StrSnd_Copy_1 "LKA_SteeringSound ##2G##LDW_LKA - LKA11 - CF_LKA_Steer_Snd";
CM_ SG_ 80 LKA_SysIndReq_Copy_1 "LKA_SystemIndicatorRequest ##2G##LDW_LKA - LKA11 - CF_LKA_SymbolState";
CM_ SG_ 80 LKA_StrTqReqVal_Copy_1 "LKA_SteeringTorqueRequestValue ##2G##LDW_LKA - LKA11 - CR_LKA_StrToqReq";
CM_ SG_ 80 LKA_ActToiSta_Copy_1 "LKA_ActiveTorqueOverlayInterfaceStatus ##2G##LDW_LKA - LKA11 - CF_LKA_ActToi";
CM_ SG_ 80 LKA_ToiFltSta_Copy_1 "LKA_TorqueOverlayInterfaceFaultStatus ##2G##LDW_LKA - LKA11 - CF_LKA_ToiFlt";
CM_ SG_ 80 LKA_SysWrn_Copy_1 "LKA_Additional_Info";
CM_ SG_ 80 LKA_UsmMod_Copy_1 "LKA_USM Mode ##2G##LDW_LKA-LKA11-CF_LKA_USM_Mode";
CM_ SG_ 80 Info_PedtrnDst_Copy_1 "Distance of the nearest pedestrian ##2G##LDW_LKA-LKA12-CF_Vess_ref_Ped_Distance";
CM_ BO_ 96 "[P] Periodic";
CM_ SG_ 96 ABS_DfctvSta "ABS_DefectiveStatus ##2G##ESC - TCS11 - ABS_DEF";
CM_ SG_ 96 ABS_ActvSta "ABS_ActiveStatus ##2G##ESC - TCS11 - ABS_ACT";
CM_ SG_ 96 ABS_DiagSta "ABS_DiagnosticStatus ##2G##ESC - TCS11 - ABS_DIAG";
CM_ SG_ 96 EBD_DfctvSta "EBD_DefectiveStatus ##2G##ESC - TCS11 - EBD_DEF";
CM_ SG_ 96 TCS_LmpSta "TCS_LampStatus ##2G##ESC - TCS15 - TCS_LAMP";
CM_ SG_ 96 TCS_DisableSta "TCS_DisabledStatus ##2G##ESC - TCS11 - TCS_PAS";
CM_ SG_ 96 TCS_DfctvSta "TCS_DefectiveStatus ##2G##ESC - TCS11 - TCS_DEF";
CM_ SG_ 96 TCS_CtrlSta "TCS_ControlStatus ##2G##ESC - TCS11 - TCS_CTL";
CM_ SG_ 96 ESC_DisableSta "ESC_DisabledStatus ##2G##ESC - TCS11 - ESP_PAS";
CM_ SG_ 96 ESC_DfctvSta "ESC_DefectiveStatus ##2G##ESC - TCS11 - ESP_DEF";
CM_ SG_ 96 ESC_CtrlSta "ESC_ControlStatus ##2G##ESC - TCS11 - ESP_CTL";
CM_ SG_ 96 TCS_Req "TCS_Request ##2G##ESC - TCS11 - TCS_REQ";
CM_ SG_ 96 MSR_FuncReq "MSR_FunctionRequest ##2G##ESC - TCS11 - MSR_C_REQ";
CM_ SG_ 96 ESC_CylPrsrVal "ESC_CylinderPressureValue ##2G##ESC - ESP12 - CYL_PRES";
CM_ SG_ 96 ESC_CylPrsrSta "ESC_CylinderPressureStatus ##2G##ESC - ESP12 - CYL_PRES_STAT";
CM_ SG_ 96 ESC_CylPrsrDiagSta "ESC_CylinderPressureDiagnosisStatus ##2G##ESC - ESP12 - CYL_PRESS_DIAG";
CM_ SG_ 96 ESC_CylPrsrFlagSta "ESC_CylinderPressureFlagStatus ##2G##ESC - ESP12 - CYL_PRES_FLAG";
CM_ SG_ 96 ESC_VsmActvSta "ESC_VsmActiveStatus ##2G##ESC - VSM11 - CF_Esc_Act";
CM_ SG_ 96 ESC_LongAccelOffstCalibPrmtr "Longitudinal Acceleration Offset Calibration Parameter";
CM_ SG_ 96 AVH_Sta "AVH_Status ##2G##ESC - ESP11 - AVH_STAT";
CM_ BO_ 106 "[P] Periodic";
CM_ SG_ 106 TCU_Crc2Val "TCU_CyclicRedundancyCheck2Value";
CM_ SG_ 106 TCU_AlvCnt2Val "TCU_AliveCounter2Value";
CM_ SG_ 106 TCU_AtTempCVal "TCU_AtTemperatureCValue";
CM_ SG_ 106 TCU_TqCnvrtrSpdVal "TCU_TorqueConverterSpeedValue";
CM_ BO_ 160 "[P] Periodic";
CM_ SG_ 160 WHL_PlsFLVal "WHL_PulseFrontLeftValue ##2G##ESC - WHL_PUL11 - WHL_PUL_FL";
CM_ SG_ 160 WHL_PlsFRVal "WHL_PulseFrontRightValue ##2G##ESC - WHL_PUL11 - WHL_PUL_FR";
CM_ SG_ 160 WHL_PlsRLVal "WHL_PulseRearLeftValue ##2G##ESC - WHL_PUL11 - WHL_PUL_RL";
CM_ SG_ 160 WHL_PlsRRVal "WHL_PulseRearRightValue ##2G##ESC - WHL_PUL11 - WHL_PUL_RR";
CM_ SG_ 160 WHL_DirFLVal "WHL_DirectionFrontLeftValue ##2G##ESC - WHL_PUL11 - WHL_DIR_FL";
CM_ SG_ 160 WHL_DirFRVal "WHL_DirectionFrontRightValue ##2G##ESC - WHL_PUL11 - WHL_DIR_FR";
CM_ SG_ 160 WHL_DirRLVal "WHL_DirectionRearLeftValue ##2G##ESC - WHL_PUL11 - WHL_DIR_RL";
CM_ SG_ 160 WHL_DirRRVal "WHL_DirectionRearRightValue ##2G##ESC - WHL_PUL11 - WHL_DIR_RR";
CM_ SG_ 160 WHL_SpdFLVal "WHL_SpeedFrontLeftValue ##2G##ESC - WHL_SPD11 - WHL_SPD_FL";
CM_ SG_ 160 WHL_SpdFRVal "WHL_SpeedFrontRightValue ##2G##ESC - WHL_SPD11 - WHL_SPD_FR";
CM_ SG_ 160 WHL_SpdRLVal "WHL_SpeedRearLeftValue ##2G##ESC - WHL_SPD11 - WHL_SPD_RL";
CM_ SG_ 160 WHL_SpdRRVal "WHL_SpeedRearRightValue ##2G##ESC - WHL_SPD11 - WHL_SPD_RR";
CM_ BO_ 181 "[P] Periodic";
CM_ SG_ 181 ENG_EngSpdErrSta "ENG_EngineSpeedErrorStatus ##2G##EMS - EMS11 - F_N_ENG";
CM_ SG_ 181 ENG_IsgSta "ENG_IsgStatus ##2G##EMS - EMS_H12 - CF_Ems_IsgStat";
CM_ SG_ 181 ENG_IgnOnSta "ENG_IgnitionOnStatus ##2G##EMS - EMS11 - SWI_IGK";
CM_ SG_ 181 ENG_EngSpdVal "ENG_EngineSpeedValue ##2G##EMS - EMS11 - N";
CM_ SG_ 181 ENG_VehSpdHiVal "ENG_VehicleSpeedHighValue";
CM_ BO_ 186 "[P] Periodic";
CM_ SG_ 186 HCU_HevRdySta "HCU_HybridVehicleReadyStatus";
CM_ SG_ 186 HCU_SccEnblSta "HCU_SmartCruiseControlEnableStatus";
CM_ BO_ 229 "[P] Periodic";
CM_ SG_ 229 ESC_YawSigSta "ESC_YawSignalStatus";
CM_ SG_ 229 ESC_LatAccelSigSta "ESC_LateralAccelerationSignalStatus";
CM_ SG_ 229 ESC_LongAccelSigSta "ESC_LongitudinalAccelerationSignalStatus";
CM_ SG_ 229 ESC_YawRtVal "ESC_YawRateValue";
CM_ SG_ 229 ESC_LatAccelVal "ESC_LateralAccelerationValue";
CM_ SG_ 229 ESC_LongAccelVal "ESC_LongitudinalAccelerationValue";
CM_ BO_ 234 "[P] Periodic";
CM_ SG_ 234 MDPS_Crc1Val "MDPS_CyclicRedundancyCheck1Value ##2G##MDPS - MDPS11 - CF_Mdps_Chksum";
CM_ SG_ 234 MDPS_AlvCnt1Val "MDPS_AliveCounter1Value ##2G##MDPS - MDPS11 - CF_Mdps_AliveCnt";
CM_ SG_ 234 MDPS_Typ "MDPS_Type ##2G##MDPS - MDPS11 - CF_Mdps_Type";
CM_ SG_ 234 MDPS_PaModeSta "MDPS_PaModeStatus ##2G##MDPS - MDPS11 - CF_Mdps_Stat";
CM_ SG_ 234 MDPS_LkaPlgInSta "MDPS_LkaPlug-inStatus ##2G##MDPS - MDPS11 - CF_Mdps_LKA_FUNC";
CM_ SG_ 234 MDPS_LkaToiActvSta "MDPS_LkaToiActiveStatus ##2G##MDPS - MDPS12 - CF_Mdps_ToiActive";
CM_ SG_ 234 MDPS_LkaToiUnblSta "MDPS_LkaToiUnavailableStatus ##2G##MDPS - MDPS12 - CF_Mdps_ToiUnavail";
CM_ SG_ 234 MDPS_LkaToiFltSta "MDPS_LkaToiFaultStatus ##2G##MDPS - MDPS12 - CF_Mdps_ToiFlt";
CM_ SG_ 234 MDPS_LkaFailSta "MDPS_LkaFailStatus ##2G##MDPS - MDPS12 - CF_Mdps_FailStat";
CM_ SG_ 234 MDPS_FlxStrSta "MDPS_FlexSteerStatus ##2G##MDPS - MDPS11 - CF_Mdps_Flex";
CM_ SG_ 234 MDPS_CurrModVal "MDPS_CurrentModeStatus ##2G##MDPS - MDPS11 - CF_Mdps_CurrMode";
CM_ SG_ 234 MDPS_OutTqVal "MDPS_OutputTorqueValue ##2G##MDPS - MDPS12 - CR_Mdps_OutTq";
CM_ SG_ 234 MDPS_StrTqSnsrVal "MDPS_SteeringTorqueSensorValue ##2G##MDPS - MDPS11 - CR_Mdps_DrvTq,MDPS12-CR_Mdps_StrTq,CR_Mdps_StrColTq";
CM_ BO_ 250 "[P] Periodic";
CM_ SG_ 250 HCU_EstAccelPdlPcVal "HCU_EstimatedAcceleratorPedalPcValue";
CM_ BO_ 256 "[P] Periodic";
CM_ SG_ 256 EMS_Crc2Val "EMS_CyclicRedundancyCheck2Value";
CM_ SG_ 256 EMS_AlvCnt2Val "EMS_AliveCounter2Value";
CM_ SG_ 256 ENG_BrkSwSta "ENG_BrakeSwitchStatus ##2G##EMS - EMS12 - BRAKE_ACT";
CM_ SG_ 256 ENG_EngSta "ENG_EngineStatus ##2G##EMS - EMS16 - ENG_STAT";
CM_ SG_ 256 ENG_AccActSta "ENG_AutoCruiseControlActiveStatus ##2G##EMS - EMS12 - ACC_ACT";
CM_ SG_ 256 ENG_CltchOpSta "ENG_ClutchStatus ##2G##EMS - EMS12 - CLU_ACK";
CM_ SG_ 256 ENG_AccelPdlVal "ENG_AcceleratorPedalValue ##2G##EMS - EMS12 - PV_AV_CAN";
CM_ SG_ 256 ENG_AppAccelPdlSta "ENG_AppliedAcceleratorPedalStatus ##2G##EMS - EMS16 - CF_Ems_AclAct";
CM_ BO_ 261 "[P] Periodic";
CM_ SG_ 261 HEV_EngSpdVal "HEV_EngineSpeedValue";
CM_ SG_ 261 HEV_AccelPdlVal "HEV_AcceleratorPedalValue";
CM_ BO_ 266 "[P] Periodic";
CM_ SG_ 266 MCU_VehSpdKphVal "MCU_VehicleSpeedKphValue";
CM_ BO_ 282 "[P] Periodic";
CM_ SG_ 282 FR_CMR_Crc1Val "FR_CMR_CyclicRedundancyCheck1Value";
CM_ SG_ 282 FR_CMR_AlvCnt1Val "FR_CMR_AliveCounter1Value";
CM_ SG_ 282 HBA_SysOptSta "HBA_SystemOptionStatus ##2G##LDW_LKA - LKA11 - CF_HBA_Opt_USM";
CM_ SG_ 282 HBA_SysSta "HBA_SystemStatus ##2G##LDW_LKA - LKA11 - CF_HBA_SysState";
CM_ SG_ 282 HBA_IndLmpReq "HBA_IndicatorLampRequest ##2G##LDW_LKA - LKA11 - CF_HBA_Lamp";
CM_ SG_ 282 iHBAref_VehLftSta "iHBAref_VehicleLeftStatus";
CM_ SG_ 282 iHBAref_VehCtrSta "iHBAref_VehicleCenterStatus";
CM_ SG_ 282 iHBAref_VehRtSta "iHBAref_VehicleRightStatus";
CM_ SG_ 282 iHBAref_ILLAmbtSta "iHBAref_IlluminationAmbientStatus";
CM_ SG_ 282 FCA_Equip_MFC "FCA_Equipment_MFC ##2G##LDW_LKA - LKA15 - CF_FCA_Equip_MFC";
CM_ SG_ 282 HBA_OptUsmSta "HBA Option USM Status";
CM_ SG_ 282 FCAref_FusSta "FCAref_FusionStatus ##2G##LDW_LKA - LKA11 - CF_LKA_FusionState";
CM_ SG_ 282 DAW_LVDA_PUDis "LVDA_PopUpDisplay ##2G##LDW_LKA - LKA12 - CF_LeadVehDptAlert_Display";
CM_ SG_ 282 DAW_LVDA_OptUsmSta "LVDA_OptionUsmStatus ##2G##LDW_LKA - LKA12 - CF_LeadVehDptAlert_USM";
CM_ SG_ 282 DAW_OptUsmSta "DAW_OptionUsmStatus ##2G##LDW_LKA - LKA12 - CF_DAW_Opt_USM_NEW";
CM_ SG_ 282 DAW_SysSta "DAW_SystemStatus ##2G##LDW_LKA - LKA12 - CF_DAW_Status";
CM_ SG_ 282 DAW_WrnMsgSta "DAW_WarningMessageStatus ##2G##LDW_LKA - LKA12 - CF_DAW_Warn";
CM_ SG_ 282 DAW_TimeRstReq "DAW_TimeResetRequest ##2G##LDW_LKA - LKA12 - CF_DAW_TimeReset";
CM_ SG_ 282 DAW_SnstvtyModRetVal "DAW_SensitivityModeReturnValue##2G##LDW_LKA - LKA12 - CF_DAW_Opt_USM";
CM_ BO_ 288 "[P] Periodic";
CM_ SG_ 288 GCU_VehSpdKphVal "GCU_VehicleSpeedKphValue";
CM_ BO_ 293 "[P] Periodic";
CM_ SG_ 293 SAS_Crc1Val "SAS_CyclicRedundancyCheck1Value";
CM_ SG_ 293 SAS_AlvCnt1Val "SAS_AliveCounter1Value";
CM_ SG_ 293 SAS_AnglVal "SAS_AngleValue";
CM_ SG_ 293 SAS_SpdVal "SAS_SpeedValue";
CM_ SG_ 293 SAS_IntSta "SAS_InternalStatus";
CM_ BO_ 314 "[EW] On Event and On Write";
CM_ SG_ 314 FR_CMR_Crc5Val "FR_CMR_CyclicRedundancyCheck5Value";
CM_ SG_ 314 FR_CMR_AlvCnt5Val "FR_CMR_AliveCounter5Value";
CM_ SG_ 314 Info_DistL "Info_DistanceLeft";
CM_ SG_ 314 Info_HeightL "Info_HeightLeft";
CM_ SG_ 314 Info_LengthL "Info_LengthLeft";
CM_ SG_ 314 Info_TypeL "Info_TypeLeft";
CM_ SG_ 314 Info_ConfL "Info_ConfidenceLeft";
CM_ SG_ 314 Info_CyclicCounterL "Info_CyclicCounterLeft";
CM_ SG_ 314 Info_VariL "Info_VarianceLeft";
CM_ SG_ 314 Info_DistR "Info_DistanceRight";
CM_ SG_ 314 Info_HeightR "Info_HeightRight";
CM_ SG_ 314 Info_LengthR "Info_LengthRight";
CM_ SG_ 314 Info_TypeR "Info_TypeRight";
CM_ SG_ 314 Info_ConfR "Info_ConfidenceRight";
CM_ SG_ 314 Info_CyclicCounterR "Info_CyclicCounterRight";
CM_ SG_ 314 Info_VariR "Info_VarianceRight";
CM_ SG_ 314 Info_RdProfSts "Info_RoadProfileStatus";
CM_ BO_ 352 "[P] Periodic";
CM_ SG_ 352 FCA_WrngSndSta "FCA warning sound status";
CM_ SG_ 352 ADAS_CMD_Crc10Val "ADAS_CMD_CyclicRedundancyCheck10Value ##2G##FCA - FCA11 - CR_FCA_ChkSum";
CM_ SG_ 352 ADAS_CMD_AlvCnt10Val "ADAS_CMD_AliveCounter10Value ##2G##FCA - FCA11 - CR_FCA_Alive";
CM_ SG_ 352 FCA_OnOffEquipSta "FCA_OnOffEquipmentStatus ##2G##FCA - FCA12 - FCA_USM";
CM_ SG_ 352 FCA_SysFlrSta "FCA_SystemFailureStatus ##2G##FCA - FCA11 - FCA_Failinfo";
CM_ SG_ 352 FCA_WrngLvlSta "FCA_WarningLevelStatus ##2G##FCA - FCA11 - CF_VSM_Warn";
CM_ SG_ 352 FCA_VehStpReq "FCA_VehicleStopRequest ##2G##FCA - FCA11 - FCA_StopReq";
CM_ SG_ 352 FCA_StbltActvReq "FCA_SeatBeltActivateRequest ##2G##FCA - FCA11 - CF_VSM_BeltCmd";
CM_ SG_ 352 FCA_HydrlcBstAsstReq "FCA_HydraulicBoostAssistRequest ##2G##FCA - FCA11 - CF_VSM_HBACmd";
CM_ SG_ 352 FCA_DclReqVal "FCA_DecelerationRequestValue ##2G##FCA - FCA11 - CR_VSM_DecCmd";
CM_ SG_ 352 FCA_PrefillActvReq "FCA_PrefillActivateRequest ##2G##FCA - FCA11 - CF_VSM_Prefill";
CM_ SG_ 352 FCA_PartialActvReq "FCA_PartialActivateRequest";
CM_ SG_ 352 FCA_FullActvReq "FCA_FullActivateRequest";
CM_ SG_ 352 FCA_SnstvtyModRetVal "FCA_SensitivityModeReturnValue ##2G##FCA - FCA12 - FCA_DrvSetState";
CM_ SG_ 352 FCA_RelVel "FCA_RelativeVelocity ##2G##FCA - FCA11_FS - FCA_RelativeVelocity";
CM_ SG_ 352 FCA_TimetoCllsn "FCA_TimetoCollision ##2G##FCA - FCA11_FS - FCA_TimetoCollision";
CM_ SG_ 352 FCA_Jnctn_OnOffEquipSta "FCA_Junction_OnOffEquipStatus";
CM_ SG_ 352 FCA_WrngTrgtDis "FCA_WarningTargetDisplay";
CM_ BO_ 362 "[P] Periodic";
CM_ SG_ 362 RSPA_Sta "RSPA_Status";
CM_ BO_ 373 "[P] Periodic";
CM_ SG_ 373 ESC_Crc3Val "ESC_CyclicRedundancyCheck3Value";
CM_ SG_ 373 ESC_AlvCnt3Val "ESC_AliveCounter3Value";
CM_ SG_ 373 ESC_VehAccelVal "ESC_VehicleAccelerationValue ##2G##ESC - TCS13 - ACCEL_REF_ACC";
CM_ SG_ 373 ESC_AccelBasisVal "ESC_AccelerationBasisValue ##2G##ESC - TCS13 - aBasis";
CM_ SG_ 373 SCC_OptTyp "SCC_OptionType ##2G##ESC - TCS13 - ACC_EQUIP";
CM_ SG_ 373 SCC_EnblReq "SCC_EnableRequest ##2G##ESC - TCS13 - ACCEnable";
CM_ SG_ 373 SCC_TqReq "SCC_TorqueRequest ##2G##ESC - TCS13 - ACC_REQ";
CM_ SG_ 373 SCC_ReqLimSta "SCC_RequestLimitedStatus ##2G##ESC - TCS13 - ACCReqLim";
CM_ SG_ 373 ESC_StdStillVal "ESC_StandStillValue ##2G##ESC - TCS13 - StandStill";
CM_ SG_ 373 ESC_BrkLtReq "ESC_BrakeLightRequest ##2G##ESC - TCS13 - BrakeLight";
CM_ SG_ 373 ESC_DclEnblReq "ESC_DecelerationEnableRequest ##2G##ESC - TCS13 - DCEnable";
CM_ SG_ 373 ESC_DrvOvrdSta "ESC_OverrideRequest ##2G##ESC - TCS13 - DriverOverride";
CM_ SG_ 373 ESC_DrvBrkSta "ESC_DriverBrakingStatus ##2G##ESC - TCS13 - CF_DriBkeStat";
CM_ SG_ 373 ESC_DrvBrkActvSta "ESC_DriverBrakingActiveStatus ##2G##ESC - TCS13 - DriverBraking";
CM_ SG_ 373 ESC_PrkBrkActvSta "ESC_ParkingBrakeActiveStatus ##2G##ESC - TCS13 - PBRAKE_ACT";
CM_ SG_ 373 FCA_EquipSta "FCA_EquipmentStatus ##2G##ESC - TCS13 - FCA_EQUIP";
CM_ SG_ 373 FCA_AvlblSta "VSM_AvailableStatus ##2G##ESC - TCS13 - CF_VSM_Avail";
CM_ BO_ 384 "[P] Periodic";
CM_ SG_ 384 FR_CMR_Obj_Crc01Val "FR_CMR_Obj_CyclicRedundancyCheck01Value";
CM_ SG_ 384 FR_CMR_Obj_AlvCnt01Val "FR_CMR_Obj_AliveCounter01Value";
CM_ SG_ 384 FR_CMR_Obj_QualLvl01Sta "FR_CMR_Obj_QualityLevel01Value";
CM_ SG_ 384 FR_CMR_Obj_AlvAge01Val "FR_CMR_Obj_AliveAge01Value";
CM_ SG_ 384 FR_CMR_Obj_MvngFlag01Sta "FR_CMR_Obj_MovingFlag01Status";
CM_ SG_ 384 FR_CMR_Obj_Id01Val "FR_CMR_Obj_ID01Value";
CM_ SG_ 384 FR_CMR_Obj_Wth01Val "FR_CMR_Obj_Width01Value";
CM_ SG_ 384 FR_CMR_Obj_Clfct01Sta "FR_CMR_Obj_Classification01Status";
CM_ SG_ 384 FR_CMR_Obj_RelPosX01Val "FR_CMR_Obj_RelativePositionX01Value";
CM_ SG_ 384 FR_CMR_Obj_RelPosY01Val "FR_CMR_Obj_RelativePositionY01Value";
CM_ SG_ 384 FR_CMR_Obj_RelVelX01Val "FR_CMR_Obj_RelativeVelocityX01Value";
CM_ SG_ 384 FR_CMR_Obj_RelVelY01Val "FR_CMR_Obj_RelativeVelocityY01Value";
CM_ SG_ 384 FR_CMR_Obj_RelAccelX01Val "FR_CMR_Obj_RelativeAccelerationX01Value";
CM_ SG_ 384 FR_CMR_Obj_QualLvl02Sta "FR_CMR_Obj_QualityLevel02Value";
CM_ SG_ 384 FR_CMR_Obj_AlvAge02Val "FR_CMR_Obj_AliveAge02Value";
CM_ SG_ 384 FR_CMR_Obj_MvngFlag02Sta "FR_CMR_Obj_MovingFlag02Status";
CM_ SG_ 384 FR_CMR_Obj_Id02Val "FR_CMR_Obj_ID02Value";
CM_ SG_ 384 FR_CMR_Obj_Wth02Val "FR_CMR_Obj_Width02Value";
CM_ SG_ 384 FR_CMR_Obj_Clfct02Sta "FR_CMR_Obj_Classification02Status";
CM_ SG_ 384 FR_CMR_Obj_RelPosX02Val "FR_CMR_Obj_RelativePositionX02Value";
CM_ SG_ 384 FR_CMR_Obj_RelPosY02Val "FR_CMR_Obj_RelativePositionY02Value";
CM_ SG_ 384 FR_CMR_Obj_RelVelX02Val "FR_CMR_Obj_RelativeVelocityX02Value";
CM_ SG_ 384 FR_CMR_Obj_RelVelY02Val "FR_CMR_Obj_RelativeVelocityY02Value";
CM_ SG_ 384 FR_CMR_Obj_RelAccelX02Val "FR_CMR_Obj_RelativeAccelerationX02Value";
CM_ BO_ 385 "[P] Periodic";
CM_ SG_ 385 FR_CMR_Obj_Crc02Val "FR_CMR_Obj_CyclicRedundancyCheck02Value";
CM_ SG_ 385 FR_CMR_Obj_AlvCnt02Val "FR_CMR_Obj_AliveCounter02Value";
CM_ SG_ 385 FR_CMR_Obj_QualLvl03Sta "FR_CMR_Obj_QualityLevel03Value";
CM_ SG_ 385 FR_CMR_Obj_AlvAge03Val "FR_CMR_Obj_AliveAge03Value";
CM_ SG_ 385 FR_CMR_Obj_MvngFlag03Sta "FR_CMR_Obj_MovingFlag03Status";
CM_ SG_ 385 FR_CMR_Obj_Id03Val "FR_CMR_Obj_ID03Value";
CM_ SG_ 385 FR_CMR_Obj_Wth03Val "FR_CMR_Obj_Width03Value";
CM_ SG_ 385 FR_CMR_Obj_Clfct03Sta "FR_CMR_Obj_Classification03Status";
CM_ SG_ 385 FR_CMR_Obj_RelPosX03Val "FR_CMR_Obj_RelativePositionX03Value";
CM_ SG_ 385 FR_CMR_Obj_RelPosY03Val "FR_CMR_Obj_RelativePositionY03Value";
CM_ SG_ 385 FR_CMR_Obj_RelVelX03Val "FR_CMR_Obj_RelativeVelocityX03Value";
CM_ SG_ 385 FR_CMR_Obj_RelVelY03Val "FR_CMR_Obj_RelativeVelocityY03Value";
CM_ SG_ 385 FR_CMR_Obj_RelAccelX03Val "FR_CMR_Obj_RelativeAccelerationX03Value";
CM_ SG_ 385 FR_CMR_Obj_QualLvl04Sta "FR_CMR_Obj_QualityLevel04Value";
CM_ SG_ 385 FR_CMR_Obj_AlvAge04Val "FR_CMR_Obj_AliveAge04Value";
CM_ SG_ 385 FR_CMR_Obj_MvngFlag04Sta "FR_CMR_Obj_MovingFlag04Status";
CM_ SG_ 385 FR_CMR_Obj_Id04Val "FR_CMR_Obj_ID04Value";
CM_ SG_ 385 FR_CMR_Obj_Wth04Val "FR_CMR_Obj_Width04Value";
CM_ SG_ 385 FR_CMR_Obj_Clfct04Sta "FR_CMR_Obj_Classification04Status";
CM_ SG_ 385 FR_CMR_Obj_RelPosX04Val "FR_CMR_Obj_RelativePositionX04Value";
CM_ SG_ 385 FR_CMR_Obj_RelPosY04Val "FR_CMR_Obj_RelativePositionY04Value";
CM_ SG_ 385 FR_CMR_Obj_RelVelX04Val "FR_CMR_Obj_RelativeVelocityX04Value";
CM_ SG_ 385 FR_CMR_Obj_RelVelY04Val "FR_CMR_Obj_RelativeVelocityY04Value";
CM_ SG_ 385 FR_CMR_Obj_RelAccelX04Val "FR_CMR_Obj_RelativeAccelerationX04Value";
CM_ BO_ 386 "[P] Periodic";
CM_ SG_ 386 FR_CMR_Obj_Crc03Val "FR_CMR_Obj_CyclicRedundancyCheck03Value";
CM_ SG_ 386 FR_CMR_Obj_AlvCnt03Val "FR_CMR_Obj_AliveCounter03Value";
CM_ SG_ 386 FR_CMR_Obj_QualLvl05Sta "FR_CMR_Obj_QualityLevel05Value";
CM_ SG_ 386 FR_CMR_Obj_AlvAge05Val "FR_CMR_Obj_AliveAge05Value";
CM_ SG_ 386 FR_CMR_Obj_MvngFlag05Sta "FR_CMR_Obj_MovingFlag05Status";
CM_ SG_ 386 FR_CMR_Obj_Id05Val "FR_CMR_Obj_ID05Value";
CM_ SG_ 386 FR_CMR_Obj_Wth05Val "FR_CMR_Obj_Width05Value";
CM_ SG_ 386 FR_CMR_Obj_Clfct05Sta "FR_CMR_Obj_Classification05Status";
CM_ SG_ 386 FR_CMR_Obj_RelPosX05Val "FR_CMR_Obj_RelativePositionX05Value";
CM_ SG_ 386 FR_CMR_Obj_RelPosY05Val "FR_CMR_Obj_RelativePositionY05Value";
CM_ SG_ 386 FR_CMR_Obj_RelVelX05Val "FR_CMR_Obj_RelativeVelocityX05Value";
CM_ SG_ 386 FR_CMR_Obj_RelVelY05Val "FR_CMR_Obj_RelativeVelocityY05Value";
CM_ SG_ 386 FR_CMR_Obj_RelAccelX05Val "FR_CMR_Obj_RelativeAccelerationX05Value";
CM_ SG_ 386 FR_CMR_Obj_QualLvl06Sta "FR_CMR_Obj_QualityLevel06Value";
CM_ SG_ 386 FR_CMR_Obj_AlvAge06Val "FR_CMR_Obj_AliveAge06Value";
CM_ SG_ 386 FR_CMR_Obj_MvngFlag06Sta "FR_CMR_Obj_MovingFlag06Status";
CM_ SG_ 386 FR_CMR_Obj_Id06Val "FR_CMR_Obj_ID06Value";
CM_ SG_ 386 FR_CMR_Obj_Wth06Val "FR_CMR_Obj_Width06Value";
CM_ SG_ 386 FR_CMR_Obj_Clfct06Sta "FR_CMR_Obj_Classification06Status";
CM_ SG_ 386 FR_CMR_Obj_RelPosX06Val "FR_CMR_Obj_RelativePositionX06Value";
CM_ SG_ 386 FR_CMR_Obj_RelPosY06Val "FR_CMR_Obj_RelativePositionY06Value";
CM_ SG_ 386 FR_CMR_Obj_RelVelX06Val "FR_CMR_Obj_RelativeVelocityX06Value";
CM_ SG_ 386 FR_CMR_Obj_RelVelY06Val "FR_CMR_Obj_RelativeVelocityY06Value";
CM_ SG_ 386 FR_CMR_Obj_RelAccelX06Val "FR_CMR_Obj_RelativeAccelerationX06Value";
CM_ BO_ 387 "[P] Periodic";
CM_ SG_ 387 FR_CMR_Obj_Crc04Val "FR_CMR_Obj_CyclicRedundancyCheck04Value";
CM_ SG_ 387 FR_CMR_Obj_AlvCnt04Val "FR_CMR_Obj_AliveCounter04Value";
CM_ SG_ 387 FR_CMR_Obj_QualLvl07Sta "FR_CMR_Obj_QualityLevel07Value";
CM_ SG_ 387 FR_CMR_Obj_AlvAge07Val "FR_CMR_Obj_AliveAge07Value";
CM_ SG_ 387 FR_CMR_Obj_MvngFlag07Sta "FR_CMR_Obj_MovingFlag07Status";
CM_ SG_ 387 FR_CMR_Obj_Id07Val "FR_CMR_Obj_ID07Value";
CM_ SG_ 387 FR_CMR_Obj_Wth07Val "FR_CMR_Obj_Width07Value";
CM_ SG_ 387 FR_CMR_Obj_Clfct07Sta "FR_CMR_Obj_Classification07Status";
CM_ SG_ 387 FR_CMR_Obj_RelPosX07Val "FR_CMR_Obj_RelativePositionX07Value";
CM_ SG_ 387 FR_CMR_Obj_RelPosY07Val "FR_CMR_Obj_RelativePositionY07Value";
CM_ SG_ 387 FR_CMR_Obj_RelVelX07Val "FR_CMR_Obj_RelativeVelocityX07Value";
CM_ SG_ 387 FR_CMR_Obj_RelVelY07Val "FR_CMR_Obj_RelativeVelocityY07Value";
CM_ SG_ 387 FR_CMR_Obj_RelAccelX07Val "FR_CMR_Obj_RelativeAccelerationX07Value";
CM_ SG_ 387 FR_CMR_Obj_QualLvl08Sta "FR_CMR_Obj_QualityLevel08Value";
CM_ SG_ 387 FR_CMR_Obj_AlvAge08Val "FR_CMR_Obj_AliveAge08Value";
CM_ SG_ 387 FR_CMR_Obj_MvngFlag08Sta "FR_CMR_Obj_MovingFlag08Status";
CM_ SG_ 387 FR_CMR_Obj_Id08Val "FR_CMR_Obj_ID08Value";
CM_ SG_ 387 FR_CMR_Obj_Wth08Val "FR_CMR_Obj_Width08Value";
CM_ SG_ 387 FR_CMR_Obj_Clfct08Sta "FR_CMR_Obj_Classification08Status";
CM_ SG_ 387 FR_CMR_Obj_RelPosX08Val "FR_CMR_Obj_RelativePositionX08Value";
CM_ SG_ 387 FR_CMR_Obj_RelPosY08Val "FR_CMR_Obj_RelativePositionY08Value";
CM_ SG_ 387 FR_CMR_Obj_RelVelX08Val "FR_CMR_Obj_RelativeVelocityX08Value";
CM_ SG_ 387 FR_CMR_Obj_RelVelY08Val "FR_CMR_Obj_RelativeVelocityY08Value";
CM_ SG_ 387 FR_CMR_Obj_RelAccelX08Val "FR_CMR_Obj_RelativeAccelerationX08Value";
BA_DEF_ BO_  "GenMsgILSupport" ENUM  "No","Yes";
BA_DEF_ BO_  "DiagState" ENUM  "No","Yes";
BA_DEF_ BO_  "DiagResponse" ENUM  "No","Yes";
BA_DEF_ BO_  "DiagRequest" ENUM  "No","Yes";
BA_DEF_  "BusType" STRING ;
BA_DEF_ BO_  "VFrameFormat" ENUM  "StandardCAN","ExtendedCAN","reserved","reserved","reserved","reserved","reserved","reserved","reserved","reserved","reserved","reserved","reserved","reserved","StandardCAN_FD","ExtendedCAN_FD";
BA_DEF_ BO_  "GenMsgSendType" ENUM  "Cyclic","NoMsgSendType";
BA_DEF_ SG_  "UserSigValidity" ENUM  "B+","ACC","IG","IG1","IG2","IG3","IG1 or IG2","IG1 or IG3","Undef";
BA_DEF_ SG_  "RoutingFactor" INT 1 1215752192;
BA_DEF_ SG_  "NetworkRequestHoldingTime" INT 0 65535;
BA_DEF_ SG_  "Description" STRING ;
BA_DEF_ SG_  "Version" STRING ;
BA_DEF_ BO_  "GenMsgCycleTime" INT 0 2000;
BA_DEF_ BO_  "GenMsgStartDelayTime" INT 0 2000;
BA_DEF_ BU_  "NmNode" ENUM  "No","Yes";
BA_DEF_ SG_  "UsrSigPurpose" ENUM  "Undef","FN","DIAG","DEV","NM";
BA_DEF_ SG_  "GenSigStartValue" INT 0 0;
BA_DEF_DEF_  "GenMsgILSupport" "Yes";
BA_DEF_DEF_  "DiagState" "No";
BA_DEF_DEF_  "DiagResponse" "No";
BA_DEF_DEF_  "DiagRequest" "No";
BA_DEF_DEF_  "BusType" "CAN FD";
BA_DEF_DEF_  "VFrameFormat" "";
BA_DEF_DEF_  "GenMsgSendType" "NoMsgSendType";
BA_DEF_DEF_  "UserSigValidity" "IG";
BA_DEF_DEF_  "RoutingFactor" 1;
BA_DEF_DEF_  "NetworkRequestHoldingTime" 0;
BA_DEF_DEF_  "Description" "";
BA_DEF_DEF_  "Version" "";
BA_DEF_DEF_  "GenMsgCycleTime" 0;
BA_DEF_DEF_  "GenMsgStartDelayTime" 0;
BA_DEF_DEF_  "NmNode" "Yes";
BA_DEF_DEF_  "UsrSigPurpose" "FN";
BA_DEF_DEF_  "GenSigStartValue" 0;
BA_ "NmNode" BU_ ILCU_LH 0;
BA_ "NmNode" BU_ ILCU_RH 0;
BA_ "NmNode" BU_ IBU_HS 0;
BA_ "NmNode" BU_ IAU 0;
BA_ "NmNode" BU_ ICU 0;
BA_ "NmNode" BU_ PTGM 0;
BA_ "NmNode" BU_ SWRC 0;
BA_ "NmNode" BU_ FICU 0;
BA_ "VFrameFormat" BO_ 2679898134 1;
BA_ "GenMsgSendType" BO_ 2679898134 0;
BA_ "GenMsgCycleTime" BO_ 2679898134 100;
BA_ "VFrameFormat" BO_ 2679898133 1;
BA_ "GenMsgSendType" BO_ 2679898133 0;
BA_ "GenMsgCycleTime" BO_ 2679898133 100;
BA_ "VFrameFormat" BO_ 2679898132 1;
BA_ "GenMsgSendType" BO_ 2679898132 0;
BA_ "GenMsgCycleTime" BO_ 2679898132 100;
BA_ "VFrameFormat" BO_ 2679898131 1;
BA_ "GenMsgCycleTime" BO_ 2679898131 100;
BA_ "GenMsgSendType" BO_ 2679898131 0;
BA_ "VFrameFormat" BO_ 2679898130 1;
BA_ "GenMsgCycleTime" BO_ 2679898130 100;
BA_ "GenMsgSendType" BO_ 2679898130 0;
BA_ "VFrameFormat" BO_ 453 14;
BA_ "GenMsgILSupport" BO_ 1729 0;
BA_ "VFrameFormat" BO_ 1729 0;
BA_ "GenMsgILSupport" BO_ 1728 0;
BA_ "VFrameFormat" BO_ 1728 0;
BA_ "GenMsgCycleTime" BO_ 48 10;
BA_ "GenMsgSendType" BO_ 48 0;
BA_ "VFrameFormat" BO_ 48 14;
BA_ "GenMsgCycleTime" BO_ 53 10;
BA_ "GenMsgSendType" BO_ 53 0;
BA_ "VFrameFormat" BO_ 53 14;
BA_ "GenMsgCycleTime" BO_ 64 10;
BA_ "GenMsgSendType" BO_ 64 0;
BA_ "VFrameFormat" BO_ 64 14;
BA_ "GenMsgCycleTime" BO_ 69 10;
BA_ "GenMsgSendType" BO_ 69 0;
BA_ "VFrameFormat" BO_ 69 14;
BA_ "GenMsgCycleTime" BO_ 74 10;
BA_ "GenMsgSendType" BO_ 74 0;
BA_ "VFrameFormat" BO_ 74 14;
BA_ "GenMsgCycleTime" BO_ 80 10;
BA_ "GenMsgSendType" BO_ 80 0;
BA_ "VFrameFormat" BO_ 80 14;
BA_ "GenMsgCycleTime" BO_ 96 10;
BA_ "GenMsgSendType" BO_ 96 0;
BA_ "VFrameFormat" BO_ 96 14;
BA_ "GenMsgCycleTime" BO_ 106 10;
BA_ "GenMsgSendType" BO_ 106 0;
BA_ "VFrameFormat" BO_ 106 14;
BA_ "GenMsgCycleTime" BO_ 160 10;
BA_ "GenMsgSendType" BO_ 160 0;
BA_ "VFrameFormat" BO_ 160 14;
BA_ "GenMsgCycleTime" BO_ 181 10;
BA_ "GenMsgSendType" BO_ 181 0;
BA_ "VFrameFormat" BO_ 181 14;
BA_ "GenMsgCycleTime" BO_ 186 10;
BA_ "GenMsgSendType" BO_ 186 0;
BA_ "VFrameFormat" BO_ 186 14;
BA_ "GenMsgCycleTime" BO_ 229 10;
BA_ "GenMsgSendType" BO_ 229 0;
BA_ "VFrameFormat" BO_ 229 14;
BA_ "GenMsgCycleTime" BO_ 234 10;
BA_ "GenMsgSendType" BO_ 234 0;
BA_ "VFrameFormat" BO_ 234 14;
BA_ "GenMsgCycleTime" BO_ 250 10;
BA_ "GenMsgSendType" BO_ 250 0;
BA_ "VFrameFormat" BO_ 250 14;
BA_ "GenMsgCycleTime" BO_ 256 10;
BA_ "GenMsgSendType" BO_ 256 0;
BA_ "VFrameFormat" BO_ 256 14;
BA_ "GenMsgCycleTime" BO_ 261 10;
BA_ "GenMsgSendType" BO_ 261 0;
BA_ "VFrameFormat" BO_ 261 14;
BA_ "GenMsgCycleTime" BO_ 266 10;
BA_ "GenMsgSendType" BO_ 266 0;
BA_ "VFrameFormat" BO_ 266 14;
BA_ "GenMsgCycleTime" BO_ 282 10;
BA_ "GenMsgSendType" BO_ 282 0;
BA_ "VFrameFormat" BO_ 282 14;
BA_ "GenMsgCycleTime" BO_ 288 10;
BA_ "GenMsgSendType" BO_ 288 0;
BA_ "VFrameFormat" BO_ 288 14;
BA_ "GenMsgCycleTime" BO_ 293 10;
BA_ "GenMsgSendType" BO_ 293 0;
BA_ "VFrameFormat" BO_ 293 14;
BA_ "VFrameFormat" BO_ 314 14;
BA_ "GenMsgCycleTime" BO_ 352 20;
BA_ "GenMsgSendType" BO_ 352 0;
BA_ "VFrameFormat" BO_ 352 14;
BA_ "GenMsgCycleTime" BO_ 362 20;
BA_ "GenMsgSendType" BO_ 362 0;
BA_ "VFrameFormat" BO_ 362 14;
BA_ "GenMsgCycleTime" BO_ 373 20;
BA_ "GenMsgSendType" BO_ 373 0;
BA_ "VFrameFormat" BO_ 373 14;
BA_ "GenMsgCycleTime" BO_ 384 30;
BA_ "GenMsgSendType" BO_ 384 0;
BA_ "VFrameFormat" BO_ 384 14;
BA_ "GenMsgCycleTime" BO_ 385 30;
BA_ "GenMsgSendType" BO_ 385 0;
BA_ "VFrameFormat" BO_ 385 14;
BA_ "GenMsgCycleTime" BO_ 386 30;
BA_ "GenMsgSendType" BO_ 386 0;
BA_ "VFrameFormat" BO_ 386 14;
BA_ "GenMsgCycleTime" BO_ 387 30;
BA_ "GenMsgSendType" BO_ 387 0;
BA_ "VFrameFormat" BO_ 387 14;
BA_ "UserSigValidity" SG_ 3221225472 USM_SccDrvSetReq 3;
BA_ "Description" SG_ 3221225472 USM_SccDrvSetReq "This signal is used for a request to set the value of USM Menus. This signal requests to change SCC driving mode.



When this signal change, the message (CLU14) is sent 3 times.";
BA_ "Version" SG_ 3221225472 USM_SccDrvSetReq "17.11.00";
BA_ "GenSigStartValue" SG_ 453 EMS_CyclicRedundancyCheck11Value 65535;
BA_ "UserSigValidity" SG_ 48 DCT_AccelPdlVal 3;
BA_ "RoutingFactor" SG_ 48 DCT_AccelPdlVal 5;
BA_ "Description" SG_ 48 DCT_AccelPdlVal "The signal PV_AV_CAN is a measure of the Accelerator Pedal value.

The accelerator pedal value is determined via 2 pedal sensors, which are connected mechanically to the

accelerator pedal. If the EMS-ECU recognizes that the accelerator pedal is not acti";
BA_ "Version" SG_ 48 DCT_AccelPdlVal "18.01.03";
BA_ "UserSigValidity" SG_ 48 DCT_EngSpdVal 3;
BA_ "RoutingFactor" SG_ 48 DCT_EngSpdVal 5;
BA_ "Description" SG_ 48 DCT_EngSpdVal "The signal N is generated by crankshaft segment period measurement (in case of an six-cylinder engine, this corresponds to a crankshaft angle of 120°) and measured with a resolution of 4 us.

The signal N is represented as a 16 bit value.



The signal ";
BA_ "Version" SG_ 48 DCT_EngSpdVal "17.11.00";
BA_ "UserSigValidity" SG_ 48 DCT_EngSpdErrSta 3;
BA_ "RoutingFactor" SG_ 48 DCT_EngSpdErrSta 5;
BA_ "Description" SG_ 48 DCT_EngSpdErrSta "The signal F_N_ENG identifies an error on searching for a long tooth or on engine speed sensing.

Note : in some cases a limp-home function can be activated in the ECU (the engine speed signal is then based on the camshaft signal), and the engine may run";
BA_ "Version" SG_ 48 DCT_EngSpdErrSta "17.11.00";
BA_ "UserSigValidity" SG_ 48 DCT_CrctEngTqVal 3;
BA_ "RoutingFactor" SG_ 48 DCT_CrctEngTqVal 5;
BA_ "Description" SG_ 48 DCT_CrctEngTqVal "The signal TQI_ACOR comprises the actual indicated engine torque (determined by calculation within the engine management system) (lambda control, knock control, catalyst overheating prevention function, temperature influences, TCS, TCU torque interventio";
BA_ "Version" SG_ 48 DCT_CrctEngTqVal "18.01.03";
BA_ "UserSigValidity" SG_ 53 VCU_GearSelDis 5;
BA_ "GenSigStartValue" SG_ 53 VCU_GearSelDis 9;
BA_ "RoutingFactor" SG_ 53 VCU_GearSelDis 5;
BA_ "Description" SG_ 53 VCU_GearSelDis "gear selector display";
BA_ "Version" SG_ 53 VCU_GearSelDis "17.11.00";
BA_ "UserSigValidity" SG_ 53 VCU_AccelPdlDpthPcVal 5;
BA_ "RoutingFactor" SG_ 53 VCU_AccelPdlDpthPcVal 5;
BA_ "Description" SG_ 53 VCU_AccelPdlDpthPcVal "Accelerator Pedal value";
BA_ "Version" SG_ 53 VCU_AccelPdlDpthPcVal "17.11.00";
BA_ "UserSigValidity" SG_ 53 VCU_EVRdySta 5;
BA_ "RoutingFactor" SG_ 53 VCU_EVRdySta 5;
BA_ "Description" SG_ 53 VCU_EVRdySta "EV Ready";
BA_ "Version" SG_ 53 VCU_EVRdySta "17.11.00";
BA_ "UserSigValidity" SG_ 64 TCU_Crc1Val 3;
BA_ "GenSigStartValue" SG_ 64 TCU_Crc1Val 65535;
BA_ "RoutingFactor" SG_ 64 TCU_Crc1Val 5;
BA_ "Description" SG_ 64 TCU_Crc1Val "The CRC checking process calculates the CRC over the entire data block, including the CRC result.

- CRC Polynomial (0x1021) , Initial Value : 0xFFFF, XOR value : 0x0000

- The mathematical expression to 16 bit CRC polynomial is given here. G(x) = x16 + ";
BA_ "Version" SG_ 64 TCU_Crc1Val "17.11.00";
BA_ "UserSigValidity" SG_ 64 TCU_AlvCnt1Val 3;
BA_ "RoutingFactor" SG_ 64 TCU_AlvCnt1Val 5;
BA_ "Description" SG_ 64 TCU_AlvCnt1Val "For the first transmission request for a data element the counter shall be initialized with 0 and shall be incremented by 1

for every subsequent send request. When the counter reaches the maximum value(0xFF), then it shall restart with – for the next ";
BA_ "Version" SG_ 64 TCU_AlvCnt1Val "17.11.00";
BA_ "UserSigValidity" SG_ 64 TCU_GearSlctDis 3;
BA_ "GenSigStartValue" SG_ 64 TCU_GearSlctDis 9;
BA_ "RoutingFactor" SG_ 64 TCU_GearSlctDis 5;
BA_ "Description" SG_ 64 TCU_GearSlctDis "Position (P, R, N..), which was identified by the gear selector.

In case the gear selector is in a intermediate position, the last clear recognized position is used.

There is no specific phase relationship between the output and any other signal.";
BA_ "Version" SG_ 64 TCU_GearSlctDis "17.11.00";
BA_ "UserSigValidity" SG_ 64 TCU_CurrGearSta 3;
BA_ "RoutingFactor" SG_ 64 TCU_CurrGearSta 5;
BA_ "Description" SG_ 64 TCU_CurrGearSta "CUR_GR indicates the gear speed which is currently engaged in the gearbox.";
BA_ "Version" SG_ 64 TCU_CurrGearSta "17.11.00";
BA_ "UserSigValidity" SG_ 64 TCU_TrgtGearSta 3;
BA_ "RoutingFactor" SG_ 64 TCU_TrgtGearSta 5;
BA_ "Description" SG_ 64 TCU_TrgtGearSta "CF_Tcu_TarGr informs about the speed, which is currently engaged in the gearbox, or, in case of a gear change (SWI_GS), which speed is reached.



Note: Gear changes covering more than one speed are also possible.

In the P and N positions, the frictiona";
BA_ "Version" SG_ 64 TCU_TrgtGearSta "17.11.00";
BA_ "UserSigValidity" SG_ 64 TCH_EngTrgtGearSta 3;
BA_ "RoutingFactor" SG_ 64 TCH_EngTrgtGearSta 5;
BA_ "Description" SG_ 64 TCH_EngTrgtGearSta "TCH_EngTrgtGearSta informs about target gear of SS timing 

(For indicating Paddle shift or Manual mode on cluster)



";
BA_ "Version" SG_ 64 TCH_EngTrgtGearSta "17.11.00";
BA_ "UserSigValidity" SG_ 64 TCU_GearLmpBlnkngReq 3;
BA_ "RoutingFactor" SG_ 64 TCU_GearLmpBlnkngReq 5;
BA_ "Description" SG_ 64 TCU_GearLmpBlnkngReq "Cluster controls blinking of Gear lamp receiving the request signal from TCU.";
BA_ "Version" SG_ 64 TCU_GearLmpBlnkngReq "17.11.00";
BA_ "UserSigValidity" SG_ 64 TCU_SmrtShftSta 3;
BA_ "RoutingFactor" SG_ 64 TCU_SmrtShftSta 5;
BA_ "Description" SG_ 64 TCU_SmrtShftSta "Information of SmartShift ";
BA_ "Version" SG_ 64 TCU_SmrtShftSta "17.11.00";
BA_ "UserSigValidity" SG_ 69 HTCU_GearSlctrDis 7;
BA_ "GenSigStartValue" SG_ 69 HTCU_GearSlctrDis 9;
BA_ "RoutingFactor" SG_ 69 HTCU_GearSlctrDis 5;
BA_ "Description" SG_ 69 HTCU_GearSlctrDis "Position (P, R, N..), which was identified by the gear selector.

In case the gear selector is in a intermediate position, the last clear recognized position is used.

There is no specific phase relationship between the output and any other signal.";
BA_ "Version" SG_ 69 HTCU_GearSlctrDis "17.11.00";
BA_ "UserSigValidity" SG_ 74 YRS_Crc1Val 3;
BA_ "GenSigStartValue" SG_ 74 YRS_Crc1Val 65535;
BA_ "RoutingFactor" SG_ 74 YRS_Crc1Val 5;
BA_ "Description" SG_ 74 YRS_Crc1Val "The CRC checking process calculates the CRC over the entire data block, including the CRC result.

- CRC Polynomial (0x1021) , Initial Value : 0xFFFF, XOR value : 0x0000

- The mathematical expression to 16 bit CRC polynomial is given here. G(x) = x16 + ";
BA_ "Version" SG_ 74 YRS_Crc1Val "17.12.03";
BA_ "UserSigValidity" SG_ 74 YRS_AlvCnt1Val 3;
BA_ "RoutingFactor" SG_ 74 YRS_AlvCnt1Val 5;
BA_ "Description" SG_ 74 YRS_AlvCnt1Val "For the first transmission request for a data element the counter shall be initialized with 0 and shall be incremented by 1

for every subsequent send request. When the counter reaches the maximum value(0xFF), then it shall restart with – for the next ";
BA_ "Version" SG_ 74 YRS_AlvCnt1Val "17.12.03";
BA_ "UserSigValidity" SG_ 74 YRS_YawSigSta 3;
BA_ "GenSigStartValue" SG_ 74 YRS_YawSigSta 2;
BA_ "RoutingFactor" SG_ 74 YRS_YawSigSta 5;
BA_ "Description" SG_ 74 YRS_YawSigSta "This signal indicates failure status of yaw rate signal and yaw rate sensing element.



0000B : No failure 



xxx1B : Yrs_Yr failure



xx1xB : Initialization is running



x1xxB : Reserved



1xxxB : Reserved



This signal represents the physical err";
BA_ "Version" SG_ 74 YRS_YawSigSta "18.02.01";
BA_ "UserSigValidity" SG_ 74 YRS_LatAccelSigSta 3;
BA_ "GenSigStartValue" SG_ 74 YRS_LatAccelSigSta 2;
BA_ "RoutingFactor" SG_ 74 YRS_LatAccelSigSta 5;
BA_ "Description" SG_ 74 YRS_LatAccelSigSta "This signal indicates failure status of lateral acceleration signal and sensing element.



0000B : No failure



xxx1B : Yrs_LatAc failure



xx1xB : Initialization is running



x1xxB : Reserved



1xxxB : Reserved



This signal represents the physica";
BA_ "Version" SG_ 74 YRS_LatAccelSigSta "18.02.01";
BA_ "UserSigValidity" SG_ 74 YRS_LongAccelSigSta 3;
BA_ "GenSigStartValue" SG_ 74 YRS_LongAccelSigSta 2;
BA_ "RoutingFactor" SG_ 74 YRS_LongAccelSigSta 5;
BA_ "Description" SG_ 74 YRS_LongAccelSigSta "This signal indicates failure status of longitudinal acceleration signal and sensing element.



0000B : No failure 



xxx1B : Yrs_LongAc failure



xx1xB : Initialization is running



x1xxB : Reserved



1xxxB : Reserved



This signal represents the ";
BA_ "Version" SG_ 74 YRS_LongAccelSigSta "18.02.01";
BA_ "UserSigValidity" SG_ 74 YRS_YawRtVal 3;
BA_ "GenSigStartValue" SG_ 74 YRS_YawRtVal 32768;
BA_ "RoutingFactor" SG_ 74 YRS_YawRtVal 5;
BA_ "Description" SG_ 74 YRS_YawRtVal "This signal indicates Information regarding yaw rate.



physical range : -163.84..163.83 ˚/s = 0000H..FFFEh



Conversion : (PH) = ((HEX)-8000H)*0.005[˚/s/digit]



                            = (HEX)*0.005[˚/s/digit] - 163.84[˚/s]



              ";
BA_ "Version" SG_ 74 YRS_YawRtVal "18.02.01";
BA_ "UserSigValidity" SG_ 74 YRS_LatAccelVal 3;
BA_ "GenSigStartValue" SG_ 74 YRS_LatAccelVal 32768;
BA_ "RoutingFactor" SG_ 74 YRS_LatAccelVal 5;
BA_ "Description" SG_ 74 YRS_LatAccelVal "This signal indicates Information regarding lateral acceleration.



physical range : -4.1768g..4.1765g = 0000H..FFFEh



Conversion : (PH) = ((HEX)-8000H)*0.000127465[g/digit]



                            = (HEX)*0.000127465[g/digit] - 4.17677312[g]

";
BA_ "Version" SG_ 74 YRS_LatAccelVal "18.02.01";
BA_ "UserSigValidity" SG_ 74 YRS_LongAccelVal 3;
BA_ "GenSigStartValue" SG_ 74 YRS_LongAccelVal 32768;
BA_ "RoutingFactor" SG_ 74 YRS_LongAccelVal 5;
BA_ "Description" SG_ 74 YRS_LongAccelVal "This signal indicates information regarding longitudinal acceleration.



physical range : -4.1768g..4.1765g = 0000H..FFFEh



Conversion : (PH) = ((HEX)-8000H)*0.000127465[g/digit]



                            = (HEX)*0.000127465[g/digit] - 4.17677312";
BA_ "Version" SG_ 74 YRS_LongAccelVal "18.02.01";
BA_ "UserSigValidity" SG_ 80 ADAS_CMD_30_Crc01Val 3;
BA_ "GenSigStartValue" SG_ 80 ADAS_CMD_30_Crc01Val 65535;
BA_ "Description" SG_ 80 ADAS_CMD_30_Crc01Val "The CRC checking process calculates the CRC over the entire data block, including the CRC result CRC Polynomial (0x1021) ,

Initial Value : 0xFFFF, XOR value : 0x0000

The mathematical expression to 16 bit CRC polynomial is given here. G(x) = x16 + x12 +";
BA_ "Version" SG_ 80 ADAS_CMD_30_Crc01Val "18.03.03";
BA_ "UserSigValidity" SG_ 80 ADAS_CMD_30_AlvCnt01Val 3;
BA_ "Description" SG_ 80 ADAS_CMD_30_AlvCnt01Val "For the first transmission request for a data element the counter shall be initialized with 0 and shall be incremented by 1

for every subsequent send request. When the counter reaches the maximum value(0xFF), then it shall restart with – for the next ";
BA_ "Version" SG_ 80 ADAS_CMD_30_AlvCnt01Val "18.03.03";
BA_ "UserSigValidity" SG_ 80 LKA_OptUsmSta_Copy_1 3;
BA_ "Version" SG_ 80 LKA_OptUsmSta_Copy_1 "18.03.02";
BA_ "UserSigValidity" SG_ 80 LKA_RcgSta_Copy_1 3;
BA_ "Version" SG_ 80 LKA_RcgSta_Copy_1 "18.03.02";
BA_ "UserSigValidity" SG_ 80 LKA_LHLnWrnSta_Copy_1 3;
BA_ "Version" SG_ 80 LKA_LHLnWrnSta_Copy_1 "18.03.02";
BA_ "UserSigValidity" SG_ 80 LKA_RHLnWrnSta_Copy_1 3;
BA_ "Version" SG_ 80 LKA_RHLnWrnSta_Copy_1 "18.03.02";
BA_ "UserSigValidity" SG_ 80 LKA_HndsoffSnd_Copy_1 3;
BA_ "Version" SG_ 80 LKA_HndsoffSnd_Copy_1 "18.03.02";
BA_ "UserSigValidity" SG_ 80 LKA_StrSnd_Copy_1 3;
BA_ "Version" SG_ 80 LKA_StrSnd_Copy_1 "18.03.02";
BA_ "UserSigValidity" SG_ 80 LKA_SysIndReq_Copy_1 3;
BA_ "Version" SG_ 80 LKA_SysIndReq_Copy_1 "18.03.02";
BA_ "UserSigValidity" SG_ 80 LKA_StrTqReqVal_Copy_1 3;
BA_ "GenSigStartValue" SG_ 80 LKA_StrTqReqVal_Copy_1 1024;
BA_ "Description" SG_ 80 LKA_StrTqReqVal_Copy_1 "This is the driver torque overlay demand value. A negative value represents a torque that would accelerate the steering wheel in a clockwise direction. This signal is always zero whilst the TOI is inactive.";
BA_ "Version" SG_ 80 LKA_StrTqReqVal_Copy_1 "18.03.02";
BA_ "UserSigValidity" SG_ 80 LKA_ActToiSta_Copy_1 3;
BA_ "Description" SG_ 80 LKA_ActToiSta_Copy_1 "This is a flag that is set to 1 when requesting the steering to activate the torque overlay interface (TOI).  This must be done before an attempt is made to request non-zero steering torque overlay.";
BA_ "Version" SG_ 80 LKA_ActToiSta_Copy_1 "18.03.02";
BA_ "UserSigValidity" SG_ 80 LKA_ToiFltSta_Copy_1 3;
BA_ "Description" SG_ 80 LKA_ToiFltSta_Copy_1 "This fault flag is set when a fault in the LKA system has been detected by the LKA ECU such that LKA can no longer function. CAN failures, internal video ECU failures, hard-wired component (e.g. master switch) failures and other system logic failures are";
BA_ "Version" SG_ 80 LKA_ToiFltSta_Copy_1 "18.03.02";
BA_ "UserSigValidity" SG_ 80 LKA_SysWrn_Copy_1 3;
BA_ "Description" SG_ 80 LKA_SysWrn_Copy_1 "A signal that provides additional information on the operation of the LKA system for the HMI to display to the driver. This includes additional fault information, reasons for unavailability of the system and additional warnings like the hands-off warning";
BA_ "Version" SG_ 80 LKA_SysWrn_Copy_1 "18.04.00";
BA_ "UserSigValidity" SG_ 80 LKA_UsmMod_Copy_1 3;
BA_ "Description" SG_ 80 LKA_UsmMod_Copy_1 "This signal indicates LKA USM Mode";
BA_ "Version" SG_ 80 LKA_UsmMod_Copy_1 "18.04.00";
BA_ "UserSigValidity" SG_ 80 Info_PedtrnDst_Copy_1 3;
BA_ "Description" SG_ 80 Info_PedtrnDst_Copy_1 "Distance of the nearest pedestrian";
BA_ "Version" SG_ 80 Info_PedtrnDst_Copy_1 "18.04.00";
BA_ "UserSigValidity" SG_ 96 ABS_DfctvSta 3;
BA_ "RoutingFactor" SG_ 96 ABS_DfctvSta 5;
BA_ "Description" SG_ 96 ABS_DfctvSta "Information regarding the ABS 'defective' indication.";
BA_ "Version" SG_ 96 ABS_DfctvSta "17.12.00";
BA_ "UserSigValidity" SG_ 96 ABS_ActvSta 3;
BA_ "RoutingFactor" SG_ 96 ABS_ActvSta 5;
BA_ "Description" SG_ 96 ABS_ActvSta "ABS controller provides an information on ABS Active signal.



ABS_ACT signal is 1 during the ABS control and if it is not ABS control phase this value is 0.

";
BA_ "Version" SG_ 96 ABS_ActvSta "17.12.00";
BA_ "UserSigValidity" SG_ 96 ABS_DiagSta 3;
BA_ "RoutingFactor" SG_ 96 ABS_DiagSta 5;
BA_ "Description" SG_ 96 ABS_DiagSta "Information regarding the ABS/TCS/ESC “diagnostic mode” indication.";
BA_ "Version" SG_ 96 ABS_DiagSta "17.12.00";
BA_ "UserSigValidity" SG_ 96 EBD_DfctvSta 3;
BA_ "RoutingFactor" SG_ 96 EBD_DfctvSta 5;
BA_ "Description" SG_ 96 EBD_DfctvSta "Information regarding the EBD  'defective' indication.";
BA_ "Version" SG_ 96 EBD_DfctvSta "17.12.00";
BA_ "UserSigValidity" SG_ 96 TCS_LmpSta 3;
BA_ "RoutingFactor" SG_ 96 TCS_LmpSta 5;
BA_ "Description" SG_ 96 TCS_LmpSta "The signal indicates the status of the “TCS/ESC Function/Warning Lamp”";
BA_ "Version" SG_ 96 TCS_LmpSta "17.12.00";
BA_ "UserSigValidity" SG_ 96 TCS_DisableSta 3;
BA_ "RoutingFactor" SG_ 96 TCS_DisableSta 5;
BA_ "Description" SG_ 96 TCS_DisableSta "Information regarding the TCS 'enable/disable' indication.



Conversion :

1. TCS_DEF(0)/TCS_PAS(0)/TCS_CTL(0) -> TCS lamp OFF

2. TCS_DEF(0)/TCS_PAS(0)/TCS_CTL(1) -> TCS Active

3. TCS_DEF(0)/TCS_PAS(1)/TCS_CTL(x) -> TCS is disabled by user

4. TCS_DEF";
BA_ "Version" SG_ 96 TCS_DisableSta "17.12.00";
BA_ "UserSigValidity" SG_ 96 TCS_DfctvSta 3;
BA_ "RoutingFactor" SG_ 96 TCS_DfctvSta 5;
BA_ "Description" SG_ 96 TCS_DfctvSta "Information regarding the TCS 'defective' indication.



Conversion :

1. TCS_DEF(0)/TCS_PAS(0)/TCS_CTL(0) -> TCS lamp OFF

2. TCS_DEF(0)/TCS_PAS(0)/TCS_CTL(1) -> TCS Active

3. TCS_DEF(0)/TCS_PAS(1)/TCS_CTL(x) -> TCS is disabled by user

4. TCS_DEF(1)/T";
BA_ "Version" SG_ 96 TCS_DfctvSta "17.12.00";
BA_ "UserSigValidity" SG_ 96 TCS_CtrlSta 3;
BA_ "RoutingFactor" SG_ 96 TCS_CtrlSta 5;
BA_ "Description" SG_ 96 TCS_CtrlSta "Information regarding the TCS 'control' indication.



Conversion :

1. TCS_DEF(0)/TCS_PAS(0)/TCS_CTL(0) -> TCS lamp OFF

2. TCS_DEF(0)/TCS_PAS(0)/TCS_CTL(1) -> TCS Active

3. TCS_DEF(0)/TCS_PAS(1)/TCS_CTL(x) -> TCS is disabled by user

4. TCS_DEF(1)/TCS";
BA_ "Version" SG_ 96 TCS_CtrlSta "17.12.00";
BA_ "UserSigValidity" SG_ 96 ESC_DisableSta 3;
BA_ "RoutingFactor" SG_ 96 ESC_DisableSta 5;
BA_ "Description" SG_ 96 ESC_DisableSta "Information regarding the ESC 'enable/disable' indication.



Conversion:

1. ESP_DEF(0)/ESP_PAS(0)/ESP_CTL(0) -> ESC lamp OFF

2. ESP_DEF(0)/ESP_PAS(0)/ESP_CTL(1) -> ESC active

3. ESP_DEF(0)/ESP_PAS(1)/ESP_CTL(x) -> ESC disabled by user (SW off)

4. ES";
BA_ "Version" SG_ 96 ESC_DisableSta "18.03.06";
BA_ "UserSigValidity" SG_ 96 ESC_DfctvSta 3;
BA_ "RoutingFactor" SG_ 96 ESC_DfctvSta 5;
BA_ "Description" SG_ 96 ESC_DfctvSta "Information regarding the ESC 'defective' indication.



Conversion:

1. ESP_DEF(0)/ESP_PAS(0)/ESP_CTL(0) -> ESC lamp OFF

2. ESP_DEF(0)/ESP_PAS(0)/ESP_CTL(1) -> ESC active

3. ESP_DEF(0)/ESP_PAS(1)/ESP_CTL(x) -> ESC disabled by user (SW off)

4. ESP_DEF";
BA_ "Version" SG_ 96 ESC_DfctvSta "17.12.00";
BA_ "UserSigValidity" SG_ 96 ESC_CtrlSta 3;
BA_ "RoutingFactor" SG_ 96 ESC_CtrlSta 5;
BA_ "Description" SG_ 96 ESC_CtrlSta "Information regarding the ESC 'control' indication.



Conversion:

1. ESP_DEF(0)/ESP_PAS(0)/ESP_CTL(0) -> ESC lamp OFF

2. ESP_DEF(0)/ESP_PAS(0)/ESP_CTL(1) -> ESC active

3. ESP_DEF(0)/ESP_PAS(1)/ESP_CTL(x) -> ESC disabled by user (SW off)

4. ESP_DEF(1";
BA_ "Version" SG_ 96 ESC_CtrlSta "17.12.00";
BA_ "UserSigValidity" SG_ 96 TCS_Req 3;
BA_ "RoutingFactor" SG_ 96 TCS_Req 5;
BA_ "Description" SG_ 96 TCS_Req "Request for an indicated desired engine torque, the combination of signals calls, on the one hand, for a desire for charge reduction (TCS or ESC function), and, on the other hand, for a desire for charge increase (MSR function).



TCS_REQ : Identifies a";
BA_ "Version" SG_ 96 TCS_Req "17.12.00";
BA_ "UserSigValidity" SG_ 96 MSR_FuncReq 3;
BA_ "RoutingFactor" SG_ 96 MSR_FuncReq 5;
BA_ "Description" SG_ 96 MSR_FuncReq "Request for an indicated desired engine torque, the combination of signals calls, on the one hand, for a desire for charge reduction (TCS or ESC function), and, on the other hand, for a desire for charge increase (MSR function).



MSR_C_REQ : Identifies";
BA_ "Version" SG_ 96 MSR_FuncReq "17.12.00";
BA_ "UserSigValidity" SG_ 96 ESC_CylPrsrVal 3;
BA_ "RoutingFactor" SG_ 96 ESC_CylPrsrVal 5;
BA_ "Description" SG_ 96 ESC_CylPrsrVal "This signal indicates pressure of brake master cylinder and provides information how deeply  a driver is pressing brake pedal.";
BA_ "Version" SG_ 96 ESC_CylPrsrVal "17.12.00";
BA_ "UserSigValidity" SG_ 96 ESC_CylPrsrSta 3;
BA_ "GenSigStartValue" SG_ 96 ESC_CylPrsrSta 1;
BA_ "RoutingFactor" SG_ 96 ESC_CylPrsrSta 5;
BA_ "Description" SG_ 96 ESC_CylPrsrSta "This signal indicates validity of CYL_PRES signal.";
BA_ "Version" SG_ 96 ESC_CylPrsrSta "18.02.00";
BA_ "UserSigValidity" SG_ 96 ESC_CylPrsrDiagSta 3;
BA_ "GenSigStartValue" SG_ 96 ESC_CylPrsrDiagSta 1;
BA_ "RoutingFactor" SG_ 96 ESC_CylPrsrDiagSta 5;
BA_ "Description" SG_ 96 ESC_CylPrsrDiagSta "This signal indicates self-diagnosis mode of master cylinder pressure signal. During system check, master cylinder pressure information cannot be sent(not available) and this bit should be set to 1.";
BA_ "Version" SG_ 96 ESC_CylPrsrDiagSta "17.12.00";
BA_ "UserSigValidity" SG_ 96 ESC_CylPrsrFlagSta 3;
BA_ "RoutingFactor" SG_ 96 ESC_CylPrsrFlagSta 5;
BA_ "Description" SG_ 96 ESC_CylPrsrFlagSta "This signal means that the pressure of master cylinder is 15 bar or over.

(0x0 : under 15 bar, 0x1 : 15 bar or over)



This signal may be difference with actual BLS(Brake Lamp Switch) state.

So the ESC does not guarantee using this signal as substitut";
BA_ "Version" SG_ 96 ESC_CylPrsrFlagSta "17.12.00";
BA_ "UserSigValidity" SG_ 96 ESC_VsmActvSta 3;
BA_ "RoutingFactor" SG_ 96 ESC_VsmActvSta 5;
BA_ "Description" SG_ 96 ESC_VsmActvSta "ESC controller provides an information on VSM (ESC+MDPS) Active signal. It indicates VSM control is

active or inactive.";
BA_ "Version" SG_ 96 ESC_VsmActvSta "17.12.00";
BA_ "UserSigValidity" SG_ 96 ESC_LongAccelOffstCalibPrmtr 3;
BA_ "GenSigStartValue" SG_ 96 ESC_LongAccelOffstCalibPrmtr 255;
BA_ "RoutingFactor" SG_ 96 ESC_LongAccelOffstCalibPrmtr 5;
BA_ "Description" SG_ 96 ESC_LongAccelOffstCalibPrmtr "This signal indicates information regarding the calibration parameter for longitudinal acceleration value.

This signal doesn't guarantee the actual offset value.

But this signal is the result of the offset measuring process.

The allowed use of this si";
BA_ "Version" SG_ 96 ESC_LongAccelOffstCalibPrmtr "18.02.00";
BA_ "UserSigValidity" SG_ 96 AVH_Sta 3;
BA_ "RoutingFactor" SG_ 96 AVH_Sta 5;
BA_ "Description" SG_ 96 AVH_Sta "This signal indicates whether the vehicle is held with hydraulic brake (service brake).";
BA_ "Version" SG_ 96 AVH_Sta "17.12.00";
BA_ "UserSigValidity" SG_ 106 TCU_Crc2Val 3;
BA_ "GenSigStartValue" SG_ 106 TCU_Crc2Val 65535;
BA_ "RoutingFactor" SG_ 106 TCU_Crc2Val 5;
BA_ "Description" SG_ 106 TCU_Crc2Val "The CRC checking process calculates the CRC over the entire data block, including the CRC result.

- CRC Polynomial (0x1021) , Initial Value : 0xFFFF, XOR value : 0x0000

- The mathematical expression to 16 bit CRC polynomial is given here. G(x) = x16 + ";
BA_ "Version" SG_ 106 TCU_Crc2Val "17.11.00";
BA_ "UserSigValidity" SG_ 106 TCU_AlvCnt2Val 3;
BA_ "RoutingFactor" SG_ 106 TCU_AlvCnt2Val 5;
BA_ "Description" SG_ 106 TCU_AlvCnt2Val "For the first transmission request for a data element the counter shall be initialized with 0 and shall be incremented by 1

for every subsequent send request. When the counter reaches the maximum value(0xFF), then it shall restart with – for the next ";
BA_ "Version" SG_ 106 TCU_AlvCnt2Val "17.11.00";
BA_ "UserSigValidity" SG_ 106 TCU_AtTempCVal 3;
BA_ "GenSigStartValue" SG_ 106 TCU_AtTempCVal 255;
BA_ "RoutingFactor" SG_ 106 TCU_AtTempCVal 5;
BA_ "Description" SG_ 106 TCU_AtTempCVal "Transmission fluid temperature in TCU sensed via an A/D converter; 

converted into degrees centigrade (°C).";
BA_ "Version" SG_ 106 TCU_AtTempCVal "17.11.00";
BA_ "UserSigValidity" SG_ 106 TCU_TqCnvrtrSpdVal 3;
BA_ "RoutingFactor" SG_ 106 TCU_TqCnvrtrSpdVal 5;
BA_ "Description" SG_ 106 TCU_TqCnvrtrSpdVal "N_TC represents the speed of the torque converter turbine of the gearbox at gearbox-side.";
BA_ "Version" SG_ 106 TCU_TqCnvrtrSpdVal "17.11.00";
BA_ "UserSigValidity" SG_ 160 WHL_PlsFLVal 3;
BA_ "RoutingFactor" SG_ 160 WHL_PlsFLVal 5;
BA_ "Description" SG_ 160 WHL_PlsFLVal "This signal indicates accumulated pulse counter of ABS^ESC wheel speed sensor (FL^FR^RL^RR)

Receiver unit uses this signal for calculation of vehicle movement distance.

Requested resolution of this signal is 0.5 pulses and refer to below (wheel sensor ";
BA_ "Version" SG_ 160 WHL_PlsFLVal "17.12.00";
BA_ "UserSigValidity" SG_ 160 WHL_PlsFRVal 3;
BA_ "RoutingFactor" SG_ 160 WHL_PlsFRVal 5;
BA_ "Description" SG_ 160 WHL_PlsFRVal "This signal indicates accumulated pulse counter of ABS^ESC wheel speed sensor (FL^FR^RL^RR)

Receiver unit uses this signal for calculation of vehicle movement distance.

Requested resolution of this signal is 0.5 pulses and refer to below (wheel sensor ";
BA_ "Version" SG_ 160 WHL_PlsFRVal "17.12.00";
BA_ "UserSigValidity" SG_ 160 WHL_PlsRLVal 3;
BA_ "RoutingFactor" SG_ 160 WHL_PlsRLVal 5;
BA_ "Description" SG_ 160 WHL_PlsRLVal "This signal indicates accumulated pulse counter of ABS^ESC wheel speed sensor (FL^FR^RL^RR)

Receiver unit uses this signal for calculation of vehicle movement distance.

Requested resolution of this signal is 0.5 pulses and refer to below (wheel sensor ";
BA_ "Version" SG_ 160 WHL_PlsRLVal "17.12.00";
BA_ "UserSigValidity" SG_ 160 WHL_PlsRRVal 3;
BA_ "RoutingFactor" SG_ 160 WHL_PlsRRVal 5;
BA_ "Description" SG_ 160 WHL_PlsRRVal "This signal indicates accumulated pulse counter of ABS^ESC wheel speed sensor (FL^FR^RL^RR)

Receiver unit uses this signal for calculation of vehicle movement distance.

Requested resolution of this signal is 0.5 pulses and refer to below (wheel sensor ";
BA_ "Version" SG_ 160 WHL_PlsRRVal "17.12.00";
BA_ "UserSigValidity" SG_ 160 WHL_DirFLVal 3;
BA_ "RoutingFactor" SG_ 160 WHL_DirFLVal 5;
BA_ "Description" SG_ 160 WHL_DirFLVal "This signal is used to check the moving direction of WHL_PUL_FL signal.";
BA_ "Version" SG_ 160 WHL_DirFLVal "17.12.00";
BA_ "UserSigValidity" SG_ 160 WHL_DirFRVal 3;
BA_ "RoutingFactor" SG_ 160 WHL_DirFRVal 5;
BA_ "Description" SG_ 160 WHL_DirFRVal "This signal is used to check the moving direction of WHL_PUL_FR signal.";
BA_ "Version" SG_ 160 WHL_DirFRVal "17.12.00";
BA_ "UserSigValidity" SG_ 160 WHL_DirRLVal 3;
BA_ "RoutingFactor" SG_ 160 WHL_DirRLVal 5;
BA_ "Description" SG_ 160 WHL_DirRLVal "This signal is used to check the moving direction of WHL_PUL_RL signal.";
BA_ "Version" SG_ 160 WHL_DirRLVal "17.12.00";
BA_ "UserSigValidity" SG_ 160 WHL_DirRRVal 3;
BA_ "RoutingFactor" SG_ 160 WHL_DirRRVal 5;
BA_ "Description" SG_ 160 WHL_DirRRVal "This signal is used to check the moving direction of WHL_PUL_RR signal.";
BA_ "Version" SG_ 160 WHL_DirRRVal "17.12.00";
BA_ "UserSigValidity" SG_ 160 WHL_SpdFLVal 3;
BA_ "RoutingFactor" SG_ 160 WHL_SpdFLVal 5;
BA_ "Description" SG_ 160 WHL_SpdFLVal "This signal provides the wheel velocity of each wheel and have 14 bits length and a resolution of 0.03125 km^h.(This resolution is higher than that of signal in TCS5).

In case of failure of one wheel speed sensor, the value 3FFFH is used as error identi";
BA_ "Version" SG_ 160 WHL_SpdFLVal "17.12.00";
BA_ "UserSigValidity" SG_ 160 WHL_SpdFRVal 3;
BA_ "RoutingFactor" SG_ 160 WHL_SpdFRVal 5;
BA_ "Description" SG_ 160 WHL_SpdFRVal "This signal provides the wheel velocity of each wheel and have 14 bits length and a resolution of 0.03125 km^h.(This resolution is higher than that of signal in TCS5).

In case of failure of one wheel speed sensor, the value 3FFFH is used as error identi";
BA_ "Version" SG_ 160 WHL_SpdFRVal "17.12.00";
BA_ "UserSigValidity" SG_ 160 WHL_SpdRLVal 3;
BA_ "RoutingFactor" SG_ 160 WHL_SpdRLVal 5;
BA_ "Description" SG_ 160 WHL_SpdRLVal "This signal provides the wheel velocity of each wheel and have 14 bits length and a resolution of 0.03125 km^h.(This resolution is higher than that of signal in TCS5).

In case of failure of one wheel speed sensor, the value 3FFFH is used as error identi";
BA_ "Version" SG_ 160 WHL_SpdRLVal "17.12.00";
BA_ "UserSigValidity" SG_ 160 WHL_SpdRRVal 3;
BA_ "RoutingFactor" SG_ 160 WHL_SpdRRVal 5;
BA_ "Description" SG_ 160 WHL_SpdRRVal "This signal provides the wheel velocity of each wheel and have 14 bits length and a resolution of 0.03125 km^h.(This resolution is higher than that of signal in TCS5).

In case of failure of one wheel speed sensor, the value 3FFFH is used as error identi";
BA_ "Version" SG_ 160 WHL_SpdRRVal "17.12.00";
BA_ "UserSigValidity" SG_ 181 ENG_EngSpdErrSta 3;
BA_ "RoutingFactor" SG_ 181 ENG_EngSpdErrSta 5;
BA_ "Description" SG_ 181 ENG_EngSpdErrSta "This signal identifies an error on searching for a long tooth or on engine speed sensing.

Note : in some cases a limp-home function can be activated in the ECU (the engine speed signal is then based on the camshaft signal), and the engine may run even i";
BA_ "Version" SG_ 181 ENG_EngSpdErrSta "17.12.00";
BA_ "UserSigValidity" SG_ 181 ENG_IsgSta 3;
BA_ "RoutingFactor" SG_ 181 ENG_IsgSta 5;
BA_ "Description" SG_ 181 ENG_IsgSta "1. ISG Status expressing CAN message divided by CF_EMS_IsgStat and CF_EMS_IsgStat2 

2. In EMS , CF_EMS_IsgStat and CF_EMS_IsgStat2 do not duplicate the output condition

(EX: If CF_EMS_IsgStat is 01h~07h, CF_EMS_IsgStat2 is 00h)



0x0:ISG is not operat";
BA_ "Version" SG_ 181 ENG_IsgSta "17.12.02";
BA_ "UserSigValidity" SG_ 181 ENG_IgnOnSta 3;
BA_ "GenSigStartValue" SG_ 181 ENG_IgnOnSta 1;
BA_ "RoutingFactor" SG_ 181 ENG_IgnOnSta 5;
BA_ "Description" SG_ 181 ENG_IgnOnSta "Status of ignition lock.";
BA_ "Version" SG_ 181 ENG_IgnOnSta "17.12.00";
BA_ "UserSigValidity" SG_ 181 ENG_EngSpdVal 3;
BA_ "RoutingFactor" SG_ 181 ENG_EngSpdVal 5;
BA_ "Description" SG_ 181 ENG_EngSpdVal "This signal is generated by crankshaft segment period measurement (in case of an six-cylinder engine, this corresponds to a crankshaft angle of 120°) and measured with a resolution of 4 us.

This signal is represented as a 16 bit value.



The signal is";
BA_ "Version" SG_ 181 ENG_EngSpdVal "17.12.00";
BA_ "UserSigValidity" SG_ 181 ENG_VehSpdHiVal 3;
BA_ "RoutingFactor" SG_ 181 ENG_VehSpdHiVal 5;
BA_ "Description" SG_ 181 ENG_VehSpdHiVal "This signal provides the one wheel velocity with resolution of 1 km/h,

and have 9 bits lengh.

In case of failure of sheel speed sensor, the value 1FF is used as error identifier";
BA_ "Version" SG_ 181 ENG_VehSpdHiVal "18.01.01";
BA_ "UserSigValidity" SG_ 186 HCU_HevRdySta 3;
BA_ "RoutingFactor" SG_ 186 HCU_HevRdySta 5;
BA_ "Description" SG_ 186 HCU_HevRdySta "Hybrid Vehicle Drivable ready";
BA_ "Version" SG_ 186 HCU_HevRdySta "17.11.00";
BA_ "UserSigValidity" SG_ 186 HCU_SccEnblSta 3;
BA_ "RoutingFactor" SG_ 186 HCU_SccEnblSta 5;
BA_ "Description" SG_ 186 HCU_SccEnblSta "Smart Cruise Control Enable";
BA_ "Version" SG_ 186 HCU_SccEnblSta "17.11.00";
BA_ "UserSigValidity" SG_ 229 ESC_YawSigSta 3;
BA_ "GenSigStartValue" SG_ 229 ESC_YawSigSta 2;
BA_ "RoutingFactor" SG_ 229 ESC_YawSigSta 5;
BA_ "Description" SG_ 229 ESC_YawSigSta "This signal indicates failure status of yaw rate signal and yaw rate sensing element.



0000B : No failure 



xxx1B : Yrs_Yr failure



xx1xB : Initialization is running



x1xxB : Reserved



1xxxB : Reserved";
BA_ "Version" SG_ 229 ESC_YawSigSta "17.11.00";
BA_ "UserSigValidity" SG_ 229 ESC_LatAccelSigSta 3;
BA_ "GenSigStartValue" SG_ 229 ESC_LatAccelSigSta 2;
BA_ "RoutingFactor" SG_ 229 ESC_LatAccelSigSta 5;
BA_ "Description" SG_ 229 ESC_LatAccelSigSta "This signal indicates failure status of lateral acceleration signal and sensing element.



0000B : No failure



xxx1B : Yrs_LatAc failure



xx1xB : Initialization is running



x1xxB : Reserved



1xxxB : Reserved";
BA_ "Version" SG_ 229 ESC_LatAccelSigSta "17.11.00";
BA_ "UserSigValidity" SG_ 229 ESC_LongAccelSigSta 3;
BA_ "GenSigStartValue" SG_ 229 ESC_LongAccelSigSta 2;
BA_ "RoutingFactor" SG_ 229 ESC_LongAccelSigSta 5;
BA_ "Description" SG_ 229 ESC_LongAccelSigSta "This signal indicates failure status of longitudinal acceleration signal and sensing element.



0000B : No failure 



xxx1B : Yrs_LongAc failure



xx1xB : Initialization is running



x1xxB : Reserved



1xxxB : Reserved";
BA_ "Version" SG_ 229 ESC_LongAccelSigSta "17.11.00";
BA_ "UserSigValidity" SG_ 229 ESC_YawRtVal 3;
BA_ "GenSigStartValue" SG_ 229 ESC_YawRtVal 32768;
BA_ "RoutingFactor" SG_ 229 ESC_YawRtVal 5;
BA_ "Description" SG_ 229 ESC_YawRtVal "This signal indicates Information regarding yaw rate.



physical range : -163.84..163.83 ˚/s = 0000H..FFFEh



Conversion : (PH) = ((HEX)-8000H)*0.005[˚/s/digit]



                            = (HEX)*0.005[˚/s/digit] - 163.84[˚/s]



              ";
BA_ "Version" SG_ 229 ESC_YawRtVal "17.11.00";
BA_ "UserSigValidity" SG_ 229 ESC_LatAccelVal 3;
BA_ "GenSigStartValue" SG_ 229 ESC_LatAccelVal 32768;
BA_ "RoutingFactor" SG_ 229 ESC_LatAccelVal 5;
BA_ "Description" SG_ 229 ESC_LatAccelVal "This signal indicates Information regarding lateral acceleration.



physical range : -4.1768g..4.1765g = 0000H..FFFEh



Conversion : (PH) = ((HEX)-8000H)*0.000127465[g/digit]



                            = (HEX)*0.000127465[g/digit] - 4.17677312[g]

";
BA_ "Version" SG_ 229 ESC_LatAccelVal "17.11.00";
BA_ "UserSigValidity" SG_ 229 ESC_LongAccelVal 3;
BA_ "GenSigStartValue" SG_ 229 ESC_LongAccelVal 32768;
BA_ "RoutingFactor" SG_ 229 ESC_LongAccelVal 5;
BA_ "Description" SG_ 229 ESC_LongAccelVal "This signal indicates information regarding longitudinal acceleration.



physical range : -4.1768g..4.1765g = 0000H..FFFEh



Conversion : (PH) = ((HEX)-8000H)*0.000127465[g/digit]



                            = (HEX)*0.000127465[g/digit] - 4.17677312";
BA_ "Version" SG_ 229 ESC_LongAccelVal "17.11.00";
BA_ "UserSigValidity" SG_ 234 MDPS_Crc1Val 3;
BA_ "GenSigStartValue" SG_ 234 MDPS_Crc1Val 65535;
BA_ "RoutingFactor" SG_ 234 MDPS_Crc1Val 5;
BA_ "Description" SG_ 234 MDPS_Crc1Val "The CRC checking process calculates the CRC over the entire data block, including the CRC result.

- CRC Polynomial (0x1021) , Initial Value : 0xFFFF, XOR value : 0x0000

- The mathematical expression to 16 bit CRC polynomial is given here. G(x) = x16 + ";
BA_ "Version" SG_ 234 MDPS_Crc1Val "17.12.00";
BA_ "UserSigValidity" SG_ 234 MDPS_AlvCnt1Val 3;
BA_ "RoutingFactor" SG_ 234 MDPS_AlvCnt1Val 5;
BA_ "Description" SG_ 234 MDPS_AlvCnt1Val "For the first transmission request for a data element the counter shall be initialized with 0 and shall be incremented by 1

for every subsequent send request. When the counter reaches the maximum value(0xFF), then it shall restart with – for the next ";
BA_ "Version" SG_ 234 MDPS_AlvCnt1Val "17.12.00";
BA_ "UserSigValidity" SG_ 234 MDPS_Typ 3;
BA_ "RoutingFactor" SG_ 234 MDPS_Typ 5;
BA_ "Description" SG_ 234 MDPS_Typ "Information regarding the type of MDPS. (C-MDPS / R-MDPS)";
BA_ "Version" SG_ 234 MDPS_Typ "17.12.00";
BA_ "UserSigValidity" SG_ 234 MDPS_PaModeSta 3;
BA_ "GenSigStartValue" SG_ 234 MDPS_PaModeSta 1;
BA_ "RoutingFactor" SG_ 234 MDPS_PaModeSta 5;
BA_ "Description" SG_ 234 MDPS_PaModeSta "This signal indicates the status of the PA steering function.";
BA_ "Version" SG_ 234 MDPS_PaModeSta "17.12.00";
BA_ "UserSigValidity" SG_ 234 MDPS_LkaPlgInSta 3;
BA_ "RoutingFactor" SG_ 234 MDPS_LkaPlgInSta 5;
BA_ "Description" SG_ 234 MDPS_LkaPlgInSta "This signal indicates whether the LKA function of MDPS is plugged in or not.

";
BA_ "Version" SG_ 234 MDPS_LkaPlgInSta "17.12.00";
BA_ "UserSigValidity" SG_ 234 MDPS_LkaToiActvSta 3;
BA_ "RoutingFactor" SG_ 234 MDPS_LkaToiActvSta 5;
BA_ "Description" SG_ 234 MDPS_LkaToiActvSta "This flag is set to 1 in response to the LKA Controller requesting the activation of the torque interface and set back to 0 in response to the LKA Controller requesting the de-activation of the torque interface.";
BA_ "Version" SG_ 234 MDPS_LkaToiActvSta "17.12.00";
BA_ "UserSigValidity" SG_ 234 MDPS_LkaToiUnblSta 3;
BA_ "RoutingFactor" SG_ 234 MDPS_LkaToiUnblSta 5;
BA_ "Description" SG_ 234 MDPS_LkaToiUnblSta "This is a flag that is set when the MDPS is not faulty, but is temporarily unable to activate the TOI due to steering torque limiting e.g. when the supply voltage is too low.";
BA_ "Version" SG_ 234 MDPS_LkaToiUnblSta "17.12.00";
BA_ "UserSigValidity" SG_ 234 MDPS_LkaToiFltSta 3;
BA_ "RoutingFactor" SG_ 234 MDPS_LkaToiFltSta 5;
BA_ "Description" SG_ 234 MDPS_LkaToiFltSta "This fault flag is set when a fault within the MDPS system has been detected such that the LKA TOI can no longer function. CAN failures, internal MDPS failures, and LKA controller logic failures are all reported by this flag. Failures reported by the LKA";
BA_ "Version" SG_ 234 MDPS_LkaToiFltSta "17.12.00";
BA_ "UserSigValidity" SG_ 234 MDPS_LkaFailSta 3;
BA_ "RoutingFactor" SG_ 234 MDPS_LkaFailSta 5;
BA_ "Description" SG_ 234 MDPS_LkaFailSta "This fault flag is set whilst the MDPS TOI is in a fail state and has not yet recovered from it. This could either be due to an MDPS detected fault (as communicated by the ‘MDPS_LkaToiFltSta' flag) or an LKA detected fault (as communicated by the ‘LK";
BA_ "Version" SG_ 234 MDPS_LkaFailSta "17.12.00";
BA_ "UserSigValidity" SG_ 234 MDPS_FlxStrSta 3;
BA_ "RoutingFactor" SG_ 234 MDPS_FlxStrSta 5;
BA_ "Description" SG_ 234 MDPS_FlxStrSta "This signal indicates flex steer parameter set in MDPS. ";
BA_ "Version" SG_ 234 MDPS_FlxStrSta "17.12.00";
BA_ "UserSigValidity" SG_ 234 MDPS_CurrModVal 3;
BA_ "RoutingFactor" SG_ 234 MDPS_CurrModVal 5;
BA_ "Description" SG_ 234 MDPS_CurrModVal "This signal indicates flex steer parameter value in MDPS.



※ For information about flex steer mode set by user, refer to MDPS_FlxStrSta signal.

";
BA_ "Version" SG_ 234 MDPS_CurrModVal "17.12.00";
BA_ "UserSigValidity" SG_ 234 MDPS_OutTqVal 3;
BA_ "GenSigStartValue" SG_ 234 MDPS_OutTqVal 2048;
BA_ "RoutingFactor" SG_ 234 MDPS_OutTqVal 5;
BA_ "Description" SG_ 234 MDPS_OutTqVal "MDPS column torque";
BA_ "Version" SG_ 234 MDPS_OutTqVal "17.12.00";
BA_ "UserSigValidity" SG_ 234 MDPS_StrTqSnsrVal 3;
BA_ "GenSigStartValue" SG_ 234 MDPS_StrTqSnsrVal 4096;
BA_ "RoutingFactor" SG_ 234 MDPS_StrTqSnsrVal 5;
BA_ "Description" SG_ 234 MDPS_StrTqSnsrVal "Steering torque sensor value



Physical Value > 0: Left Direction (CCW)

Physical Value < 0: Right Direction (CW)";
BA_ "Version" SG_ 234 MDPS_StrTqSnsrVal "18.03.06";
BA_ "UserSigValidity" SG_ 250 HCU_EstAccelPdlPcVal 3;
BA_ "RoutingFactor" SG_ 250 HCU_EstAccelPdlPcVal 5;
BA_ "Description" SG_ 250 HCU_EstAccelPdlPcVal "Speed Control Status";
BA_ "Version" SG_ 250 HCU_EstAccelPdlPcVal "17.11.00";
BA_ "UserSigValidity" SG_ 256 EMS_Crc2Val 3;
BA_ "GenSigStartValue" SG_ 256 EMS_Crc2Val 65535;
BA_ "RoutingFactor" SG_ 256 EMS_Crc2Val 5;
BA_ "Description" SG_ 256 EMS_Crc2Val "The CRC checking process calculates the CRC over the entire data block, including the CRC result.

- CRC Polynomial (0x1021) , Initial Value : 0xFFFF, XOR value : 0x0000

- The mathematical expression to 16 bit CRC polynomial is given here. G(x) = x16 + ";
BA_ "Version" SG_ 256 EMS_Crc2Val "17.11.00";
BA_ "UserSigValidity" SG_ 256 EMS_AlvCnt2Val 3;
BA_ "RoutingFactor" SG_ 256 EMS_AlvCnt2Val 5;
BA_ "Description" SG_ 256 EMS_AlvCnt2Val "For the first transmission request for a data element the counter shall be initialized with 0 and shall be incremented by 1

for every subsequent send request. When the counter reaches the maximum value(0xFF), then it shall restart with – for the next ";
BA_ "Version" SG_ 256 EMS_AlvCnt2Val "17.12.03";
BA_ "UserSigValidity" SG_ 256 ENG_BrkSwSta 3;
BA_ "GenSigStartValue" SG_ 256 ENG_BrkSwSta 1;
BA_ "RoutingFactor" SG_ 256 ENG_BrkSwSta 5;
BA_ "Description" SG_ 256 ENG_BrkSwSta "This signal indicates that a brake switch is activated or not. When the brake switch is activated(pressed) its value is 02H otherwise its value is 01H.

If the EMS does not support this signal the value is 00H.



Physical range : 0 ... 100

Conversion :";
BA_ "Version" SG_ 256 ENG_BrkSwSta "17.12.00";
BA_ "UserSigValidity" SG_ 256 ENG_EngSta 3;
BA_ "RoutingFactor" SG_ 256 ENG_EngSta 5;
BA_ "Description" SG_ 256 ENG_EngSta "This signal indicates that a status of engine.";
BA_ "Version" SG_ 256 ENG_EngSta "17.12.00";
BA_ "UserSigValidity" SG_ 256 ENG_AccActSta 3;
BA_ "RoutingFactor" SG_ 256 ENG_AccActSta 5;
BA_ "Description" SG_ 256 ENG_AccActSta "EMS sends the state of the cruise control via the signal ACC_ACT. 

If the EMS does not support this signal the value is 00H



If the cruise control is activated then ACC_ACT = 1. In this period, vehicle speed control (cruise control) is performed by th";
BA_ "Version" SG_ 256 ENG_AccActSta "17.12.00";
BA_ "UserSigValidity" SG_ 256 ENG_CltchOpSta 3;
BA_ "RoutingFactor" SG_ 256 ENG_CltchOpSta 5;
BA_ "Description" SG_ 256 ENG_CltchOpSta "This signal indicates that ECU has detected an operation of a clutch. Using this signal an ISG (Idle Stop & Go) system acts as an alternator or a starter.



If the EMS does not support this signal the value is 00H";
BA_ "Version" SG_ 256 ENG_CltchOpSta "17.12.00";
BA_ "UserSigValidity" SG_ 256 ENG_AccelPdlVal 3;
BA_ "RoutingFactor" SG_ 256 ENG_AccelPdlVal 5;
BA_ "Description" SG_ 256 ENG_AccelPdlVal "The signal PV_AV_CAN is a measure of the Accelerator Pedal value.

The accelerator pedal value is determined via 2 pedal sensors, which are connected mechanically to the

accelerator pedal. If the EMS-ECU recognizes that the accelerator pedal is not acti";
BA_ "Version" SG_ 256 ENG_AccelPdlVal "18.01.01";
BA_ "UserSigValidity" SG_ 256 ENG_AppAccelPdlSta 3;
BA_ "RoutingFactor" SG_ 256 ENG_AppAccelPdlSta 5;
BA_ "Description" SG_ 256 ENG_AppAccelPdlSta "This signal indicates if the driver applies the accelerator pedal. 

The signal always indicates the actual operation of the accelerator pedal, independent from SCC mode.";
BA_ "Version" SG_ 256 ENG_AppAccelPdlSta "17.12.00";
BA_ "UserSigValidity" SG_ 261 HEV_EngSpdVal 3;
BA_ "RoutingFactor" SG_ 261 HEV_EngSpdVal 5;
BA_ "Description" SG_ 261 HEV_EngSpdVal "Engine Speed";
BA_ "Version" SG_ 261 HEV_EngSpdVal "18.05.04";
BA_ "UserSigValidity" SG_ 261 HEV_AccelPdlVal 3;
BA_ "RoutingFactor" SG_ 261 HEV_AccelPdlVal 5;
BA_ "Description" SG_ 261 HEV_AccelPdlVal "The signal is a measure of the Accelerator Pedal value.

The accelerator pedal value is determined via 2 pedal sensors, which are connected mechanically to the accelerator pedal. If the EMS-ECU recognizes that the accelerator pedal is not activated, then";
BA_ "Version" SG_ 261 HEV_AccelPdlVal "18.05.04";
BA_ "UserSigValidity" SG_ 266 MCU_VehSpdKphVal 5;
BA_ "RoutingFactor" SG_ 266 MCU_VehSpdKphVal 5;
BA_ "Version" SG_ 266 MCU_VehSpdKphVal "17.11.00";
BA_ "UserSigValidity" SG_ 282 FR_CMR_Crc1Val 3;
BA_ "GenSigStartValue" SG_ 282 FR_CMR_Crc1Val 65535;
BA_ "RoutingFactor" SG_ 282 FR_CMR_Crc1Val 5;
BA_ "Description" SG_ 282 FR_CMR_Crc1Val "The CRC checking process calculates the CRC over the entire data block, including the CRC result.

- CRC Polynomial (0x1021) , Initial Value : 0xFFFF, XOR value : 0x0000

- The mathematical expression to 16 bit CRC polynomial is given here. G(x) = x16 + ";
BA_ "Version" SG_ 282 FR_CMR_Crc1Val "17.11.00";
BA_ "UserSigValidity" SG_ 282 FR_CMR_AlvCnt1Val 3;
BA_ "RoutingFactor" SG_ 282 FR_CMR_AlvCnt1Val 5;
BA_ "Description" SG_ 282 FR_CMR_AlvCnt1Val "For the first transmission request for a data element the counter shall be initialized with 0 and shall be incremented by 1

for every subsequent send request. When the counter reaches the maximum value(0xFF), then it shall restart with – for the next ";
BA_ "Version" SG_ 282 FR_CMR_AlvCnt1Val "17.11.00";
BA_ "UserSigValidity" SG_ 282 HBA_SysOptSta 3;
BA_ "RoutingFactor" SG_ 282 HBA_SysOptSta 5;
BA_ "Description" SG_ 282 HBA_SysOptSta "HBA System Option Information to Lamp Controller";
BA_ "Version" SG_ 282 HBA_SysOptSta "17.12.02";
BA_ "UserSigValidity" SG_ 282 HBA_SysSta 3;
BA_ "RoutingFactor" SG_ 282 HBA_SysSta 5;
BA_ "Description" SG_ 282 HBA_SysSta "This signal indicates the status of High Beam Assist system.";
BA_ "Version" SG_ 282 HBA_SysSta "17.12.02";
BA_ "UserSigValidity" SG_ 282 HBA_IndLmpReq 3;
BA_ "RoutingFactor" SG_ 282 HBA_IndLmpReq 5;
BA_ "Description" SG_ 282 HBA_IndLmpReq "HBA System Indicator Lamp Status ";
BA_ "Version" SG_ 282 HBA_IndLmpReq "17.12.02";
BA_ "UserSigValidity" SG_ 282 iHBAref_VehLftSta 3;
BA_ "RoutingFactor" SG_ 282 iHBAref_VehLftSta 5;
BA_ "Description" SG_ 282 iHBAref_VehLftSta "Information on the presence or absence of the front-left side";
BA_ "Version" SG_ 282 iHBAref_VehLftSta "17.11.00";
BA_ "UserSigValidity" SG_ 282 iHBAref_VehCtrSta 3;
BA_ "RoutingFactor" SG_ 282 iHBAref_VehCtrSta 5;
BA_ "Description" SG_ 282 iHBAref_VehCtrSta "Information on the presence or absence of the front-center";
BA_ "Version" SG_ 282 iHBAref_VehCtrSta "17.11.00";
BA_ "UserSigValidity" SG_ 282 iHBAref_VehRtSta 3;
BA_ "RoutingFactor" SG_ 282 iHBAref_VehRtSta 5;
BA_ "Description" SG_ 282 iHBAref_VehRtSta "Information on the presence or absence of the front-right side";
BA_ "Version" SG_ 282 iHBAref_VehRtSta "17.11.00";
BA_ "UserSigValidity" SG_ 282 iHBAref_ILLAmbtSta 3;
BA_ "RoutingFactor" SG_ 282 iHBAref_ILLAmbtSta 5;
BA_ "Description" SG_ 282 iHBAref_ILLAmbtSta "This signal is status of the ambient brightness

0x0 is bright(Highbeam off) condition/ 0x1 is dark condition";
BA_ "Version" SG_ 282 iHBAref_ILLAmbtSta "17.11.00";
BA_ "UserSigValidity" SG_ 282 FCA_Equip_MFC 3;
BA_ "RoutingFactor" SG_ 282 FCA_Equip_MFC 5;
BA_ "Description" SG_ 282 FCA_Equip_MFC "FCA Sensor Type";
BA_ "Version" SG_ 282 FCA_Equip_MFC "18.02.03";
BA_ "UserSigValidity" SG_ 282 HBA_OptUsmSta 3;
BA_ "RoutingFactor" SG_ 282 HBA_OptUsmSta 5;
BA_ "Description" SG_ 282 HBA_OptUsmSta "HBA Option USM Status";
BA_ "Version" SG_ 282 HBA_OptUsmSta "18.04.00";
BA_ "UserSigValidity" SG_ 282 FCAref_FusSta 3;
BA_ "RoutingFactor" SG_ 282 FCAref_FusSta 5;
BA_ "Description" SG_ 282 FCAref_FusSta "Fusion Function State";
BA_ "Version" SG_ 282 FCAref_FusSta "17.12.02";
BA_ "UserSigValidity" SG_ 282 DAW_LVDA_PUDis 3;
BA_ "RoutingFactor" SG_ 282 DAW_LVDA_PUDis 5;
BA_ "Description" SG_ 282 DAW_LVDA_PUDis "Message for displaying LVDA(Leading Vehicle Departure Alert) Warning

";
BA_ "Version" SG_ 282 DAW_LVDA_PUDis "18.07.01";
BA_ "UserSigValidity" SG_ 282 DAW_LVDA_OptUsmSta 3;
BA_ "RoutingFactor" SG_ 282 DAW_LVDA_OptUsmSta 5;
BA_ "Description" SG_ 282 DAW_LVDA_OptUsmSta "LVDA USM state";
BA_ "Version" SG_ 282 DAW_LVDA_OptUsmSta "18.07.01";
BA_ "UserSigValidity" SG_ 282 DAW_OptUsmSta 3;
BA_ "RoutingFactor" SG_ 282 DAW_OptUsmSta 5;
BA_ "Description" SG_ 282 DAW_OptUsmSta "This signal represents the lastest DAW ON/OFF value of USM.";
BA_ "Version" SG_ 282 DAW_OptUsmSta "18.07.01";
BA_ "UserSigValidity" SG_ 282 DAW_SysSta 3;
BA_ "RoutingFactor" SG_ 282 DAW_SysSta 5;
BA_ "Description" SG_ 282 DAW_SysSta "This signal represents Attention Assist System Status or Attention Level.";
BA_ "Version" SG_ 282 DAW_SysSta "18.07.01";
BA_ "UserSigValidity" SG_ 282 DAW_WrnMsgSta 3;
BA_ "RoutingFactor" SG_ 282 DAW_WrnMsgSta 5;
BA_ "Description" SG_ 282 DAW_WrnMsgSta "This signal represents Rest recommend warning message popup state.";
BA_ "Version" SG_ 282 DAW_WrnMsgSta "18.07.01";
BA_ "UserSigValidity" SG_ 282 DAW_TimeRstReq 3;
BA_ "RoutingFactor" SG_ 282 DAW_TimeRstReq 5;
BA_ "Description" SG_ 282 DAW_TimeRstReq "This signal requests CLU 'Last Break Time' Reset.

DAW send '0x1' when detecting driver's rest.";
BA_ "Version" SG_ 282 DAW_TimeRstReq "18.07.01";
BA_ "UserSigValidity" SG_ 282 DAW_SnstvtyModRetVal 3;
BA_ "RoutingFactor" SG_ 282 DAW_SnstvtyModRetVal 5;
BA_ "Description" SG_ 282 DAW_SnstvtyModRetVal "This signal represents the feedback value of the current ADAS warning timing.";
BA_ "Version" SG_ 282 DAW_SnstvtyModRetVal "18.07.01";
BA_ "UserSigValidity" SG_ 288 GCU_VehSpdKphVal 5;
BA_ "RoutingFactor" SG_ 288 GCU_VehSpdKphVal 5;
BA_ "Version" SG_ 288 GCU_VehSpdKphVal "17.11.00";
BA_ "UserSigValidity" SG_ 293 SAS_Crc1Val 3;
BA_ "GenSigStartValue" SG_ 293 SAS_Crc1Val 65535;
BA_ "RoutingFactor" SG_ 293 SAS_Crc1Val 5;
BA_ "Description" SG_ 293 SAS_Crc1Val "The CRC checking process calculates the CRC over the entire data block, including the CRC result.

- CRC Polynomial (0x1021) , Initial Value : 0xFFFF, XOR value : 0x0000

- The mathematical expression to 16 bit CRC polynomial is given here. G(x) = x16 + ";
BA_ "Version" SG_ 293 SAS_Crc1Val "17.11.00";
BA_ "UserSigValidity" SG_ 293 SAS_AlvCnt1Val 3;
BA_ "RoutingFactor" SG_ 293 SAS_AlvCnt1Val 5;
BA_ "Description" SG_ 293 SAS_AlvCnt1Val "For the first transmission request for a data element the counter shall be initialized with 0 and shall be incremented by 1

for every subsequent send request. When the counter reaches the maximum value(0xFF), then it shall restart with – for the next ";
BA_ "Version" SG_ 293 SAS_AlvCnt1Val "17.11.00";
BA_ "UserSigValidity" SG_ 293 SAS_AnglVal 3;
BA_ "RoutingFactor" SG_ 293 SAS_AnglVal 5;
BA_ "Description" SG_ 293 SAS_AnglVal "Information regarding the steering wheel angle.  (PH) = (HEX) * 0.1 (0 <  HEX < 7FFFH) or (PH) = (HEX - 65536) * 0.1 (HEX > 7FFFH)";
BA_ "Version" SG_ 293 SAS_AnglVal "17.11.00";
BA_ "UserSigValidity" SG_ 293 SAS_SpdVal 3;
BA_ "RoutingFactor" SG_ 293 SAS_SpdVal 5;
BA_ "Description" SG_ 293 SAS_SpdVal "Information regarding the steering wheel rotation speed 

(PH) = (HEX) * 4 (0 ≤ HEX < 254)";
BA_ "Version" SG_ 293 SAS_SpdVal "17.11.00";
BA_ "UserSigValidity" SG_ 293 SAS_IntSta 3;
BA_ "GenSigStartValue" SG_ 293 SAS_IntSta 7;
BA_ "RoutingFactor" SG_ 293 SAS_IntSta 5;
BA_ "Description" SG_ 293 SAS_IntSta "Information regarding the steering angle sensor’s internal state. If SAS_AnglVal value is O.K., SAS_OK flag is set and otherwise SAS_OK flag is cleared. If steering angle sensor has been calibrated, SAS_CAL flag is set and otherwise cleared.

SF1 - SF5";
BA_ "Version" SG_ 293 SAS_IntSta "17.11.00";
BA_ "UserSigValidity" SG_ 314 FR_CMR_Crc5Val 3;
BA_ "Description" SG_ 314 FR_CMR_Crc5Val "The CRC checking process calculates the CRC over the entire data block, including the CRC result.

- CRC Polynomial (0x1021) , Initial Value : 0xFFFF, XOR value : 0x0000

- The mathematical expression to 16 bit CRC polynomial is given here. G(x) = x16 + ";
BA_ "Version" SG_ 314 FR_CMR_Crc5Val "17.12.03";
BA_ "UserSigValidity" SG_ 314 FR_CMR_AlvCnt5Val 3;
BA_ "Description" SG_ 314 FR_CMR_AlvCnt5Val "For the first transmission request for a data element the counter shall be initialized with 0 and shall be incremented by 1

for every subsequent send request. When the counter reaches the maximum value(0xFF), then it shall restart with – for the next ";
BA_ "Version" SG_ 314 FR_CMR_AlvCnt5Val "17.12.03";
BA_ "UserSigValidity" SG_ 314 Info_DistL 3;
BA_ "Description" SG_ 314 Info_DistL "Distance left to the shape on road surface (Left Side)";
BA_ "Version" SG_ 314 Info_DistL "17.12.03";
BA_ "UserSigValidity" SG_ 314 Info_HeightL 3;
BA_ "Description" SG_ 314 Info_HeightL "Height of the shape on road surface (Left Side)";
BA_ "Version" SG_ 314 Info_HeightL "17.12.03";
BA_ "UserSigValidity" SG_ 314 Info_LengthL 3;
BA_ "Description" SG_ 314 Info_LengthL "Length of the shape on road surface (Left Side)";
BA_ "Version" SG_ 314 Info_LengthL "17.12.03";
BA_ "UserSigValidity" SG_ 314 Info_TypeL 3;
BA_ "Description" SG_ 314 Info_TypeL "Type of the shape on road surface (Left Side)";
BA_ "Version" SG_ 314 Info_TypeL "17.12.03";
BA_ "UserSigValidity" SG_ 314 Info_ConfL 3;
BA_ "Description" SG_ 314 Info_ConfL "Reliability of the shape on road surface (Left side)";
BA_ "Version" SG_ 314 Info_ConfL "17.12.03";
BA_ "UserSigValidity" SG_ 314 Info_CyclicCounterL 3;
BA_ "Description" SG_ 314 Info_CyclicCounterL "Check counter for recognition of the shape (Left Side)";
BA_ "Version" SG_ 314 Info_CyclicCounterL "17.12.03";
BA_ "UserSigValidity" SG_ 314 Info_VariL 3;
BA_ "Description" SG_ 314 Info_VariL "Variance level of the shape information (Left Side)";
BA_ "Version" SG_ 314 Info_VariL "17.12.03";
BA_ "UserSigValidity" SG_ 314 Info_DistR 3;
BA_ "Description" SG_ 314 Info_DistR "Distance left to the shape on road surface (Right Side)";
BA_ "Version" SG_ 314 Info_DistR "17.12.03";
BA_ "UserSigValidity" SG_ 314 Info_HeightR 3;
BA_ "Description" SG_ 314 Info_HeightR "Height of the shape on road surface (Right Side)";
BA_ "Version" SG_ 314 Info_HeightR "17.12.03";
BA_ "UserSigValidity" SG_ 314 Info_LengthR 3;
BA_ "Description" SG_ 314 Info_LengthR "Length of the shape on road surface (Right Side)";
BA_ "Version" SG_ 314 Info_LengthR "17.12.03";
BA_ "UserSigValidity" SG_ 314 Info_TypeR 3;
BA_ "Description" SG_ 314 Info_TypeR "Type of the shape on road surface (Right Side)";
BA_ "Version" SG_ 314 Info_TypeR "17.12.03";
BA_ "UserSigValidity" SG_ 314 Info_ConfR 3;
BA_ "Description" SG_ 314 Info_ConfR "Reliability of the shape on road surface (Right Side)";
BA_ "Version" SG_ 314 Info_ConfR "17.12.03";
BA_ "UserSigValidity" SG_ 314 Info_CyclicCounterR 3;
BA_ "Description" SG_ 314 Info_CyclicCounterR "Check counter for recognition of the shape (Right Side)";
BA_ "Version" SG_ 314 Info_CyclicCounterR "17.12.03";
BA_ "UserSigValidity" SG_ 314 Info_VariR 3;
BA_ "Description" SG_ 314 Info_VariR "Variance level of the shape information (Right Side)";
BA_ "Version" SG_ 314 Info_VariR "17.12.03";
BA_ "UserSigValidity" SG_ 314 Info_RdProfSts 3;
BA_ "Description" SG_ 314 Info_RdProfSts "System status checker";
BA_ "Version" SG_ 314 Info_RdProfSts "17.12.03";
BA_ "UserSigValidity" SG_ 352 ADAS_CMD_Crc10Val 3;
BA_ "GenSigStartValue" SG_ 352 ADAS_CMD_Crc10Val 65535;
BA_ "RoutingFactor" SG_ 352 ADAS_CMD_Crc10Val 5;
BA_ "Description" SG_ 352 ADAS_CMD_Crc10Val "The CRC checking process calculates the CRC over the entire data block, including the CRC result.

- CRC Polynomial (0x1021) , Initial Value : 0xFFFF, XOR value : 0x0000

- The mathematical expression to 16 bit CRC polynomial is given here. G(x) = x16 + ";
BA_ "Version" SG_ 352 ADAS_CMD_Crc10Val "17.12.00";
BA_ "UserSigValidity" SG_ 352 ADAS_CMD_AlvCnt10Val 3;
BA_ "RoutingFactor" SG_ 352 ADAS_CMD_AlvCnt10Val 5;
BA_ "Description" SG_ 352 ADAS_CMD_AlvCnt10Val "For the first transmission request for a data element the counter shall be initialized with 0 and shall be incremented by 1

for every subsequent send request. When the counter reaches the maximum value(0xFF), then it shall restart with – for the next ";
BA_ "Version" SG_ 352 ADAS_CMD_AlvCnt10Val "17.12.00";
BA_ "UserSigValidity" SG_ 352 FCA_OnOffEquipSta 3;
BA_ "RoutingFactor" SG_ 352 FCA_OnOffEquipSta 5;
BA_ "Description" SG_ 352 FCA_OnOffEquipSta "This signal describes the FCA Function.

- 시스템 장착 여부 및 시스템 on/off 정보";
BA_ "Version" SG_ 352 FCA_OnOffEquipSta "17.12.00";
BA_ "UserSigValidity" SG_ 352 FCA_SysFlrSta 3;
BA_ "RoutingFactor" SG_ 352 FCA_SysFlrSta 5;
BA_ "Description" SG_ 352 FCA_SysFlrSta "This signal describes the failure information of FCA Function.



- 시스템 정상 또는 카메라/레이더/시스템 고장상태 정보";
BA_ "Version" SG_ 352 FCA_SysFlrSta "17.12.00";
BA_ "UserSigValidity" SG_ 352 FCA_WrngLvlSta 3;
BA_ "RoutingFactor" SG_ 352 FCA_WrngLvlSta 5;
BA_ "Description" SG_ 352 FCA_WrngLvlSta "Request CLU to activate the corresponding warning device(s) according to the FCA warning level.

- FCA 1차/2차/3차 작동 상태 표시용 정보신호";
BA_ "Version" SG_ 352 FCA_WrngLvlSta "17.12.00";
BA_ "UserSigValidity" SG_ 352 FCA_VehStpReq 3;
BA_ "RoutingFactor" SG_ 352 FCA_VehStpReq 5;
BA_ "Description" SG_ 352 FCA_VehStpReq "A control request flag for vehicle stop. FCA expects vehicle to be controlled to a complete stop and hold its state by ESC.



- FCA 제동상황 종료후 정차 상태 유지를 위한 신호";
BA_ "Version" SG_ 352 FCA_VehStpReq "17.12.00";
BA_ "UserSigValidity" SG_ 352 FCA_StbltActvReq 3;
BA_ "RoutingFactor" SG_ 352 FCA_StbltActvReq 5;
BA_ "Description" SG_ 352 FCA_StbltActvReq "Depending on the driving situation, FCA tells PSB to release(no alert), retract or pull the seat belt for occupant protection or warning.

- FCA 제동상황시 시트벨트 작동을 위한 정보 신호";
BA_ "Version" SG_ 352 FCA_StbltActvReq "17.12.00";
BA_ "UserSigValidity" SG_ 352 FCA_HydrlcBstAsstReq 3;
BA_ "RoutingFactor" SG_ 352 FCA_HydrlcBstAsstReq 5;
BA_ "Description" SG_ 352 FCA_HydrlcBstAsstReq "Depending on the driving situation, FCA tells ESC to use lowered HBA (Hydraulic Boost Assist) threshold to sensitize the HBA entrance. 

The boost assist function is more easily activated than under normal driving condition.

- FCA 제동상황시 HBA �";
BA_ "Version" SG_ 352 FCA_HydrlcBstAsstReq "17.12.00";
BA_ "UserSigValidity" SG_ 352 FCA_DclReqVal 3;
BA_ "RoutingFactor" SG_ 352 FCA_DclReqVal 5;
BA_ "Description" SG_ 352 FCA_DclReqVal "Depending on the driving situation, FCA gives ESC the deceleration command. ESC maintains the deceleration.

- FCA 제동을 위한 요구 감속도 값";
BA_ "Version" SG_ 352 FCA_DclReqVal "17.12.00";
BA_ "UserSigValidity" SG_ 352 FCA_PrefillActvReq 3;
BA_ "RoutingFactor" SG_ 352 FCA_PrefillActvReq 5;
BA_ "Description" SG_ 352 FCA_PrefillActvReq "A control requeset flag for FCA first warning. (Audible Warning)

- FCA 1차 제동상황 요청신호";
BA_ "Version" SG_ 352 FCA_PrefillActvReq "17.12.00";
BA_ "UserSigValidity" SG_ 352 FCA_PartialActvReq 3;
BA_ "RoutingFactor" SG_ 352 FCA_PartialActvReq 5;
BA_ "Description" SG_ 352 FCA_PartialActvReq "A control requeset flag for FCA second warning. (Partial braking)

- FCA 2차 제동상황 요청신호";
BA_ "Version" SG_ 352 FCA_PartialActvReq "17.11.00";
BA_ "UserSigValidity" SG_ 352 FCA_FullActvReq 3;
BA_ "RoutingFactor" SG_ 352 FCA_FullActvReq 5;
BA_ "Description" SG_ 352 FCA_FullActvReq "A control requeset flag for FCA third warning. (Full braking)

- FCA 3차 제동상황 요청신호";
BA_ "Version" SG_ 352 FCA_FullActvReq "17.11.00";
BA_ "UserSigValidity" SG_ 352 FCA_SnstvtyModRetVal 3;
BA_ "RoutingFactor" SG_ 352 FCA_SnstvtyModRetVal 5;
BA_ "Description" SG_ 352 FCA_SnstvtyModRetVal "This signal is FCA sensitive set mode switch(USM) info return value to cluster.

- FCA 민감도 설정 관련 USM 설정 스위치 정보의 리턴 값";
BA_ "Version" SG_ 352 FCA_SnstvtyModRetVal "17.12.00";
BA_ "UserSigValidity" SG_ 352 FCA_RelVel 3;
BA_ "RoutingFactor" SG_ 352 FCA_RelVel 5;
BA_ "Description" SG_ 352 FCA_RelVel "This signal indicates the relative velocity between the host vehicle and a forward vehicle.







(PH) = ((HEX)-0FFH)*0.1 [m/s/digit]



       = (HEX)*0.1 [m/s/digit] - 25.5 [m/s]



CAN Message Physical range : Max. Relative velocity : 0x1FE(25.5m/s),";
BA_ "Version" SG_ 352 FCA_RelVel "17.12.00";
BA_ "UserSigValidity" SG_ 352 FCA_TimetoCllsn 3;
BA_ "RoutingFactor" SG_ 352 FCA_TimetoCllsn 5;
BA_ "Description" SG_ 352 FCA_TimetoCllsn "This signal indicates predictive time to Collision between the host vehicle and a forward vehicle.







(PH) = 10*(HEX) [ms]



CAN Message Physical range : 0 ~ 2540 [ms], Resolution : 10ms";
BA_ "Version" SG_ 352 FCA_TimetoCllsn "17.12.00";
BA_ "UserSigValidity" SG_ 352 FCA_Jnctn_OnOffEquipSta 3;
BA_ "RoutingFactor" SG_ 352 FCA_Jnctn_OnOffEquipSta 5;
BA_ "Description" SG_ 352 FCA_Jnctn_OnOffEquipSta "This signal describes the FCA-JC Function.

- 시스템 장착 여부 및 시스템 on/off 정보";
BA_ "Version" SG_ 352 FCA_Jnctn_OnOffEquipSta "17.11.00";
BA_ "UserSigValidity" SG_ 352 FCA_WrngTrgtDis 3;
BA_ "RoutingFactor" SG_ 352 FCA_WrngTrgtDis 5;
BA_ "Description" SG_ 352 FCA_WrngTrgtDis "Request CLU to activate the corresponding warning device(s) according to the type of FCA warning target.

- FCA 경고 대상 종류별 표시 정보신호";
BA_ "Version" SG_ 352 FCA_WrngTrgtDis "17.12.03";
BA_ "UserSigValidity" SG_ 362 RSPA_Sta 3;
BA_ "GenSigStartValue" SG_ 362 RSPA_Sta 1;
BA_ "RoutingFactor" SG_ 362 RSPA_Sta 5;
BA_ "Description" SG_ 362 RSPA_Sta "현재 RSPA의 상태";
BA_ "Version" SG_ 362 RSPA_Sta "17.11.00";
BA_ "UserSigValidity" SG_ 373 ESC_Crc3Val 3;
BA_ "GenSigStartValue" SG_ 373 ESC_Crc3Val 65535;
BA_ "RoutingFactor" SG_ 373 ESC_Crc3Val 5;
BA_ "Description" SG_ 373 ESC_Crc3Val "The CRC checking process calculates the CRC over the entire data block, including the CRC result.

- CRC Polynomial (0x1021) , Initial Value : 0xFFFF, XOR value : 0x0000

- The mathematical expression to 16 bit CRC polynomial is given here. G(x) = x16 + ";
BA_ "Version" SG_ 373 ESC_Crc3Val "17.11.00";
BA_ "UserSigValidity" SG_ 373 ESC_AlvCnt3Val 3;
BA_ "RoutingFactor" SG_ 373 ESC_AlvCnt3Val 5;
BA_ "Description" SG_ 373 ESC_AlvCnt3Val "For the first transmission request for a data element the counter shall be initialized with 0 and shall be incremented by 1

for every subsequent send request. When the counter reaches the maximum value(0xFF), then it shall restart with – for the next ";
BA_ "Version" SG_ 373 ESC_AlvCnt3Val "17.11.00";
BA_ "UserSigValidity" SG_ 373 ESC_VehAccelVal 3;
BA_ "RoutingFactor" SG_ 373 ESC_VehAccelVal 5;
BA_ "Description" SG_ 373 ESC_VehAccelVal "The vehicle acceleration ACCEL_REF_ACC displays the feedback signal for the inner acceleration control loop since it is the SCC-internal acceleration command value. In addition this signal is used to calculate the target object acceleration. If the requi";
BA_ "Version" SG_ 373 ESC_VehAccelVal "17.12.00";
BA_ "UserSigValidity" SG_ 373 ESC_AccelBasisVal 3;
BA_ "RoutingFactor" SG_ 373 ESC_AccelBasisVal 5;
BA_ "Description" SG_ 373 ESC_AccelBasisVal "This value is used to initialize the acceleration control when SCC is engaged or after driver override.";
BA_ "Version" SG_ 373 ESC_AccelBasisVal "17.12.00";
BA_ "UserSigValidity" SG_ 373 SCC_OptTyp 3;
BA_ "RoutingFactor" SG_ 373 SCC_OptTyp 5;
BA_ "Description" SG_ 373 SCC_OptTyp "This value is used for SCC is equipped or not.";
BA_ "Version" SG_ 373 SCC_OptTyp "17.12.00";
BA_ "UserSigValidity" SG_ 373 SCC_EnblReq 3;
BA_ "RoutingFactor" SG_ 373 SCC_EnblReq 5;
BA_ "Description" SG_ 373 SCC_EnblReq "This signal is set by the safety logic in the TCS/ESC. The safety logic shall monitor the following:

1. A temporary failure in the vehicle does not allow SCC (Brakes are overheated, etc…). 

SCC is disabled reversible.

2. SCC communication failure (t";
BA_ "Version" SG_ 373 SCC_EnblReq "17.12.00";
BA_ "UserSigValidity" SG_ 373 SCC_TqReq 3;
BA_ "RoutingFactor" SG_ 373 SCC_TqReq 5;
BA_ "Description" SG_ 373 SCC_TqReq "When it is set, the signal indicates that ESC requests engine torque control for SCC. When the signal is set, EMS should not conduct fuel-cut off control unless it is required to prevent the damage of the engine and the related components.";
BA_ "Version" SG_ 373 SCC_TqReq "17.12.00";
BA_ "UserSigValidity" SG_ 373 SCC_ReqLimSta 3;
BA_ "RoutingFactor" SG_ 373 SCC_ReqLimSta 5;
BA_ "Description" SG_ 373 SCC_ReqLimSta "Due to limitaion of the actuators the acceleration or deceleration request from SCC can not be processed or only partly. 



Examples:

1. SCC is requesting more acceleration than the engine can deliver.

2. SCC is requesting deceleration on a low μ sur";
BA_ "Version" SG_ 373 SCC_ReqLimSta "17.12.00";
BA_ "UserSigValidity" SG_ 373 ESC_StdStillVal 3;
BA_ "RoutingFactor" SG_ 373 ESC_StdStillVal 5;
BA_ "Description" SG_ 373 ESC_StdStillVal "If an ESC uses active wheel speed sensors, wheel speeds down to 0 Km/h can be measured. And at 0 Km/h a StandStill flag is set in the ESC. This signal is used in the offset determination of the yaw rate and shall indicate that the vehicle has come to a c";
BA_ "Version" SG_ 373 ESC_StdStillVal "17.12.00";
BA_ "UserSigValidity" SG_ 373 ESC_BrkLtReq 3;
BA_ "RoutingFactor" SG_ 373 ESC_BrkLtReq 5;
BA_ "Description" SG_ 373 ESC_BrkLtReq "Flag from TCS which activates the illumination of the brake lights during automatic braking.";
BA_ "Version" SG_ 373 ESC_BrkLtReq "17.12.00";
BA_ "UserSigValidity" SG_ 373 ESC_DclEnblReq 3;
BA_ "RoutingFactor" SG_ 373 ESC_DclEnblReq 5;
BA_ "Description" SG_ 373 ESC_DclEnblReq "This signal enables the deceleration control to accept command values axvCv from SCC. This flag is complementary to the ACC_REQ flag if SCC is in active mode.";
BA_ "Version" SG_ 373 ESC_DclEnblReq "17.12.00";
BA_ "UserSigValidity" SG_ 373 ESC_DrvOvrdSta 3;
BA_ "RoutingFactor" SG_ 373 ESC_DrvOvrdSta 5;
BA_ "Description" SG_ 373 ESC_DrvOvrdSta "This signal indicates that acceleration or deceleration value of driver’s requirement is greater than SCC setting value.";
BA_ "Version" SG_ 373 ESC_DrvOvrdSta "17.12.00";
BA_ "UserSigValidity" SG_ 373 ESC_DrvBrkSta 3;
BA_ "RoutingFactor" SG_ 373 ESC_DrvBrkSta 5;
BA_ "Description" SG_ 373 ESC_DrvBrkSta "This signal indicates flag from ESC to SCC to indicate the driver braking state";
BA_ "Version" SG_ 373 ESC_DrvBrkSta "17.12.00";
BA_ "UserSigValidity" SG_ 373 ESC_DrvBrkActvSta 3;
BA_ "RoutingFactor" SG_ 373 ESC_DrvBrkActvSta 5;
BA_ "Description" SG_ 373 ESC_DrvBrkActvSta "This signal indicates that a driver is pressing the brake pedal or not.";
BA_ "Version" SG_ 373 ESC_DrvBrkActvSta "17.12.00";
BA_ "UserSigValidity" SG_ 373 ESC_PrkBrkActvSta 3;
BA_ "RoutingFactor" SG_ 373 ESC_PrkBrkActvSta 5;
BA_ "Description" SG_ 373 ESC_PrkBrkActvSta "This signal indicates whether the parking brake is activated or not.";
BA_ "Version" SG_ 373 ESC_PrkBrkActvSta "17.12.00";
BA_ "UserSigValidity" SG_ 373 FCA_EquipSta 3;
BA_ "RoutingFactor" SG_ 373 FCA_EquipSta 5;
BA_ "Description" SG_ 373 FCA_EquipSta "FCA Equipment Status";
BA_ "Version" SG_ 373 FCA_EquipSta "17.12.00";
BA_ "UserSigValidity" SG_ 373 FCA_AvlblSta 3;
BA_ "RoutingFactor" SG_ 373 FCA_AvlblSta 5;
BA_ "Description" SG_ 373 FCA_AvlblSta "This signal indicates state signal from ESC to FCA which tells if ESC is 'Available', 'Temporarily not available', 'Permanently not available' or 'FCA Communication Error'.";
BA_ "Version" SG_ 373 FCA_AvlblSta "18.02.00";
BA_ "UserSigValidity" SG_ 384 FR_CMR_Obj_Crc01Val 3;
BA_ "GenSigStartValue" SG_ 384 FR_CMR_Obj_Crc01Val 65535;
BA_ "Description" SG_ 384 FR_CMR_Obj_Crc01Val "[Cyclic redundancy check] The CRC checking process calculates the CRC over the entire data block, including the CRC result CRC Polynomial (0x1021) ,

Initial Value : 0xFFFF, XOR value : 0x0000

The mathematical expression to 16 bit CRC polynomial is give";
BA_ "Version" SG_ 384 FR_CMR_Obj_Crc01Val "18.03.01";
BA_ "UserSigValidity" SG_ 384 FR_CMR_Obj_AlvCnt01Val 3;
BA_ "Description" SG_ 384 FR_CMR_Obj_AlvCnt01Val "[Alive counter] For the first transmission request for a data element the counter shall be initialized with 0 and shall be incremented by 1

for every subsequent send request. When the counter reaches the maximum value(0xFF), then it shall restart with �";
BA_ "Version" SG_ 384 FR_CMR_Obj_AlvCnt01Val "18.03.01";
BA_ "UserSigValidity" SG_ 384 FR_CMR_Obj_QualLvl01Sta 3;
BA_ "Description" SG_ 384 FR_CMR_Obj_QualLvl01Sta "[Quality level] Information quality for a target object. Information quality can be interpreted by reliability, validity, probability etc.  

Value range : 0~100 (0~30 : Low, 30~60 : Medium, 60~100 : High)";
BA_ "Version" SG_ 384 FR_CMR_Obj_QualLvl01Sta "18.03.01";
BA_ "UserSigValidity" SG_ 384 FR_CMR_Obj_AlvAge01Val 3;
BA_ "Description" SG_ 384 FR_CMR_Obj_AlvAge01Val "[Alive Age] Lifetime

(Keep the higher values than 255 as 255.)";
BA_ "Version" SG_ 384 FR_CMR_Obj_AlvAge01Val "18.03.01";
BA_ "UserSigValidity" SG_ 384 FR_CMR_Obj_MvngFlag01Sta 3;
BA_ "Description" SG_ 384 FR_CMR_Obj_MvngFlag01Sta "[Moving flag] Moving information for a forward or oncoming object (ex. preceding vehicle, oncoming vehicle) : Stationary, Movable (Moving, Stopped) etc.";
BA_ "Version" SG_ 384 FR_CMR_Obj_MvngFlag01Sta "18.03.01";
BA_ "UserSigValidity" SG_ 384 FR_CMR_Obj_Id01Val 3;
BA_ "Description" SG_ 384 FR_CMR_Obj_Id01Val "[Track ID] Unlike radar (including corner radar), extra 'Track ID' signal is required because camera automatically sorts messages according to distance between subject and track vehicle. (1-127 valid and 0 is always invalid)";
BA_ "Version" SG_ 384 FR_CMR_Obj_Id01Val "18.03.01";
BA_ "UserSigValidity" SG_ 384 FR_CMR_Obj_Wth01Val 3;
BA_ "Description" SG_ 384 FR_CMR_Obj_Wth01Val "[Object width] Target object width. ";
BA_ "Version" SG_ 384 FR_CMR_Obj_Wth01Val "18.03.01";
BA_ "UserSigValidity" SG_ 384 FR_CMR_Obj_Clfct01Sta 3;
BA_ "Description" SG_ 384 FR_CMR_Obj_Clfct01Sta "[Object classification] Object classification result. 

Passenger car, Motor bike, truck, bicycle, pedestrian, etc. ";
BA_ "Version" SG_ 384 FR_CMR_Obj_Clfct01Sta "18.03.01";
BA_ "UserSigValidity" SG_ 384 FR_CMR_Obj_RelPosX01Val 3;
BA_ "GenSigStartValue" SG_ 384 FR_CMR_Obj_RelPosX01Val 7000;
BA_ "Description" SG_ 384 FR_CMR_Obj_RelPosX01Val "[Longitudinal distance] Physical distance between the subject vehicle and a target object in the x-axis of vehicle fixed coordinate system (ISO).

Reference point of the subject vehicle : the center of front bumper

Reference point of a target object : t";
BA_ "Version" SG_ 384 FR_CMR_Obj_RelPosX01Val "18.03.01";
BA_ "UserSigValidity" SG_ 384 FR_CMR_Obj_RelPosY01Val 3;
BA_ "Description" SG_ 384 FR_CMR_Obj_RelPosY01Val "[Lateral distance] Physical distance between the subject and a target object in the y-axis of vehicle fixed coordinate system (ISO). 

Reference point of the subject vehicle : centerline of the subject vehicle (x-axis of vehicle fixed coordinate system)

";
BA_ "Version" SG_ 384 FR_CMR_Obj_RelPosY01Val "18.03.01";
BA_ "UserSigValidity" SG_ 384 FR_CMR_Obj_RelVelX01Val 3;
BA_ "GenSigStartValue" SG_ 384 FR_CMR_Obj_RelVelX01Val 2000;
BA_ "Description" SG_ 384 FR_CMR_Obj_RelVelX01Val "[Longitudinal velocity] Relative velocity between the subject vehicle and a target object. 

Positive velocity : A forward object moves away from the subject vehicle, or a following object approaches the subject vehicle.";
BA_ "Version" SG_ 384 FR_CMR_Obj_RelVelX01Val "18.03.01";
BA_ "UserSigValidity" SG_ 384 FR_CMR_Obj_RelVelY01Val 3;
BA_ "GenSigStartValue" SG_ 384 FR_CMR_Obj_RelVelY01Val 500;
BA_ "Description" SG_ 384 FR_CMR_Obj_RelVelY01Val "[Lateral velocity] Relative velocity between the subject vehicle and target object. 

Positive velocity : A target object on the left side of the subject vehicle moves away from subject vehicle, or a target object on the right side of the subject vehicle";
BA_ "Version" SG_ 384 FR_CMR_Obj_RelVelY01Val "18.03.01";
BA_ "UserSigValidity" SG_ 384 FR_CMR_Obj_RelAccelX01Val 3;
BA_ "Description" SG_ 384 FR_CMR_Obj_RelAccelX01Val "[Longitudinal acceleration] Relative acceleration between the subject and target vehicle. 

Positive acceleration : a target object moves away from the subject vehicle, or a following object approaches the subject vehicle.";
BA_ "Version" SG_ 384 FR_CMR_Obj_RelAccelX01Val "18.03.01";
BA_ "UserSigValidity" SG_ 384 FR_CMR_Obj_QualLvl02Sta 3;
BA_ "Description" SG_ 384 FR_CMR_Obj_QualLvl02Sta "[Quality level] Information quality for a target object. Information quality can be interpreted by reliability, validity, probability etc.  

Value range : 0~100 (0~30 : Low, 30~60 : Medium, 60~100 : High)";
BA_ "Version" SG_ 384 FR_CMR_Obj_QualLvl02Sta "18.03.01";
BA_ "UserSigValidity" SG_ 384 FR_CMR_Obj_AlvAge02Val 3;
BA_ "Description" SG_ 384 FR_CMR_Obj_AlvAge02Val "[Alive Age] Lifetime

(Keep the higher values than 255 as 255.)";
BA_ "Version" SG_ 384 FR_CMR_Obj_AlvAge02Val "18.03.01";
BA_ "UserSigValidity" SG_ 384 FR_CMR_Obj_MvngFlag02Sta 3;
BA_ "Description" SG_ 384 FR_CMR_Obj_MvngFlag02Sta "[Moving flag] Moving information for a forward or oncoming object (ex. preceding vehicle, oncoming vehicle) : Stationary, Movable (Moving, Stopped) etc.";
BA_ "Version" SG_ 384 FR_CMR_Obj_MvngFlag02Sta "18.03.01";
BA_ "UserSigValidity" SG_ 384 FR_CMR_Obj_Id02Val 3;
BA_ "Description" SG_ 384 FR_CMR_Obj_Id02Val "[Track ID] Unlike radar (including corner radar), extra 'Track ID' signal is required because camera automatically sorts messages according to distance between subject and track vehicle. (1-127 valid and 0 is always invalid)";
BA_ "Version" SG_ 384 FR_CMR_Obj_Id02Val "18.03.01";
BA_ "UserSigValidity" SG_ 384 FR_CMR_Obj_Wth02Val 3;
BA_ "Description" SG_ 384 FR_CMR_Obj_Wth02Val "[Object width] Target object width. ";
BA_ "Version" SG_ 384 FR_CMR_Obj_Wth02Val "18.03.01";
BA_ "UserSigValidity" SG_ 384 FR_CMR_Obj_Clfct02Sta 3;
BA_ "Description" SG_ 384 FR_CMR_Obj_Clfct02Sta "[Object classification] Object classification result. 

Passenger car, Motor bike, truck, bicycle, pedestrian, etc. ";
BA_ "Version" SG_ 384 FR_CMR_Obj_Clfct02Sta "18.03.01";
BA_ "UserSigValidity" SG_ 384 FR_CMR_Obj_RelPosX02Val 3;
BA_ "GenSigStartValue" SG_ 384 FR_CMR_Obj_RelPosX02Val 7000;
BA_ "Description" SG_ 384 FR_CMR_Obj_RelPosX02Val "[Longitudinal distance] Physical distance between the subject vehicle and a target object in the x-axis of vehicle fixed coordinate system (ISO).

Reference point of the subject vehicle : the center of front bumper

Reference point of a target object : t";
BA_ "Version" SG_ 384 FR_CMR_Obj_RelPosX02Val "18.03.01";
BA_ "UserSigValidity" SG_ 384 FR_CMR_Obj_RelPosY02Val 3;
BA_ "Description" SG_ 384 FR_CMR_Obj_RelPosY02Val "[Lateral distance] Physical distance between the subject and a target object in the y-axis of vehicle fixed coordinate system (ISO). 

Reference point of the subject vehicle : centerline of the subject vehicle (x-axis of vehicle fixed coordinate system)

";
BA_ "Version" SG_ 384 FR_CMR_Obj_RelPosY02Val "18.03.01";
BA_ "UserSigValidity" SG_ 384 FR_CMR_Obj_RelVelX02Val 3;
BA_ "GenSigStartValue" SG_ 384 FR_CMR_Obj_RelVelX02Val 2000;
BA_ "Description" SG_ 384 FR_CMR_Obj_RelVelX02Val "[Longitudinal velocity] Relative velocity between the subject vehicle and a target object. 

Positive velocity : A forward object moves away from the subject vehicle, or a following object approaches the subject vehicle.";
BA_ "Version" SG_ 384 FR_CMR_Obj_RelVelX02Val "18.03.01";
BA_ "UserSigValidity" SG_ 384 FR_CMR_Obj_RelVelY02Val 3;
BA_ "GenSigStartValue" SG_ 384 FR_CMR_Obj_RelVelY02Val 500;
BA_ "Description" SG_ 384 FR_CMR_Obj_RelVelY02Val "[Lateral velocity] Relative velocity between the subject vehicle and target object. 

Positive velocity : A target object on the left side of the subject vehicle moves away from subject vehicle, or a target object on the right side of the subject vehicle";
BA_ "Version" SG_ 384 FR_CMR_Obj_RelVelY02Val "18.03.01";
BA_ "UserSigValidity" SG_ 384 FR_CMR_Obj_RelAccelX02Val 3;
BA_ "Description" SG_ 384 FR_CMR_Obj_RelAccelX02Val "[Longitudinal acceleration] Relative acceleration between the subject and target vehicle. 

Positive acceleration : a target object moves away from the subject vehicle, or a following object approaches the subject vehicle.";
BA_ "Version" SG_ 384 FR_CMR_Obj_RelAccelX02Val "18.03.01";
BA_ "UserSigValidity" SG_ 385 FR_CMR_Obj_Crc02Val 3;
BA_ "GenSigStartValue" SG_ 385 FR_CMR_Obj_Crc02Val 65535;
BA_ "Description" SG_ 385 FR_CMR_Obj_Crc02Val "[Cyclic redundancy check] The CRC checking process calculates the CRC over the entire data block, including the CRC result CRC Polynomial (0x1021) ,

Initial Value : 0xFFFF, XOR value : 0x0000

The mathematical expression to 16 bit CRC polynomial is give";
BA_ "Version" SG_ 385 FR_CMR_Obj_Crc02Val "18.03.01";
BA_ "UserSigValidity" SG_ 385 FR_CMR_Obj_AlvCnt02Val 3;
BA_ "Description" SG_ 385 FR_CMR_Obj_AlvCnt02Val "[Alive counter] For the first transmission request for a data element the counter shall be initialized with 0 and shall be incremented by 1

for every subsequent send request. When the counter reaches the maximum value(0xFF), then it shall restart with �";
BA_ "Version" SG_ 385 FR_CMR_Obj_AlvCnt02Val "18.03.01";
BA_ "UserSigValidity" SG_ 385 FR_CMR_Obj_QualLvl03Sta 3;
BA_ "Description" SG_ 385 FR_CMR_Obj_QualLvl03Sta "[Quality level] Information quality for a target object. Information quality can be interpreted by reliability, validity, probability etc.  

Value range : 0~100 (0~30 : Low, 30~60 : Medium, 60~100 : High)";
BA_ "Version" SG_ 385 FR_CMR_Obj_QualLvl03Sta "18.03.01";
BA_ "UserSigValidity" SG_ 385 FR_CMR_Obj_AlvAge03Val 3;
BA_ "Description" SG_ 385 FR_CMR_Obj_AlvAge03Val "[Alive Age] Lifetime

(Keep the higher values than 255 as 255.)";
BA_ "Version" SG_ 385 FR_CMR_Obj_AlvAge03Val "18.03.01";
BA_ "UserSigValidity" SG_ 385 FR_CMR_Obj_MvngFlag03Sta 3;
BA_ "Description" SG_ 385 FR_CMR_Obj_MvngFlag03Sta "[Moving flag] Moving information for a forward or oncoming object (ex. preceding vehicle, oncoming vehicle) : Stationary, Movable (Moving, Stopped) etc.";
BA_ "Version" SG_ 385 FR_CMR_Obj_MvngFlag03Sta "18.03.01";
BA_ "UserSigValidity" SG_ 385 FR_CMR_Obj_Id03Val 3;
BA_ "Description" SG_ 385 FR_CMR_Obj_Id03Val "[Track ID] Unlike radar (including corner radar), extra 'Track ID' signal is required because camera automatically sorts messages according to distance between subject and track vehicle. (1-127 valid and 0 is always invalid)";
BA_ "Version" SG_ 385 FR_CMR_Obj_Id03Val "18.03.01";
BA_ "UserSigValidity" SG_ 385 FR_CMR_Obj_Wth03Val 3;
BA_ "Description" SG_ 385 FR_CMR_Obj_Wth03Val "[Object width] Target object width. ";
BA_ "Version" SG_ 385 FR_CMR_Obj_Wth03Val "18.03.01";
BA_ "UserSigValidity" SG_ 385 FR_CMR_Obj_Clfct03Sta 3;
BA_ "Description" SG_ 385 FR_CMR_Obj_Clfct03Sta "[Object classification] Object classification result. 

Passenger car, Motor bike, truck, bicycle, pedestrian, etc. ";
BA_ "Version" SG_ 385 FR_CMR_Obj_Clfct03Sta "18.03.01";
BA_ "UserSigValidity" SG_ 385 FR_CMR_Obj_RelPosX03Val 3;
BA_ "GenSigStartValue" SG_ 385 FR_CMR_Obj_RelPosX03Val 7000;
BA_ "Description" SG_ 385 FR_CMR_Obj_RelPosX03Val "[Longitudinal distance] Physical distance between the subject vehicle and a target object in the x-axis of vehicle fixed coordinate system (ISO).

Reference point of the subject vehicle : the center of front bumper

Reference point of a target object : t";
BA_ "Version" SG_ 385 FR_CMR_Obj_RelPosX03Val "18.03.01";
BA_ "UserSigValidity" SG_ 385 FR_CMR_Obj_RelPosY03Val 3;
BA_ "Description" SG_ 385 FR_CMR_Obj_RelPosY03Val "[Lateral distance] Physical distance between the subject and a target object in the y-axis of vehicle fixed coordinate system (ISO). 

Reference point of the subject vehicle : centerline of the subject vehicle (x-axis of vehicle fixed coordinate system)

";
BA_ "Version" SG_ 385 FR_CMR_Obj_RelPosY03Val "18.03.01";
BA_ "UserSigValidity" SG_ 385 FR_CMR_Obj_RelVelX03Val 3;
BA_ "GenSigStartValue" SG_ 385 FR_CMR_Obj_RelVelX03Val 2000;
BA_ "Description" SG_ 385 FR_CMR_Obj_RelVelX03Val "[Longitudinal velocity] Relative velocity between the subject vehicle and a target object. 

Positive velocity : A forward object moves away from the subject vehicle, or a following object approaches the subject vehicle.";
BA_ "Version" SG_ 385 FR_CMR_Obj_RelVelX03Val "18.03.01";
BA_ "UserSigValidity" SG_ 385 FR_CMR_Obj_RelVelY03Val 3;
BA_ "GenSigStartValue" SG_ 385 FR_CMR_Obj_RelVelY03Val 500;
BA_ "Description" SG_ 385 FR_CMR_Obj_RelVelY03Val "[Lateral velocity] Relative velocity between the subject vehicle and target object. 

Positive velocity : A target object on the left side of the subject vehicle moves away from subject vehicle, or a target object on the right side of the subject vehicle";
BA_ "Version" SG_ 385 FR_CMR_Obj_RelVelY03Val "18.03.01";
BA_ "UserSigValidity" SG_ 385 FR_CMR_Obj_RelAccelX03Val 3;
BA_ "Description" SG_ 385 FR_CMR_Obj_RelAccelX03Val "[Longitudinal acceleration] Relative acceleration between the subject and target vehicle. 

Positive acceleration : a target object moves away from the subject vehicle, or a following object approaches the subject vehicle.";
BA_ "Version" SG_ 385 FR_CMR_Obj_RelAccelX03Val "18.03.01";
BA_ "UserSigValidity" SG_ 385 FR_CMR_Obj_QualLvl04Sta 3;
BA_ "Description" SG_ 385 FR_CMR_Obj_QualLvl04Sta "[Quality level] Information quality for a target object. Information quality can be interpreted by reliability, validity, probability etc.  

Value range : 0~100 (0~30 : Low, 30~60 : Medium, 60~100 : High)";
BA_ "Version" SG_ 385 FR_CMR_Obj_QualLvl04Sta "18.03.01";
BA_ "UserSigValidity" SG_ 385 FR_CMR_Obj_AlvAge04Val 3;
BA_ "Description" SG_ 385 FR_CMR_Obj_AlvAge04Val "[Alive Age] Lifetime

(Keep the higher values than 255 as 255.)";
BA_ "Version" SG_ 385 FR_CMR_Obj_AlvAge04Val "18.03.01";
BA_ "UserSigValidity" SG_ 385 FR_CMR_Obj_MvngFlag04Sta 3;
BA_ "Description" SG_ 385 FR_CMR_Obj_MvngFlag04Sta "[Moving flag] Moving information for a forward or oncoming object (ex. preceding vehicle, oncoming vehicle) : Stationary, Movable (Moving, Stopped) etc.";
BA_ "Version" SG_ 385 FR_CMR_Obj_MvngFlag04Sta "18.03.01";
BA_ "UserSigValidity" SG_ 385 FR_CMR_Obj_Id04Val 3;
BA_ "Description" SG_ 385 FR_CMR_Obj_Id04Val "[Track ID] Unlike radar (including corner radar), extra 'Track ID' signal is required because camera automatically sorts messages according to distance between subject and track vehicle. (1-127 valid and 0 is always invalid)";
BA_ "Version" SG_ 385 FR_CMR_Obj_Id04Val "18.03.01";
BA_ "UserSigValidity" SG_ 385 FR_CMR_Obj_Wth04Val 3;
BA_ "Description" SG_ 385 FR_CMR_Obj_Wth04Val "[Object width] Target object width. ";
BA_ "Version" SG_ 385 FR_CMR_Obj_Wth04Val "18.03.01";
BA_ "UserSigValidity" SG_ 385 FR_CMR_Obj_Clfct04Sta 3;
BA_ "Description" SG_ 385 FR_CMR_Obj_Clfct04Sta "[Object classification] Object classification result. 

Passenger car, Motor bike, truck, bicycle, pedestrian, etc. ";
BA_ "Version" SG_ 385 FR_CMR_Obj_Clfct04Sta "18.03.01";
BA_ "UserSigValidity" SG_ 385 FR_CMR_Obj_RelPosX04Val 3;
BA_ "GenSigStartValue" SG_ 385 FR_CMR_Obj_RelPosX04Val 7000;
BA_ "Description" SG_ 385 FR_CMR_Obj_RelPosX04Val "[Longitudinal distance] Physical distance between the subject vehicle and a target object in the x-axis of vehicle fixed coordinate system (ISO).

Reference point of the subject vehicle : the center of front bumper

Reference point of a target object : t";
BA_ "Version" SG_ 385 FR_CMR_Obj_RelPosX04Val "18.03.01";
BA_ "UserSigValidity" SG_ 385 FR_CMR_Obj_RelPosY04Val 3;
BA_ "Description" SG_ 385 FR_CMR_Obj_RelPosY04Val "[Lateral distance] Physical distance between the subject and a target object in the y-axis of vehicle fixed coordinate system (ISO). 

Reference point of the subject vehicle : centerline of the subject vehicle (x-axis of vehicle fixed coordinate system)

";
BA_ "Version" SG_ 385 FR_CMR_Obj_RelPosY04Val "18.03.01";
BA_ "UserSigValidity" SG_ 385 FR_CMR_Obj_RelVelX04Val 3;
BA_ "GenSigStartValue" SG_ 385 FR_CMR_Obj_RelVelX04Val 2000;
BA_ "Description" SG_ 385 FR_CMR_Obj_RelVelX04Val "[Longitudinal velocity] Relative velocity between the subject vehicle and a target object. 

Positive velocity : A forward object moves away from the subject vehicle, or a following object approaches the subject vehicle.";
BA_ "Version" SG_ 385 FR_CMR_Obj_RelVelX04Val "18.03.01";
BA_ "UserSigValidity" SG_ 385 FR_CMR_Obj_RelVelY04Val 3;
BA_ "GenSigStartValue" SG_ 385 FR_CMR_Obj_RelVelY04Val 500;
BA_ "Description" SG_ 385 FR_CMR_Obj_RelVelY04Val "[Lateral velocity] Relative velocity between the subject vehicle and target object. 

Positive velocity : A target object on the left side of the subject vehicle moves away from subject vehicle, or a target object on the right side of the subject vehicle";
BA_ "Version" SG_ 385 FR_CMR_Obj_RelVelY04Val "18.03.01";
BA_ "UserSigValidity" SG_ 385 FR_CMR_Obj_RelAccelX04Val 3;
BA_ "Description" SG_ 385 FR_CMR_Obj_RelAccelX04Val "[Longitudinal acceleration] Relative acceleration between the subject and target vehicle. 

Positive acceleration : a target object moves away from the subject vehicle, or a following object approaches the subject vehicle.";
BA_ "Version" SG_ 385 FR_CMR_Obj_RelAccelX04Val "18.03.01";
BA_ "UserSigValidity" SG_ 386 FR_CMR_Obj_Crc03Val 3;
BA_ "GenSigStartValue" SG_ 386 FR_CMR_Obj_Crc03Val 65535;
BA_ "Description" SG_ 386 FR_CMR_Obj_Crc03Val "[Cyclic redundancy check] The CRC checking process calculates the CRC over the entire data block, including the CRC result CRC Polynomial (0x1021) ,

Initial Value : 0xFFFF, XOR value : 0x0000

The mathematical expression to 16 bit CRC polynomial is give";
BA_ "Version" SG_ 386 FR_CMR_Obj_Crc03Val "18.03.01";
BA_ "UserSigValidity" SG_ 386 FR_CMR_Obj_AlvCnt03Val 3;
BA_ "Description" SG_ 386 FR_CMR_Obj_AlvCnt03Val "[Alive counter] For the first transmission request for a data element the counter shall be initialized with 0 and shall be incremented by 1

for every subsequent send request. When the counter reaches the maximum value(0xFF), then it shall restart with �";
BA_ "Version" SG_ 386 FR_CMR_Obj_AlvCnt03Val "18.03.01";
BA_ "UserSigValidity" SG_ 386 FR_CMR_Obj_QualLvl05Sta 3;
BA_ "Description" SG_ 386 FR_CMR_Obj_QualLvl05Sta "[Quality level] Information quality for a target object. Information quality can be interpreted by reliability, validity, probability etc.  

Value range : 0~100 (0~30 : Low, 30~60 : Medium, 60~100 : High)";
BA_ "Version" SG_ 386 FR_CMR_Obj_QualLvl05Sta "18.03.01";
BA_ "UserSigValidity" SG_ 386 FR_CMR_Obj_AlvAge05Val 3;
BA_ "Description" SG_ 386 FR_CMR_Obj_AlvAge05Val "[Alive Age] Lifetime

(Keep the higher values than 255 as 255.)";
BA_ "Version" SG_ 386 FR_CMR_Obj_AlvAge05Val "18.03.01";
BA_ "UserSigValidity" SG_ 386 FR_CMR_Obj_MvngFlag05Sta 3;
BA_ "Description" SG_ 386 FR_CMR_Obj_MvngFlag05Sta "[Moving flag] Moving information for a forward or oncoming object (ex. preceding vehicle, oncoming vehicle) : Stationary, Movable (Moving, Stopped) etc.";
BA_ "Version" SG_ 386 FR_CMR_Obj_MvngFlag05Sta "18.03.01";
BA_ "UserSigValidity" SG_ 386 FR_CMR_Obj_Id05Val 3;
BA_ "Description" SG_ 386 FR_CMR_Obj_Id05Val "[Track ID] Unlike radar (including corner radar), extra 'Track ID' signal is required because camera automatically sorts messages according to distance between subject and track vehicle. (1-127 valid and 0 is always invalid)";
BA_ "Version" SG_ 386 FR_CMR_Obj_Id05Val "18.03.01";
BA_ "UserSigValidity" SG_ 386 FR_CMR_Obj_Wth05Val 3;
BA_ "Description" SG_ 386 FR_CMR_Obj_Wth05Val "[Object width] Target object width. ";
BA_ "Version" SG_ 386 FR_CMR_Obj_Wth05Val "18.03.01";
BA_ "UserSigValidity" SG_ 386 FR_CMR_Obj_Clfct05Sta 3;
BA_ "Description" SG_ 386 FR_CMR_Obj_Clfct05Sta "[Object classification] Object classification result. 

Passenger car, Motor bike, truck, bicycle, pedestrian, etc. ";
BA_ "Version" SG_ 386 FR_CMR_Obj_Clfct05Sta "18.03.01";
BA_ "UserSigValidity" SG_ 386 FR_CMR_Obj_RelPosX05Val 3;
BA_ "GenSigStartValue" SG_ 386 FR_CMR_Obj_RelPosX05Val 7000;
BA_ "Description" SG_ 386 FR_CMR_Obj_RelPosX05Val "[Longitudinal distance] Physical distance between the subject vehicle and a target object in the x-axis of vehicle fixed coordinate system (ISO).

Reference point of the subject vehicle : the center of front bumper

Reference point of a target object : t";
BA_ "Version" SG_ 386 FR_CMR_Obj_RelPosX05Val "18.03.01";
BA_ "UserSigValidity" SG_ 386 FR_CMR_Obj_RelPosY05Val 3;
BA_ "Description" SG_ 386 FR_CMR_Obj_RelPosY05Val "[Lateral distance] Physical distance between the subject and a target object in the y-axis of vehicle fixed coordinate system (ISO). 

Reference point of the subject vehicle : centerline of the subject vehicle (x-axis of vehicle fixed coordinate system)

";
BA_ "Version" SG_ 386 FR_CMR_Obj_RelPosY05Val "18.03.01";
BA_ "UserSigValidity" SG_ 386 FR_CMR_Obj_RelVelX05Val 3;
BA_ "GenSigStartValue" SG_ 386 FR_CMR_Obj_RelVelX05Val 2000;
BA_ "Description" SG_ 386 FR_CMR_Obj_RelVelX05Val "[Longitudinal velocity] Relative velocity between the subject vehicle and a target object. 

Positive velocity : A forward object moves away from the subject vehicle, or a following object approaches the subject vehicle.";
BA_ "Version" SG_ 386 FR_CMR_Obj_RelVelX05Val "18.03.01";
BA_ "UserSigValidity" SG_ 386 FR_CMR_Obj_RelVelY05Val 3;
BA_ "GenSigStartValue" SG_ 386 FR_CMR_Obj_RelVelY05Val 500;
BA_ "Description" SG_ 386 FR_CMR_Obj_RelVelY05Val "[Lateral velocity] Relative velocity between the subject vehicle and target object. 

Positive velocity : A target object on the left side of the subject vehicle moves away from subject vehicle, or a target object on the right side of the subject vehicle";
BA_ "Version" SG_ 386 FR_CMR_Obj_RelVelY05Val "18.03.01";
BA_ "UserSigValidity" SG_ 386 FR_CMR_Obj_RelAccelX05Val 3;
BA_ "Description" SG_ 386 FR_CMR_Obj_RelAccelX05Val "[Longitudinal acceleration] Relative acceleration between the subject and target vehicle. 

Positive acceleration : a target object moves away from the subject vehicle, or a following object approaches the subject vehicle.";
BA_ "Version" SG_ 386 FR_CMR_Obj_RelAccelX05Val "18.03.01";
BA_ "UserSigValidity" SG_ 386 FR_CMR_Obj_QualLvl06Sta 3;
BA_ "Description" SG_ 386 FR_CMR_Obj_QualLvl06Sta "[Quality level] Information quality for a target object. Information quality can be interpreted by reliability, validity, probability etc.  

Value range : 0~100 (0~30 : Low, 30~60 : Medium, 60~100 : High)";
BA_ "Version" SG_ 386 FR_CMR_Obj_QualLvl06Sta "18.03.01";
BA_ "UserSigValidity" SG_ 386 FR_CMR_Obj_AlvAge06Val 3;
BA_ "Description" SG_ 386 FR_CMR_Obj_AlvAge06Val "[Alive Age] Lifetime

(Keep the higher values than 255 as 255.)";
BA_ "Version" SG_ 386 FR_CMR_Obj_AlvAge06Val "18.03.01";
BA_ "UserSigValidity" SG_ 386 FR_CMR_Obj_MvngFlag06Sta 3;
BA_ "Description" SG_ 386 FR_CMR_Obj_MvngFlag06Sta "[Moving flag] Moving information for a forward or oncoming object (ex. preceding vehicle, oncoming vehicle) : Stationary, Movable (Moving, Stopped) etc.";
BA_ "Version" SG_ 386 FR_CMR_Obj_MvngFlag06Sta "18.03.01";
BA_ "UserSigValidity" SG_ 386 FR_CMR_Obj_Id06Val 3;
BA_ "Description" SG_ 386 FR_CMR_Obj_Id06Val "[Track ID] Unlike radar (including corner radar), extra 'Track ID' signal is required because camera automatically sorts messages according to distance between subject and track vehicle. (1-127 valid and 0 is always invalid)";
BA_ "Version" SG_ 386 FR_CMR_Obj_Id06Val "18.03.01";
BA_ "UserSigValidity" SG_ 386 FR_CMR_Obj_Wth06Val 3;
BA_ "Description" SG_ 386 FR_CMR_Obj_Wth06Val "[Object width] Target object width. ";
BA_ "Version" SG_ 386 FR_CMR_Obj_Wth06Val "18.03.01";
BA_ "UserSigValidity" SG_ 386 FR_CMR_Obj_Clfct06Sta 3;
BA_ "Description" SG_ 386 FR_CMR_Obj_Clfct06Sta "[Object classification] Object classification result. 

Passenger car, Motor bike, truck, bicycle, pedestrian, etc. ";
BA_ "Version" SG_ 386 FR_CMR_Obj_Clfct06Sta "18.03.01";
BA_ "UserSigValidity" SG_ 386 FR_CMR_Obj_RelPosX06Val 3;
BA_ "GenSigStartValue" SG_ 386 FR_CMR_Obj_RelPosX06Val 7000;
BA_ "Description" SG_ 386 FR_CMR_Obj_RelPosX06Val "[Longitudinal distance] Physical distance between the subject vehicle and a target object in the x-axis of vehicle fixed coordinate system (ISO).

Reference point of the subject vehicle : the center of front bumper

Reference point of a target object : t";
BA_ "Version" SG_ 386 FR_CMR_Obj_RelPosX06Val "18.03.01";
BA_ "UserSigValidity" SG_ 386 FR_CMR_Obj_RelPosY06Val 3;
BA_ "Description" SG_ 386 FR_CMR_Obj_RelPosY06Val "[Lateral distance] Physical distance between the subject and a target object in the y-axis of vehicle fixed coordinate system (ISO). 

Reference point of the subject vehicle : centerline of the subject vehicle (x-axis of vehicle fixed coordinate system)

";
BA_ "Version" SG_ 386 FR_CMR_Obj_RelPosY06Val "18.03.01";
BA_ "UserSigValidity" SG_ 386 FR_CMR_Obj_RelVelX06Val 3;
BA_ "GenSigStartValue" SG_ 386 FR_CMR_Obj_RelVelX06Val 2000;
BA_ "Description" SG_ 386 FR_CMR_Obj_RelVelX06Val "[Longitudinal velocity] Relative velocity between the subject vehicle and a target object. 

Positive velocity : A forward object moves away from the subject vehicle, or a following object approaches the subject vehicle.";
BA_ "Version" SG_ 386 FR_CMR_Obj_RelVelX06Val "18.03.01";
BA_ "UserSigValidity" SG_ 386 FR_CMR_Obj_RelVelY06Val 3;
BA_ "GenSigStartValue" SG_ 386 FR_CMR_Obj_RelVelY06Val 500;
BA_ "Description" SG_ 386 FR_CMR_Obj_RelVelY06Val "[Lateral velocity] Relative velocity between the subject vehicle and target object. 

Positive velocity : A target object on the left side of the subject vehicle moves away from subject vehicle, or a target object on the right side of the subject vehicle";
BA_ "Version" SG_ 386 FR_CMR_Obj_RelVelY06Val "18.03.01";
BA_ "UserSigValidity" SG_ 386 FR_CMR_Obj_RelAccelX06Val 3;
BA_ "Description" SG_ 386 FR_CMR_Obj_RelAccelX06Val "[Longitudinal acceleration] Relative acceleration between the subject and target vehicle. 

Positive acceleration : a target object moves away from the subject vehicle, or a following object approaches the subject vehicle.";
BA_ "Version" SG_ 386 FR_CMR_Obj_RelAccelX06Val "18.03.01";
BA_ "UserSigValidity" SG_ 387 FR_CMR_Obj_Crc04Val 3;
BA_ "GenSigStartValue" SG_ 387 FR_CMR_Obj_Crc04Val 65535;
BA_ "Description" SG_ 387 FR_CMR_Obj_Crc04Val "[Cyclic redundancy check] The CRC checking process calculates the CRC over the entire data block, including the CRC result CRC Polynomial (0x1021) ,

Initial Value : 0xFFFF, XOR value : 0x0000

The mathematical expression to 16 bit CRC polynomial is give";
BA_ "Version" SG_ 387 FR_CMR_Obj_Crc04Val "18.03.01";
BA_ "UserSigValidity" SG_ 387 FR_CMR_Obj_AlvCnt04Val 3;
BA_ "Description" SG_ 387 FR_CMR_Obj_AlvCnt04Val "[Alive counter] For the first transmission request for a data element the counter shall be initialized with 0 and shall be incremented by 1

for every subsequent send request. When the counter reaches the maximum value(0xFF), then it shall restart with �";
BA_ "Version" SG_ 387 FR_CMR_Obj_AlvCnt04Val "18.03.01";
BA_ "UserSigValidity" SG_ 387 FR_CMR_Obj_QualLvl07Sta 3;
BA_ "Description" SG_ 387 FR_CMR_Obj_QualLvl07Sta "[Quality level] Information quality for a target object. Information quality can be interpreted by reliability, validity, probability etc.  

Value range : 0~100 (0~30 : Low, 30~60 : Medium, 60~100 : High)";
BA_ "Version" SG_ 387 FR_CMR_Obj_QualLvl07Sta "18.03.01";
BA_ "UserSigValidity" SG_ 387 FR_CMR_Obj_AlvAge07Val 3;
BA_ "Description" SG_ 387 FR_CMR_Obj_AlvAge07Val "[Alive Age] Lifetime

(Keep the higher values than 255 as 255.)";
BA_ "Version" SG_ 387 FR_CMR_Obj_AlvAge07Val "18.03.01";
BA_ "UserSigValidity" SG_ 387 FR_CMR_Obj_MvngFlag07Sta 3;
BA_ "Description" SG_ 387 FR_CMR_Obj_MvngFlag07Sta "[Moving flag] Moving information for a forward or oncoming object (ex. preceding vehicle, oncoming vehicle) : Stationary, Movable (Moving, Stopped) etc.";
BA_ "Version" SG_ 387 FR_CMR_Obj_MvngFlag07Sta "18.03.01";
BA_ "UserSigValidity" SG_ 387 FR_CMR_Obj_Id07Val 3;
BA_ "Description" SG_ 387 FR_CMR_Obj_Id07Val "[Track ID] Unlike radar (including corner radar), extra 'Track ID' signal is required because camera automatically sorts messages according to distance between subject and track vehicle. (1-127 valid and 0 is always invalid)";
BA_ "Version" SG_ 387 FR_CMR_Obj_Id07Val "18.03.01";
BA_ "UserSigValidity" SG_ 387 FR_CMR_Obj_Wth07Val 3;
BA_ "Description" SG_ 387 FR_CMR_Obj_Wth07Val "[Object width] Target object width. ";
BA_ "Version" SG_ 387 FR_CMR_Obj_Wth07Val "18.03.01";
BA_ "UserSigValidity" SG_ 387 FR_CMR_Obj_Clfct07Sta 3;
BA_ "Description" SG_ 387 FR_CMR_Obj_Clfct07Sta "[Object classification] Object classification result. 

Passenger car, Motor bike, truck, bicycle, pedestrian, etc. ";
BA_ "Version" SG_ 387 FR_CMR_Obj_Clfct07Sta "18.03.01";
BA_ "UserSigValidity" SG_ 387 FR_CMR_Obj_RelPosX07Val 3;
BA_ "GenSigStartValue" SG_ 387 FR_CMR_Obj_RelPosX07Val 7000;
BA_ "Description" SG_ 387 FR_CMR_Obj_RelPosX07Val "[Longitudinal distance] Physical distance between the subject vehicle and a target object in the x-axis of vehicle fixed coordinate system (ISO).

Reference point of the subject vehicle : the center of front bumper

Reference point of a target object : t";
BA_ "Version" SG_ 387 FR_CMR_Obj_RelPosX07Val "18.03.01";
BA_ "UserSigValidity" SG_ 387 FR_CMR_Obj_RelPosY07Val 3;
BA_ "Description" SG_ 387 FR_CMR_Obj_RelPosY07Val "[Lateral distance] Physical distance between the subject and a target object in the y-axis of vehicle fixed coordinate system (ISO). 

Reference point of the subject vehicle : centerline of the subject vehicle (x-axis of vehicle fixed coordinate system)

";
BA_ "Version" SG_ 387 FR_CMR_Obj_RelPosY07Val "18.03.01";
BA_ "UserSigValidity" SG_ 387 FR_CMR_Obj_RelVelX07Val 3;
BA_ "GenSigStartValue" SG_ 387 FR_CMR_Obj_RelVelX07Val 2000;
BA_ "Description" SG_ 387 FR_CMR_Obj_RelVelX07Val "[Longitudinal velocity] Relative velocity between the subject vehicle and a target object. 

Positive velocity : A forward object moves away from the subject vehicle, or a following object approaches the subject vehicle.";
BA_ "Version" SG_ 387 FR_CMR_Obj_RelVelX07Val "18.03.01";
BA_ "UserSigValidity" SG_ 387 FR_CMR_Obj_RelVelY07Val 3;
BA_ "GenSigStartValue" SG_ 387 FR_CMR_Obj_RelVelY07Val 500;
BA_ "Description" SG_ 387 FR_CMR_Obj_RelVelY07Val "[Lateral velocity] Relative velocity between the subject vehicle and target object. 

Positive velocity : A target object on the left side of the subject vehicle moves away from subject vehicle, or a target object on the right side of the subject vehicle";
BA_ "Version" SG_ 387 FR_CMR_Obj_RelVelY07Val "18.03.01";
BA_ "UserSigValidity" SG_ 387 FR_CMR_Obj_RelAccelX07Val 3;
BA_ "Description" SG_ 387 FR_CMR_Obj_RelAccelX07Val "[Longitudinal acceleration] Relative acceleration between the subject and target vehicle. 

Positive acceleration : a target object moves away from the subject vehicle, or a following object approaches the subject vehicle.";
BA_ "Version" SG_ 387 FR_CMR_Obj_RelAccelX07Val "18.03.01";
BA_ "UserSigValidity" SG_ 387 FR_CMR_Obj_QualLvl08Sta 3;
BA_ "Description" SG_ 387 FR_CMR_Obj_QualLvl08Sta "[Quality level] Information quality for a target object. Information quality can be interpreted by reliability, validity, probability etc.  

Value range : 0~100 (0~30 : Low, 30~60 : Medium, 60~100 : High)";
BA_ "Version" SG_ 387 FR_CMR_Obj_QualLvl08Sta "18.03.01";
BA_ "UserSigValidity" SG_ 387 FR_CMR_Obj_AlvAge08Val 3;
BA_ "Description" SG_ 387 FR_CMR_Obj_AlvAge08Val "[Alive Age] Lifetime

(Keep the higher values than 255 as 255.)";
BA_ "Version" SG_ 387 FR_CMR_Obj_AlvAge08Val "18.03.01";
BA_ "UserSigValidity" SG_ 387 FR_CMR_Obj_MvngFlag08Sta 3;
BA_ "Description" SG_ 387 FR_CMR_Obj_MvngFlag08Sta "[Moving flag] Moving information for a forward or oncoming object (ex. preceding vehicle, oncoming vehicle) : Stationary, Movable (Moving, Stopped) etc.";
BA_ "Version" SG_ 387 FR_CMR_Obj_MvngFlag08Sta "18.03.01";
BA_ "UserSigValidity" SG_ 387 FR_CMR_Obj_Id08Val 3;
BA_ "Description" SG_ 387 FR_CMR_Obj_Id08Val "[Track ID] Unlike radar (including corner radar), extra 'Track ID' signal is required because camera automatically sorts messages according to distance between subject and track vehicle. (1-127 valid and 0 is always invalid)";
BA_ "Version" SG_ 387 FR_CMR_Obj_Id08Val "18.03.01";
BA_ "UserSigValidity" SG_ 387 FR_CMR_Obj_Wth08Val 3;
BA_ "Description" SG_ 387 FR_CMR_Obj_Wth08Val "[Object width] Target object width. ";
BA_ "Version" SG_ 387 FR_CMR_Obj_Wth08Val "18.03.01";
BA_ "UserSigValidity" SG_ 387 FR_CMR_Obj_Clfct08Sta 3;
BA_ "Description" SG_ 387 FR_CMR_Obj_Clfct08Sta "[Object classification] Object classification result. 

Passenger car, Motor bike, truck, bicycle, pedestrian, etc. ";
BA_ "Version" SG_ 387 FR_CMR_Obj_Clfct08Sta "18.03.01";
BA_ "UserSigValidity" SG_ 387 FR_CMR_Obj_RelPosX08Val 3;
BA_ "GenSigStartValue" SG_ 387 FR_CMR_Obj_RelPosX08Val 7000;
BA_ "Description" SG_ 387 FR_CMR_Obj_RelPosX08Val "[Longitudinal distance] Physical distance between the subject vehicle and a target object in the x-axis of vehicle fixed coordinate system (ISO).

Reference point of the subject vehicle : the center of front bumper

Reference point of a target object : t";
BA_ "Version" SG_ 387 FR_CMR_Obj_RelPosX08Val "18.03.01";
BA_ "UserSigValidity" SG_ 387 FR_CMR_Obj_RelPosY08Val 3;
BA_ "Description" SG_ 387 FR_CMR_Obj_RelPosY08Val "[Lateral distance] Physical distance between the subject and a target object in the y-axis of vehicle fixed coordinate system (ISO). 

Reference point of the subject vehicle : centerline of the subject vehicle (x-axis of vehicle fixed coordinate system)

";
BA_ "Version" SG_ 387 FR_CMR_Obj_RelPosY08Val "18.03.01";
BA_ "UserSigValidity" SG_ 387 FR_CMR_Obj_RelVelX08Val 3;
BA_ "GenSigStartValue" SG_ 387 FR_CMR_Obj_RelVelX08Val 2000;
BA_ "Description" SG_ 387 FR_CMR_Obj_RelVelX08Val "[Longitudinal velocity] Relative velocity between the subject vehicle and a target object. 

Positive velocity : A forward object moves away from the subject vehicle, or a following object approaches the subject vehicle.";
BA_ "Version" SG_ 387 FR_CMR_Obj_RelVelX08Val "18.03.01";
BA_ "UserSigValidity" SG_ 387 FR_CMR_Obj_RelVelY08Val 3;
BA_ "GenSigStartValue" SG_ 387 FR_CMR_Obj_RelVelY08Val 500;
BA_ "Description" SG_ 387 FR_CMR_Obj_RelVelY08Val "[Lateral velocity] Relative velocity between the subject vehicle and target object. 

Positive velocity : A target object on the left side of the subject vehicle moves away from subject vehicle, or a target object on the right side of the subject vehicle";
BA_ "Version" SG_ 387 FR_CMR_Obj_RelVelY08Val "18.03.01";
BA_ "UserSigValidity" SG_ 387 FR_CMR_Obj_RelAccelX08Val 3;
BA_ "Description" SG_ 387 FR_CMR_Obj_RelAccelX08Val "[Longitudinal acceleration] Relative acceleration between the subject and target vehicle. 

Positive acceleration : a target object moves away from the subject vehicle, or a following object approaches the subject vehicle.";
BA_ "Version" SG_ 387 FR_CMR_Obj_RelAccelX08Val "18.03.01";
VAL_ 3221225472 USM_SccDrvSetReq 0 "Default" 1 "Slow" 2 "Normal" 3 "Fast" 4 "Reserved" 5 "Reserved" 6 "Reserved" 7 "Invalid" ;
VAL_ 453 HEV_EngSpdErrSta 1 "engine speed sensor defective" 0 "No Error" ;
VAL_ 453 EMS_AliveCounter11Value 255 "Signal Invalid " ;
VAL_ 453 EMS_CyclicRedundancyCheck11Value 65535 "Signal Invalid" ;
VAL_ 48 EMS_SCCIsgEna 3 "Error" 2 "Reserved" 1 "ISG Stop Enable" 0 "ISG Stop not Enable" ;
VAL_ 48 CF_ECU_SSC_STAT 3 "Failure Detected" 2 "Reserved" 1 "SSC ON" 0 "SC OFF (Normal)" ;
VAL_ 48 DCT_AccelPdlVal 0 "Accelerator Pedal not activated" 1022 "Accelerator Pedal fully activated" 1023 "Accelerator Pedal is defective (fail state) or Non-ETC system (APS is not installed), Error indicator" ;
VAL_ 48 DCT_EngSpdErrSta 0 "No error" 1 "Engine speed sensor defective" 2 "Not used" 3 "Error indicator" ;
VAL_ 53 VCU_GearSelDis 0 "P" 1 "B" 2 "Not used" 3 "Not used" 4 "Not used" 5 "D" 6 "N" 7 "R" 8 "Not used" 9 "Not Display at Cluster" 10 "reserved" 11 "reserved" 12 "reserved" 13 "reserved" 14 "Intermediate Position" 15 "Fault" ;
VAL_ 53 VCU_AccelPdlDpthPcVal 255 "Error" ;
VAL_ 53 VCU_EVRdySta 0 "None" 1 "EV Drivable" 2 "Not used" 3 "Error Indicator" ;
VAL_ 64 TCU_GearSlctDis 0 "P" 1 "L" 2 "2" 3 "3" 4 "DS Mode" 5 "D" 6 "N" 7 "R" 8 "sports mode / manual shift / paddle shift" 9 "Not Display at Cluster" 10 "Sub-Rom Communication" 11 "Sub-Rom Communication Error" 12 "Paddle shift (D-position)" 13 "Reserved" 14 "Intermediate Position" 15 "fault" ;
VAL_ 64 TCU_CurrGearSta 0 "if N or P are detected (no frictional connection)" 1 "1st speed" 2 "2nd speed" 3 "3rd speed" 4 "4th speed" 5 "5th speed" 6 "6th speed" 7 "7th speed" 8 "8th speed" 14 "Reverse speed" ;
VAL_ 64 TCU_TrgtGearSta 0 "if N or P are detected (no frictional connection)" 1 "1st speed" 2 "2nd speed" 3 "3rd speed" 4 "4th speed" 5 "5th speed" 6 "6th speed" 7 "7th speed" 8 "8th speed" 14 "Reverse speed" ;
VAL_ 64 TCH_EngTrgtGearSta 0 "if N or P are detected (no frictional connection)" 1 "1st speed" 2 "2nd speed" 3 "3rd speed" 4 "4th speed" 5 "5th speed" 6 "6th speed" 7 "7th speed" 8 "8th speed" 14 "Reverse speed" ;
VAL_ 64 TCU_GearLmpBlnkngReq 0 "No blink" 1 "Request lamp blinking" 2 "Not used" 3 "Error Indicator" ;
VAL_ 64 TCU_SmrtShftSta 0 "Smart Shift not Applied" 1 "Smart Shift Applied" 2 "Not used" 3 "Error Indicator" ;
VAL_ 69 HTCU_GearSlctrDis 5 "5th speed" ;
VAL_ 80 LKA_OptUsmSta_Copy_1 0 "None LKA/LDW Option (Default)" 1 "LDW" 2 "LKA" 3 "Reserved" 4 "LDW Only (None LKA)" 5 "LDW only OFF (None LKA)" 6 "LDW/LKA OFF" 7 "Invalid" ;
VAL_ 80 LKA_RcgSta_Copy_1 0 "Not Recognized" 1 "Full Lane Recognized" 2 "Left Line Recognized" 3 "Right Line Recognized" 4 "Reserved" 5 "Reserved" 6 "Reserved" 7 "Reserved" ;
VAL_ 80 LKA_LHLnWrnSta_Copy_1 0 "No Warning" 1 "Lane Departure Warning" 2 "Reserved" 3 "Reserved" ;
VAL_ 80 LKA_RHLnWrnSta_Copy_1 0 "No Warning" 1 "Lane Departure Warning" 2 "Reserved" 3 "Reserved" ;
VAL_ 80 LKA_HndsoffSnd_Copy_1 0 "Off" 1 "Hands-off Sound Warning" 2 "Reserved" 3 "Reserved" ;
VAL_ 80 LKA_StrSnd_Copy_1 0 "Off" 1 "Warning" 2 "Reserved" 3 "Reserved" ;
VAL_ 80 LKA_SysIndReq_Copy_1 0 "Off" 1 "Unavailable_(Grey On)" 2 "Lane Recognized_(Green On)" 3 "Lane Departure_(Green Blink)" 4 "System Fail_(Orange On)" 5 "Not Calibrated_(Orange Blink)" 6 "Regulation_(Orange On)" 7 "Reserved" ;
VAL_ 80 LKA_ActToiSta_Copy_1 0 "De-activate TOI" 1 "Activate TOI" 2 "Reserved" 3 "Error indicator" ;
VAL_ 80 LKA_ToiFltSta_Copy_1 0 "No Fault" 1 "Fault" 2 "Reserved" 3 "Error indicatorr" ;
VAL_ 80 LKA_SysWrn_Copy_1 0 "No Info" 1 "Reserved" 2 "Reserved" 3 "Reserved" 4 "Hands-Off Warning 1" 5 "Hands-Off Warning 2" 6 "Reserved" 7 "Reserved" 8 "Reserved" 9 "System Automatic off" 10 "Reserved" 11 "Reserved" 12 "Reserved" 13 "Reserved" 14 "Reserved" 15 "System Fail" ;
VAL_ 80 LKA_UsmMod_Copy_1 0 "NONE" 1 "LKA 1 mode" 2 "LKA 2 mode" 3 "LDW" ;
VAL_ 96 ABS_DfctvSta 0 "ABS is not defective" 1 "ABS is defective" 2 "Not used" 3 "Error Indicator" ;
VAL_ 96 ABS_ActvSta 0 "ABS control inactive" 1 "ABS control active" 2 "Not used" 3 "Error Indicator" ;
VAL_ 96 ABS_DiagSta 0 "ABS/TCS/ESC is not diagnostic mode" 1 "ABS/TCS/ESC is diagnostic mode" 2 "Not used" 3 "Error Indicator" ;
VAL_ 96 EBD_DfctvSta 0 "EBD is not defective" 1 "EBD is defective" 2 "Not used" 3 "Error Indicator" ;
VAL_ 96 TCS_LmpSta 0 "TCS/ESC Function/Warning Lamp OFF" 1 "TCS/ESC Function/Warning Lamp ON" 2 "TCS/ESC Function/Warning Lamp BLINKING(2Hz)" 3 "Error Indicator" ;
VAL_ 96 TCS_DisableSta 0 "TCS is enabled by user" 1 "TCS is disabled by user" 2 "Not used" 3 "Error Indicator" ;
VAL_ 96 TCS_DfctvSta 0 "TCS is not defective" 1 "TCS is defective (failed)" 2 "Not used" 3 "Error Indicator" ;
VAL_ 96 TCS_CtrlSta 0 "TCS Inactive" 1 "TCS Active" 2 "Not used" 3 "Error Indicator" ;
VAL_ 96 ESC_DisableSta 0 "ESC enabled by user (SW On)" 1 "ESC disabled by user(SW Off)" 2 "ESC disabled (ABS only applied)" 3 "Error Indicator" ;
VAL_ 96 ESC_DfctvSta 0 "ESC is not defective" 1 "ESC is defective (failed)" 2 "Not used" 3 "Error Indicator" ;
VAL_ 96 ESC_CtrlSta 0 "ESC inactive" 1 "ESC active" 2 "Not used" 3 "Error Indicator" ;
VAL_ 96 TCS_Req 0 "Passive" 1 "TCS/ESC control active" 2 "Not used" 3 "Error Indicator" ;
VAL_ 96 MSR_FuncReq 0 "Passive or TCS function" 1 "MSR control active" 2 "Not used" 3 "Error Indicator" ;
VAL_ 96 ESC_CylPrsrVal 4095 "Error" ;
VAL_ 96 ESC_CylPrsrSta 0 "Master cylinder pressure signal is invalid" 1 "Master cylinder pressure signal is valid" 2 "Not used" 3 "Error Indicator" ;
VAL_ 96 ESC_CylPrsrDiagSta 0 "Master cylinder pressure is not available temporarily" 1 "Master cylinder pressure signal is available" 2 "Not used" 3 "Error Indicator" ;
VAL_ 96 ESC_CylPrsrFlagSta 0 "Off" 1 "On" 2 "Not used" 3 "Error Indicator" ;
VAL_ 96 ESC_VsmActvSta 0 "VSM control inactive" 1 "VSM control active" 2 "Not used" 3 "Error Indicator" ;
VAL_ 96 AVH_Sta 0 "No apply" 1 "Vehicle is held by the service brake" 2 "Being released" 3 "Error Indicator" ;
VAL_ 106 TCU_AtTempCVal 255 "Error Indicator" ;
VAL_ 106 TCU_TqCnvrtrSpdVal 255 "Error Indicator" ;
VAL_ 160 WHL_PlsFLVal 255 "Error" ;
VAL_ 160 WHL_PlsFRVal 255 "Error" ;
VAL_ 160 WHL_PlsRLVal 255 "Error" ;
VAL_ 160 WHL_PlsRRVal 255 "Error" ;
VAL_ 160 WHL_DirFLVal 0 "Unknown (Wheel moving stop state or Not applied wheel sensor for direction)" 1 "Forward direction" 2 "Backward direction" 3 "Error identifier" ;
VAL_ 160 WHL_DirFRVal 0 "Unknown (Wheel moving stop state or Not applied wheel sensor for direction)" 1 "Forward direction" 2 "Backward direction" 3 "Error identifier" ;
VAL_ 160 WHL_DirRLVal 0 "Unknown (Wheel moving stop state or Not applied wheel sensor for direction)" 1 "Forward direction" 2 "Backward direction" 3 "Error identifier" ;
VAL_ 160 WHL_DirRRVal 0 "Unknown (Wheel moving stop state or Not applied wheel sensor for direction)" 1 "Forward direction" 2 "Backward direction" 3 "Error identifier" ;
VAL_ 160 WHL_SpdFLVal 16383 "Error" ;
VAL_ 160 WHL_SpdFRVal 16383 "Error" ;
VAL_ 160 WHL_SpdRLVal 16383 "Error" ;
VAL_ 160 WHL_SpdRRVal 16383 "Error" ;
VAL_ 181 ENG_EngSpdErrSta 0 "No error" 1 "Engine speed sensor defective" 2 "Not used" 3 "Error indicator" ;
VAL_ 181 ENG_IsgSta 0 "ISG is not operating Normal engine operating without ISG" 1 "Idle stop is activated Idle is stopped by ECU during driving" 2 "Automatically started by ECU Engine is automatically started by ECU regardless driver’s volition during idle stop because the condition that ISG function to be prohibited is satisfied, for example SOC is too low." 3 "ISG is prohibited Driver prohibits to activate ISG in order to avoid start lag when he met traffic jam for example." 4 "Fault  existing in ISG. Idle stop is prohibited and engine started automatically if it is idle stop condition." 5 "Idle stop is inhibited by system automatically for safety and  convenient condition related with battery SOC, brake vacuum pressure etc. ISG function check for EOL." 6 "Auto start is deactivated system automatically to keep safety, Such as door open, hood open and seat belt unlock." 7 "If driver shift gear N to D range without braking to make auto starting. (Economy ISG Only)" ;
VAL_ 181 ENG_IgnOnSta 0 "KEY OFF, control unit in self-holding phase" 1 "KEY ON" 2 "Not used" 3 "Error indicator" ;
VAL_ 181 ENG_VehSpdHiVal 511 "Error indicator" ;
VAL_ 186 HCU_HevRdySta 0 "HEV not ready" 1 "HEV Drivable" 2 "Not used" 3 "Error Indicator" ;
VAL_ 186 HCU_SccEnblSta 0 "SCC Impossible" 1 "SCC Possible" 2 "Not used" 3 "Error Indicator" ;
VAL_ 234 MDPS_Typ 0 "C-MDPS" 1 "R-MDPS(Dual Pinion)" 2 "R-MDPS(Belt)" 6 "Not Used" 7 "Error Indicator" ;
VAL_ 234 MDPS_PaModeSta 0 "Reserved" 1 "Steering still in initialization phase" 2 "Steering ready, waits for PA command" 3 "Steering set in standby by PA" 4 "Steering requested to go to first activation step" 5 "Steering requested to go to final activation step" 6 "Steering went to error internally" 7 "Steering aborted the automatic function" 14 "Not Used" 15 "Error Indicator" ;
VAL_ 234 MDPS_LkaPlgInSta 0 "The LKA function of MDPS is not plugged in (unplugged)." 1 "The LKA function of MDPS is plugged in." 2 "Not Used" 3 "Error Indicator" ;
VAL_ 234 MDPS_LkaToiActvSta 0 "Deactivated" 1 "Activated" 2 "Not Used" 3 "Error Indicator" ;
VAL_ 234 MDPS_LkaToiUnblSta 0 "Available" 1 "Unavailable" 2 "Not Used" 3 "Error Indicator" ;
VAL_ 234 MDPS_LkaToiFltSta 0 "No fault" 1 "Faulty" 2 "Not Used" 3 "Error Indicator" ;
VAL_ 234 MDPS_LkaFailSta 0 "Not in fail state" 1 "In fail state" 2 "Not Used" 3 "Error Indicator" ;
VAL_ 234 MDPS_FlxStrSta 0 "Standard Mode" 1 "Sport Mode" 2 "Comport Mode" 3 "RESERVED" 4 "RESERVED" 5 "RESERVED" 6 "Not Used" 7 "Error Indicator" ;
VAL_ 234 MDPS_CurrModVal 0 "Standard Mode" 1 "Sport Mode" 2 "Comfort Mode" 3 "RESERVED" 4 "RESERVED" 5 "RESERVED" 6 "Not Used" 7 "Error Indicator" ;
VAL_ 234 MDPS_OutTqVal 4094 "Not Used" 4095 "Error Indicator" ;
VAL_ 234 MDPS_StrTqSnsrVal 8190 "Not Used" 8191 "Error Indicator" ;
VAL_ 256 EMS_Crc2Val 65535 "Signal Invalid (Message with unused CRC. CRC signal is transmitted fixed value)" ;
VAL_ 256 EMS_AlvCnt2Val 255 "Signal Invalid (Message with unused Alive counter. Alive counter signal is transmitted fixed value)" ;
VAL_ 256 ENG_BrkSwSta 0 "Brake switch is not pressed (OFF)" 1 "Brake switch is pressed (ON)" 2 "EMS does not support this function." 3 "Brake switch failure" ;
VAL_ 256 ENG_EngSta 0 "Engine Stop" 1 "Cranking" 2 "Stalled" 3 "Running" 4 "Reserved" 5 "Reserved" 6 "Reserved" 7 "Fault" ;
VAL_ 256 ENG_AccActSta 0 "Auto cruise control is not active" 1 "Auto cruise control is active" 2 "Not used" 3 "Error indicator" ;
VAL_ 256 ENG_CltchOpSta 0 "Clutch is not operating" 1 "Clutch is operating" 2 "Not used" 3 "Error indicator" ;
VAL_ 256 ENG_AccelPdlVal 0 "Accelerator Pedal not activated" 1022 "Accelerator Pedal fully activated" 1023 "Accelerator Pedal is defective (fail state) or Non-ETC system (APS is not installed), Error indicator" ;
VAL_ 256 ENG_AppAccelPdlSta 0 "Accelerator pedal not pressed" 1 "Accelerator pedal pressed" 2 "Reserved" 3 "Accelerator pedal position sensor failure" ;
VAL_ 261 HEV_AccelPdlVal 0 "Accelerator Pedal not activated" 254 "Accelerator Pedal fully activated" 255 "Accelerator Pedal is defective (fail state) or Non-ETC system (APS is not installed)" ;
VAL_ 282 HBA_SysOptSta 0 "None HBA Option (Default)" 1 "HBA Option" 2 "Reserved" 3 "Error indicator" ;
VAL_ 282 HBA_SysSta 0 "HBA Disable" 1 "HBA Enable & High Beam Off" 2 "HBA Enable & High Beam On" 3 "Reserved" 4 "Reserved" 5 "Reserved" 6 "Reserved" 7 "System Fail" ;
VAL_ 282 HBA_IndLmpReq 0 "HBA Indicator Lamp Off" 1 "HBA Indicator Lamp On" 2 "Reserved" 3 "Error indicator" ;
VAL_ 282 iHBAref_VehLftSta 0 "Exist (Default)" 1 "None" 2 "Reserved" 3 "Error indicator" ;
VAL_ 282 iHBAref_VehCtrSta 0 "Exist (Default)" 1 "None" 2 "Reserved" 3 "Error indicator" ;
VAL_ 282 iHBAref_VehRtSta 0 "Exist (Default)" 1 "None" 2 "Reserved" 3 "Error indicator" ;
VAL_ 282 iHBAref_ILLAmbtSta 0 "Bright (HighBeam off)" 1 "Dark" 2 "Reserved" 3 "Error indicator" ;
VAL_ 282 FCA_Equip_MFC 0 "No Coding" 1 "Sensor Fusion FCA" 2 "Camera only FCA" 3 "No FCA Option" 4 "ADAS_DRV Option" 5 "Reserved" 6 "Not used" 7 "Error indicator" ;
VAL_ 282 HBA_OptUsmSta 0 "None HBA Option (Default)" 1 "HBA Function Off" 2 "HBA Function On" 3 "Invalid (Fail)" ;
VAL_ 282 FCAref_FusSta 0 "Normal" 1 "Fusion Disabled" 2 "Front Radar Communication Error" 3 "Camera Blockage" 4 "Reserved" 5 "Reserved" 6 "Reserved" 7 "Reserved" ;
VAL_ 282 DAW_LVDA_PUDis 0 "Default" 1 "Display “Leading vehicle departure alert”" 2 "Reserved" 3 "Error indicator" ;
VAL_ 282 DAW_LVDA_OptUsmSta 0 "No Option (default)" 1 "Off" 2 "On" 3 "Error Indicator" ;
VAL_ 282 DAW_OptUsmSta 0 "None DAW Option (Default)" 1 "System Off" 2 "System On" 3 "Reserved" 4 "Reserved" 5 "Reserved" 6 "Reserved" 7 "Invalid (Gray)" ;
VAL_ 282 DAW_SysSta 0 "System Off" 1 "Attention Level  1" 2 "Attention Level  2" 3 "Attention Level  3" 4 "Attention Level  4" 5 "Attention Level  5" 6 "Reserved" 7 "Reserved" 8 "Reserved" 9 "Reserved" 10 "Reserved" 11 "Reserved" 12 "Reserved" 13 "Reserved" 14 "System Standby" 15 "System Fail" ;
VAL_ 282 DAW_WrnMsgSta 0 "No Warning" 1 "Rest Recommend Warning" 2 "Reserved" 3 "Reserved" 4 "Reserved" 5 "Reserved" 6 "Reserved" 7 "Error indicator" ;
VAL_ 282 DAW_TimeRstReq 0 "No signal" 1 "Time reset" 2 "Reserved" 3 "Error indicator" ;
VAL_ 282 DAW_SnstvtyModRetVal 0 "Default" 1 "Late" 2 "Normal" 3 "Reserved" 4 "Reserved" 5 "Reserved" 6 "Reserved" 7 "Invalid" ;
VAL_ 293 SAS_AnglVal 32767 "Error Indicator" ;
VAL_ 293 SAS_SpdVal 255 "Error Indicator" ;
VAL_ 314 Info_TypeL 0 "Ground" 1 "Bump" 2 "Hole" 3 "Reserved" ;
VAL_ 314 Info_CyclicCounterL 0 "Cyclic Counter" 1 "Cyclic Counter" 2 "Cyclic Counter" 3 "Cyclic Counter" ;
VAL_ 314 Info_VariL 0 "Profile Height Variance" 1 "Profile Height Variance" 2 "Profile Height Variance" 3 "Profile Height Variance" 4 "Profile Height Variance" 5 "Profile Height Variance" 6 "Profile Height Variance" 7 "Profile Height Variance" 8 "Profile Height Variance" 9 "Profile Height Variance" 10 "Profile Height Variance" 11 "Profile Height Variance" 12 "Profile Height Variance" 13 "Profile Height Variance" 14 "Profile Height Variance" 15 "Profile Height Variance" 16 "Profile Height Variance" 17 "Profile Height Variance" 18 "Profile Height Variance" 19 "Profile Height Variance" 20 "Profile Height Variance" 21 "Profile Height Variance" 22 "Profile Height Variance" 23 "Profile Height Variance" 24 "Profile Height Variance" 25 "Profile Height Variance" 26 "Profile Height Variance" 27 "Profile Height Variance" 28 "Profile Height Variance" 29 "Profile Height Variance" 30 "Profile Height Variance" 31 "Profile Height Variance" 32 "Profile Height Variance" 33 "Profile Height Variance" 34 "Profile Height Variance" 35 "Profile Height Variance" 36 "Profile Height Variance" 37 "Profile Height Variance" 38 "Profile Height Variance" 39 "Profile Height Variance" 40 "Profile Height Variance" 41 "Profile Height Variance" 42 "Profile Height Variance" 43 "Profile Height Variance" 44 "Profile Height Variance" 45 "Profile Height Variance" 46 "Profile Height Variance" 47 "Profile Height Variance" 48 "Profile Height Variance" 49 "Profile Height Variance" 50 "Profile Height Variance" 51 "Profile Height Variance" 52 "Profile Height Variance" 53 "Profile Height Variance" 54 "Profile Height Variance" 55 "Profile Height Variance" 56 "Profile Height Variance" 57 "Profile Height Variance" 58 "Profile Height Variance" 59 "Profile Height Variance" 60 "Profile Height Variance" 61 "Profile Height Variance" 62 "Profile Height Variance" 63 "Profile Height Variance" 64 "Profile Height Variance" 65 "Profile Height Variance" 66 "Profile Height Variance" 67 "Profile Height Variance" 68 "Profile Height Variance" 69 "Profile Height Variance" 70 "Profile Height Variance" 71 "Profile Height Variance" 72 "Profile Height Variance" 73 "Profile Height Variance" 74 "Profile Height Variance" 75 "Profile Height Variance" 76 "Profile Height Variance" 77 "Profile Height Variance" 78 "Profile Height Variance" 79 "Profile Height Variance" 80 "Profile Height Variance" 81 "Profile Height Variance" 82 "Profile Height Variance" 83 "Profile Height Variance" 84 "Profile Height Variance" 85 "Profile Height Variance" 86 "Profile Height Variance" 87 "Profile Height Variance" 88 "Profile Height Variance" 89 "Profile Height Variance" 90 "Profile Height Variance" 91 "Profile Height Variance" 92 "Profile Height Variance" 93 "Profile Height Variance" 94 "Profile Height Variance" 95 "Profile Height Variance" 96 "Profile Height Variance" 97 "Profile Height Variance" 98 "Profile Height Variance" 99 "Profile Height Variance" 100 "Profile Height Variance" 101 "Profile Height Variance" 102 "Profile Height Variance" 103 "Profile Height Variance" 104 "Profile Height Variance" 105 "Profile Height Variance" 106 "Profile Height Variance" 107 "Profile Height Variance" 108 "Profile Height Variance" 109 "Profile Height Variance" 110 "Profile Height Variance" 111 "Profile Height Variance" 112 "Profile Height Variance" 113 "Profile Height Variance" 114 "Profile Height Variance" 115 "Profile Height Variance" 116 "Profile Height Variance" 117 "Profile Height Variance" 118 "Profile Height Variance" 119 "Profile Height Variance" 120 "Profile Height Variance" 121 "Profile Height Variance" 122 "Profile Height Variance" 123 "Profile Height Variance" 124 "Profile Height Variance" 125 "Profile Height Variance" 126 "Profile Height Variance" 127 "Profile Height Variance" ;
VAL_ 314 Info_TypeR 0 "Ground" 1 "Bump" 2 "Hole" 3 "Reserved" ;
VAL_ 314 Info_CyclicCounterR 0 "Cyclic Counter" 1 "Cyclic Counter" 2 "Cyclic Counter" 3 "Cyclic Counter" ;
VAL_ 314 Info_VariR 0 "Profile Height Variance" 1 "Profile Height Variance" 2 "Profile Height Variance" 3 "Profile Height Variance" 4 "Profile Height Variance" 5 "Profile Height Variance" 6 "Profile Height Variance" 7 "Profile Height Variance" 8 "Profile Height Variance" 9 "Profile Height Variance" 10 "Profile Height Variance" 11 "Profile Height Variance" 12 "Profile Height Variance" 13 "Profile Height Variance" 14 "Profile Height Variance" 15 "Profile Height Variance" 16 "Profile Height Variance" 17 "Profile Height Variance" 18 "Profile Height Variance" 19 "Profile Height Variance" 20 "Profile Height Variance" 21 "Profile Height Variance" 22 "Profile Height Variance" 23 "Profile Height Variance" 24 "Profile Height Variance" 25 "Profile Height Variance" 26 "Profile Height Variance" 27 "Profile Height Variance" 28 "Profile Height Variance" 29 "Profile Height Variance" 30 "Profile Height Variance" 31 "Profile Height Variance" 32 "Profile Height Variance" 33 "Profile Height Variance" 34 "Profile Height Variance" 35 "Profile Height Variance" 36 "Profile Height Variance" 37 "Profile Height Variance" 38 "Profile Height Variance" 39 "Profile Height Variance" 40 "Profile Height Variance" 41 "Profile Height Variance" 42 "Profile Height Variance" 43 "Profile Height Variance" 44 "Profile Height Variance" 45 "Profile Height Variance" 46 "Profile Height Variance" 47 "Profile Height Variance" 48 "Profile Height Variance" 49 "Profile Height Variance" 50 "Profile Height Variance" 51 "Profile Height Variance" 52 "Profile Height Variance" 53 "Profile Height Variance" 54 "Profile Height Variance" 55 "Profile Height Variance" 56 "Profile Height Variance" 57 "Profile Height Variance" 58 "Profile Height Variance" 59 "Profile Height Variance" 60 "Profile Height Variance" 61 "Profile Height Variance" 62 "Profile Height Variance" 63 "Profile Height Variance" 64 "Profile Height Variance" 65 "Profile Height Variance" 66 "Profile Height Variance" 67 "Profile Height Variance" 68 "Profile Height Variance" 69 "Profile Height Variance" 70 "Profile Height Variance" 71 "Profile Height Variance" 72 "Profile Height Variance" 73 "Profile Height Variance" 74 "Profile Height Variance" 75 "Profile Height Variance" 76 "Profile Height Variance" 77 "Profile Height Variance" 78 "Profile Height Variance" 79 "Profile Height Variance" 80 "Profile Height Variance" 81 "Profile Height Variance" 82 "Profile Height Variance" 83 "Profile Height Variance" 84 "Profile Height Variance" 85 "Profile Height Variance" 86 "Profile Height Variance" 87 "Profile Height Variance" 88 "Profile Height Variance" 89 "Profile Height Variance" 90 "Profile Height Variance" 91 "Profile Height Variance" 92 "Profile Height Variance" 93 "Profile Height Variance" 94 "Profile Height Variance" 95 "Profile Height Variance" 96 "Profile Height Variance" 97 "Profile Height Variance" 98 "Profile Height Variance" 99 "Profile Height Variance" 100 "Profile Height Variance" 101 "Profile Height Variance" 102 "Profile Height Variance" 103 "Profile Height Variance" 104 "Profile Height Variance" 105 "Profile Height Variance" 106 "Profile Height Variance" 107 "Profile Height Variance" 108 "Profile Height Variance" 109 "Profile Height Variance" 110 "Profile Height Variance" 111 "Profile Height Variance" 112 "Profile Height Variance" 113 "Profile Height Variance" 114 "Profile Height Variance" 115 "Profile Height Variance" 116 "Profile Height Variance" 117 "Profile Height Variance" 118 "Profile Height Variance" 119 "Profile Height Variance" 120 "Profile Height Variance" 121 "Profile Height Variance" 122 "Profile Height Variance" 123 "Profile Height Variance" 124 "Profile Height Variance" 125 "Profile Height Variance" 126 "Profile Height Variance" 127 "Profile Height Variance" ;
VAL_ 314 Info_RdProfSts 0 "None Option (Default)" 1 "Normal" 2 "Not used" 3 "Error Indicator" ;
VAL_ 352 FCA_WrngSndSta 7 "Error Indicator" 6 "Reserved" 5 "Reserved" 4 "Reserved" 3 "Warning 3" 2 "Warning 2" 1 "Warning 1" 0 "No warning" ;
VAL_ 352 FCA_OnOffEquipSta 0 "Default" 1 "Off" 2 "Warning" 3 "Assist" 4 "Reserved" 5 "Reserved" 6 "Reserved" 7 "Invalid" ;
VAL_ 352 FCA_SysFlrSta 0 "Normal" 1 "Temp. Unavailable by Camera" 2 "Temp. Unavailable by Radar" 3 "Service Required" 4 "Temp. Unavailable by Camera (Camera only)" 5 "Reserved" 6 "Reserved" 7 "Reserved" ;
VAL_ 352 FCA_WrngLvlSta 0 "No warning" 1 "Warning level 1" 2 "Warning level 2" 3 "Warning level 3" ;
VAL_ 352 FCA_VehStpReq 0 "No request" 1 "Stop control is required" 2 "Reserved" 3 "Error Indicator" ;
VAL_ 352 FCA_StbltActvReq 0 "Release No alert" 1 "Pre-crash full retraction" 2 "Haptic warning" 3 "Reserved" 4 "Reserved" 5 "Reserved" 6 "Reserved" 7 "Reserved" ;
VAL_ 352 FCA_HydrlcBstAsstReq 0 "Standard threshold" 1 "Lowered threshold 1" 2 "Lowered threshold 2" 3 "Lowered threshold 3" ;
VAL_ 352 FCA_PrefillActvReq 0 "No pre-fill" 1 "Pre-fill act" 2 "Reserved" 3 "Error Indicator" ;
VAL_ 352 FCA_PartialActvReq 0 "No Partial act" 1 "Partail act " 2 "Reserved" 3 "Error Indicator" ;
VAL_ 352 FCA_FullActvReq 0 "No Full act" 1 "Full act" 2 "Reserved" 3 "Error Indicator" ;
VAL_ 352 FCA_SnstvtyModRetVal 0 "Default" 1 "Late" 2 "Normal" 3 "Early" 4 "Reserved" 5 "Reserved" 6 "Reserved" 7 "Invalid" ;
VAL_ 352 FCA_RelVel 511 "Signal Invalid" ;
VAL_ 352 FCA_Jnctn_OnOffEquipSta 0 "Default" 1 "Off" 2 "On" 3 "Invalid" ;
VAL_ 352 FCA_WrngTrgtDis 0 "No warning" 1 "FCA-Pedestrian" 2 "Reserved" 3 "FCA-Cyclist" 4 "Reserved" 5 "FCA-Car" 6 "Reserved" 7 "FCA-JC(L)" 8 "FCA-JC®" 9 "Reserved" 10 "Reserved" 11 "FCA-JT(L)" 12 "FCA-JT(R)" 13 "Reserved" 14 "Reserved" ;
VAL_ 362 RSPA_Sta 1 "Init" 2 "New Start" 3 "Ready OK" 4 "Assist Req" 5 "Assist OK" 6 "Assist Fail" 7 "Abort" 8 "Ready Fail" ;
VAL_ 373 ESC_VehAccelVal 2047 "Error" ;
VAL_ 373 ESC_AccelBasisVal 2047 "Error" ;
VAL_ 373 SCC_OptTyp 0 "SCC is not equipped" 1 "SCC is equipped" 2 "Not used" 3 "Error Indicator" ;
VAL_ 373 SCC_EnblReq 0 "SCC enabled" 1 "SCC disabled reversible" 2 "SCC disabled irreversible" 3 "SCC disabled irreversible due to communication error" ;
VAL_ 373 SCC_TqReq 0 "No request" 1 "Enable SCC torque request" 2 "Not used" 3 "Error Indicator" ;
VAL_ 373 SCC_ReqLimSta 0 "No request" 1 "Limited No Limitation" 2 "Acceleration Limited" 3 "Deceleration Limited" ;
VAL_ 373 ESC_StdStillVal 0 "No stand still detected" 1 "stand still detected" 2 "Not used" 3 "Error Indicator" ;
VAL_ 373 ESC_BrkLtReq 0 "No request" 1 "Activate brake lights" 2 "Not used" 3 "Error Indicator" ;
VAL_ 373 ESC_DclEnblReq 0 "Disable deceleration control" 1 "Enable deceleration control" 2 "Not used" 3 "Error Indicator" ;
VAL_ 373 ESC_DrvOvrdSta 0 "No override" 1 "Override by acceleration pedal" 2 "Override by deceleration" 3 "Error Indicator" ;
VAL_ 373 ESC_DrvBrkSta 0 "Driver is not braking / failure" 1 "Driver is braking" 2 "Not used" 3 "Error Indicator" ;
VAL_ 373 ESC_DrvBrkActvSta 0 "Brake pedal not pressed" 1 "Brake pedal pressed" 2 "Not used" 3 "Error Indicator" ;
VAL_ 373 ESC_PrkBrkActvSta 0 "Parking brake is not activated" 1 "Parking brake is activated" 2 "Not used" 3 "Error Indicator" ;
VAL_ 373 FCA_EquipSta 0 "FCA is not equipped" 1 "FCA is equipped" 2 "Not used" 3 "Error Indicator" ;
VAL_ 373 FCA_AvlblSta 0 "Available" 1 "Temporarily not available" 2 "Permanently not available" 3 "FCA Communication Error" ;
VAL_ 384 FR_CMR_Obj_MvngFlag01Sta 0 " Not Defined" 1 "  Standing (never moved back lights are on)" 2 "  Parked (never moved, back lights are off)" 3 "  Stopped (movable)" 4 "  Unknown (movable)" 5 "  Moving (movable)" 6 "  Stopped (Oncoming )" 7 "  Unknown (Oncoming )" 8 "  Moving (Oncoming )" 9 "  Crossing Bicycle" ;
VAL_ 384 FR_CMR_Obj_Clfct01Sta 0 " Unknown" 1 " Truck" 2 " Car" 3 " MotorBike" 4 " Bicycle" 5 " Pedestrians" 6 " Undecided" ;
VAL_ 384 FR_CMR_Obj_MvngFlag02Sta 0 " Not Defined" 1 "  Standing (never moved back lights are on)" 2 "  Parked (never moved, back lights are off)" 3 "  Stopped (movable)" 4 "  Unknown (movable)" 5 "  Moving (movable)" 6 "  Stopped (Oncoming )" 7 "  Unknown (Oncoming )" 8 "  Moving (Oncoming )" 9 "  Crossing Bicycle" ;
VAL_ 384 FR_CMR_Obj_Clfct02Sta 0 " Unknown" 1 " Truck" 2 " Car" 3 " MotorBike" 4 " Bicycle" 5 " Pedestrians" 6 " Undecided" ;
VAL_ 385 FR_CMR_Obj_MvngFlag03Sta 0 " Not Defined" 1 "  Standing (never moved back lights are on)" 2 "  Parked (never moved, back lights are off)" 3 "  Stopped (movable)" 4 "  Unknown (movable)" 5 "  Moving (movable)" 6 "  Stopped (Oncoming )" 7 "  Unknown (Oncoming )" 8 "  Moving (Oncoming )" 9 "  Crossing Bicycle" ;
VAL_ 385 FR_CMR_Obj_Clfct03Sta 0 " Unknown" 1 " Truck" 2 " Car" 3 " MotorBike" 4 " Bicycle" 5 " Pedestrians" 6 " Undecided" ;
VAL_ 385 FR_CMR_Obj_MvngFlag04Sta 0 " Not Defined" 1 "  Standing (never moved back lights are on)" 2 "  Parked (never moved, back lights are off)" 3 "  Stopped (movable)" 4 "  Unknown (movable)" 5 "  Moving (movable)" 6 "  Stopped (Oncoming )" 7 "  Unknown (Oncoming )" 8 "  Moving (Oncoming )" 9 "  Crossing Bicycle" ;
VAL_ 385 FR_CMR_Obj_Clfct04Sta 0 " Unknown" 1 " Truck" 2 " Car" 3 " MotorBike" 4 " Bicycle" 5 " Pedestrians" 6 " Undecided" ;
VAL_ 386 FR_CMR_Obj_MvngFlag05Sta 0 " Not Defined" 1 "  Standing (never moved back lights are on)" 2 "  Parked (never moved, back lights are off)" 3 "  Stopped (movable)" 4 "  Unknown (movable)" 5 "  Moving (movable)" 6 "  Stopped (Oncoming )" 7 "  Unknown (Oncoming )" 8 "  Moving (Oncoming )" 9 "  Crossing Bicycle" ;
VAL_ 386 FR_CMR_Obj_Clfct05Sta 0 " Unknown" 1 " Truck" 2 " Car" 3 " MotorBike" 4 " Bicycle" 5 " Pedestrians" 6 " Undecided" ;
VAL_ 386 FR_CMR_Obj_MvngFlag06Sta 0 " Not Defined" 1 "  Standing (never moved back lights are on)" 2 "  Parked (never moved, back lights are off)" 3 "  Stopped (movable)" 4 "  Unknown (movable)" 5 "  Moving (movable)" 6 "  Stopped (Oncoming )" 7 "  Unknown (Oncoming )" 8 "  Moving (Oncoming )" 9 "  Crossing Bicycle" ;
VAL_ 386 FR_CMR_Obj_Clfct06Sta 0 " Unknown" 1 " Truck" 2 " Car" 3 " MotorBike" 4 " Bicycle" 5 " Pedestrians" 6 " Undecided" ;
VAL_ 387 FR_CMR_Obj_MvngFlag07Sta 0 " Not Defined" 1 "  Standing (never moved back lights are on)" 2 "  Parked (never moved, back lights are off)" 3 "  Stopped (movable)" 4 "  Unknown (movable)" 5 "  Moving (movable)" 6 "  Stopped (Oncoming )" 7 "  Unknown (Oncoming )" 8 "  Moving (Oncoming )" 9 "  Crossing Bicycle" ;
VAL_ 387 FR_CMR_Obj_Clfct07Sta 0 " Unknown" 1 " Truck" 2 " Car" 3 " MotorBike" 4 " Bicycle" 5 " Pedestrians" 6 " Undecided" ;
VAL_ 387 FR_CMR_Obj_MvngFlag08Sta 0 " Not Defined" 1 "  Standing (never moved back lights are on)" 2 "  Parked (never moved, back lights are off)" 3 "  Stopped (movable)" 4 "  Unknown (movable)" 5 "  Moving (movable)" 6 "  Stopped (Oncoming )" 7 "  Unknown (Oncoming )" 8 "  Moving (Oncoming )" 9 "  Crossing Bicycle" ;
VAL_ 387 FR_CMR_Obj_Clfct08Sta 0 " Unknown" 1 " Truck" 2 " Car" 3 " MotorBike" 4 " Bicycle" 5 " Pedestrians" 6 " Undecided" ;
SIG_GROUP_ 453 EMS_11_10ms 1 : EMS_CyclicRedundancyCheck11Value EMS_AliveCounter11Value HEV_EngSpdErrSta;
SIG_GROUP_ 48 EMS_03_10ms 1 : CF_ECU_SSC_STAT EMS_SCCIsgEna DCT_CrctEngTqVal DCT_EngSpdErrSta DCT_EngSpdVal DCT_AccelPdlVal;
SIG_GROUP_ 64 TCU_01_10ms 1 : TCU_SmrtShftSta TCU_GearLmpBlnkngReq TCH_EngTrgtGearSta TCU_TrgtGearSta TCU_GearSlctDis TCU_AlvCnt1Val TCU_Crc1Val TCU_CurrGearSta;
SIG_GROUP_ 74 YRS_01_10ms 1 : YRS_LongAccelVal YRS_LatAccelVal YRS_YawRtVal YRS_LongAccelSigSta YRS_LatAccelSigSta YRS_YawSigSta YRS_AlvCnt1Val YRS_Crc1Val;
SIG_GROUP_ 80 L_ADAS_CMD_30_10ms 1 : Info_PedtrnDst_Copy_1 LKA_UsmMod_Copy_1 LKA_SysWrn_Copy_1 LKA_ToiFltSta_Copy_1 LKA_ActToiSta_Copy_1 LKA_StrTqReqVal_Copy_1 LKA_SysIndReq_Copy_1 LKA_StrSnd_Copy_1 LKA_HndsoffSnd_Copy_1 LKA_RHLnWrnSta_Copy_1 LKA_LHLnWrnSta_Copy_1 LKA_RcgSta_Copy_1 LKA_OptUsmSta_Copy_1 ADAS_CMD_30_AlvCnt01Val ADAS_CMD_30_Crc01Val;
SIG_GROUP_ 96 ESC_01_10ms 1 : AVH_Sta ESC_LongAccelOffstCalibPrmtr ESC_VsmActvSta ESC_CylPrsrFlagSta ESC_CylPrsrDiagSta ESC_CylPrsrSta ESC_CylPrsrVal MSR_FuncReq TCS_Req ESC_CtrlSta ESC_DfctvSta ESC_DisableSta TCS_CtrlSta TCS_DfctvSta TCS_DisableSta TCS_LmpSta EBD_DfctvSta ABS_DiagSta ABS_ActvSta ABS_DfctvSta;
SIG_GROUP_ 160 WHL_01_10ms 1 : WHL_DirRLVal WHL_DirFRVal WHL_DirFLVal WHL_PlsRRVal WHL_PlsFRVal WHL_PlsRLVal WHL_PlsFLVal WHL_SpdFLVal WHL_SpdFRVal WHL_SpdRLVal WHL_SpdRRVal WHL_DirRRVal;
SIG_GROUP_ 181 EMS_01_10ms 1 : ENG_VehSpdHiVal ENG_EngSpdVal ENG_EngSpdErrSta ENG_IsgSta ENG_IgnOnSta;
SIG_GROUP_ 229 ESC_02_10ms 1 : ESC_LatAccelVal ESC_YawRtVal ESC_LongAccelSigSta ESC_LatAccelSigSta ESC_LongAccelVal ESC_YawSigSta;
SIG_GROUP_ 234 MDPS_01_10ms 1 : MDPS_StrTqSnsrVal MDPS_OutTqVal MDPS_CurrModVal MDPS_FlxStrSta MDPS_LkaFailSta MDPS_LkaToiFltSta MDPS_LkaToiUnblSta MDPS_LkaToiActvSta MDPS_LkaPlgInSta MDPS_PaModeSta MDPS_Typ MDPS_AlvCnt1Val MDPS_Crc1Val;
SIG_GROUP_ 256 EMS_02_10ms 1 : ENG_CltchOpSta ENG_AccActSta ENG_BrkSwSta ENG_EngSta EMS_Crc2Val EMS_AlvCnt2Val ENG_AppAccelPdlSta ENG_AccelPdlVal;
SIG_GROUP_ 261 EMS_07_10ms 1 : HEV_EngSpdVal HEV_AccelPdlVal;
SIG_GROUP_ 282 FR_CMR_01_10ms 1 : DAW_SnstvtyModRetVal DAW_TimeRstReq DAW_WrnMsgSta DAW_SysSta DAW_OptUsmSta DAW_LVDA_OptUsmSta DAW_LVDA_PUDis FCAref_FusSta HBA_OptUsmSta FCA_Equip_MFC iHBAref_ILLAmbtSta iHBAref_VehRtSta iHBAref_VehCtrSta iHBAref_VehLftSta HBA_IndLmpReq HBA_SysSta HBA_SysOptSta FR_CMR_AlvCnt1Val FR_CMR_Crc1Val;
SIG_GROUP_ 293 SAS_01_10ms 1 : SAS_IntSta SAS_SpdVal SAS_AnglVal SAS_AlvCnt1Val SAS_Crc1Val;
SIG_GROUP_ 352 ADAS_CMD_10_20ms 1 : FCA_WrngSndSta FCA_Jnctn_OnOffEquipSta FCA_TimetoCllsn FCA_SnstvtyModRetVal FCA_RelVel FCA_FullActvReq FCA_PartialActvReq FCA_PrefillActvReq FCA_DclReqVal FCA_HydrlcBstAsstReq FCA_StbltActvReq FCA_WrngLvlSta FCA_VehStpReq FCA_SysFlrSta FCA_OnOffEquipSta ADAS_CMD_AlvCnt10Val ADAS_CMD_Crc10Val FCA_WrngTrgtDis;
SIG_GROUP_ 373 ESC_03_20ms 1 : FCA_AvlblSta FCA_EquipSta ESC_PrkBrkActvSta ESC_DrvBrkSta ESC_DrvOvrdSta ESC_DclEnblReq SCC_ReqLimSta ESC_BrkLtReq SCC_EnblReq SCC_TqReq SCC_OptTyp ESC_AccelBasisVal ESC_VehAccelVal ESC_AlvCnt3Val ESC_Crc3Val ESC_DrvBrkActvSta ESC_StdStillVal;
