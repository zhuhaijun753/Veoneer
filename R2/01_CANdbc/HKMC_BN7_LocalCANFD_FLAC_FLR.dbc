VERSION ""

NS_ :

BS_:

BU_: FR_CMR FR_RDR

BO_ 384 L_FR_RDR_ClusterTrack0_50ms: 64 FR_RDR
 SG_ FLR_CT0_CrcVal : 0|16@1+ (1,0) [0|65535] ""  FR_CMR
 SG_ FLR_CT0_AlvCntVal : 16|8@1+ (1,0) [0|255] ""  FR_CMR
 SG_ FLR_CT0_ListIndex : 24|4@1+ (1,0) [0|15] ""  FR_CMR
 SG_ FLR_CT0_SequenceCounter : 28|4@1+ (1,0) [0|15] ""  FR_CMR
 SG_ FLR_CT0_TimeStamp : 32|32@1+ (1,0) [0|4294967295] ""  FR_CMR
 SG_ FLR_CT0_Latency : 64|8@1+ (1,0) [0|255] "ms"  FR_CMR
 SG_ FLR_CT0_ClosestPointX : 72|12@1+ (0.05,-3) [-3|200] "m"  FR_CMR
 SG_ FLR_CT0_ClosestPointXStdDev : 84|7@1+ (0.05,0) [0|6] "m"  FR_CMR
 SG_ FLR_CT0_ClosestPointY : 91|10@1- (0.1,0) [-51|51] "m"  FR_CMR
 SG_ FLR_CT0_ClosestPointYStdDev : 101|6@1+ (0.1,0) [0|6] "m"  FR_CMR
 SG_ FLR_CT0_Confidence : 107|2@1+ (1,0) [0|3] ""  FR_CMR
 SG_ FLR_CT0_Elevation : 109|2@1+ (1,0) [0|3] ""  FR_CMR
 SG_ FLR_CT0_ElevationConfidence : 111|2@1+ (1,0) [0|3] ""  FR_CMR
 SG_ FLR_CT0_ExistanceProbability : 113|5@1+ (5,0) [0|100] "%"  FR_CMR
 SG_ FLR_CT0_Lifetime : 118|13@1+ (1,0) [0|8190] "Cycles"  FR_CMR
 SG_ FLR_CT0_ModelBoxHeading : 131|13@1- (0.001,0) [-3.15|3.15] "rad"  FR_CMR
 SG_ FLR_CT0_ModelBoxLength : 144|9@1+ (0.1,0) [0|50] "m"  FR_CMR
 SG_ FLR_CT0_ModelBoxWidth : 153|8@1+ (0.1,0) [0|25] "m"  FR_CMR
 SG_ FLR_CT0_ModelBoxX : 161|11@1+ (0.05,-25) [-25|75] "m"  FR_CMR
 SG_ FLR_CT0_ModelBoxY : 172|9@1- (0.1,0) [-25|25] "m"  FR_CMR
 SG_ FLR_CT0_MotionClass : 181|2@1+ (1,0) [0|3] ""  FR_CMR
 SG_ FLR_CT0_ObjectId : 183|16@1+ (1,0) [0|65535] ""  FR_CMR
 SG_ FLR_CT0_ObservationHistory : 199|16@1+ (1,0) [0|65535] ""  FR_CMR
 SG_ FLR_CT0_QualityBits : 215|18@1+ (1,0) [0|262143] ""  FR_CMR
 SG_ FLR_CT0_StationaryCounter : 233|16@1+ (1,0) [0|65535] ""  FR_CMR
 SG_ FLR_CT0_Type : 249|4@1+ (1,0) [0|8] ""  FR_CMR
 SG_ FLR_CT0_X_Acceleration : 253|9@1- (0.1,0) [-25|25] "m/s^2"  FR_CMR
 SG_ FLR_CT0_X_Velocity : 262|13@1- (0.05,0) [-120|120] "m/s"  FR_CMR
 SG_ FLR_CT0_X_VelocityStdDev : 275|7@1+ (0.05,0) [0|6] "m/s"  FR_CMR
 SG_ FLR_CT0_Y_Acceleration : 282|8@1- (0.25,0) [-25|25] "m/s^2"  FR_CMR
 SG_ FLR_CT0_Y_Velocity : 290|11@1- (0.1,0) [-100|100] "m/s"  FR_CMR
 SG_ FLR_CT0_Y_VelocityStdDev : 301|7@1+ (0.05,0) [0|6] "m/s"  FR_CMR

BO_ 385 L_FR_RDR_ClusterTrack1_50ms: 64 FR_RDR
 SG_ FLR_CT1_CrcVal : 0|16@1+ (1,0) [0|65535] ""  FR_CMR
 SG_ FLR_CT1_AlvCntVal : 16|8@1+ (1,0) [0|255] ""  FR_CMR
 SG_ FLR_CT1_ListIndex : 24|4@1+ (1,0) [0|15] ""  FR_CMR
 SG_ FLR_CT1_SequenceCounter : 28|4@1+ (1,0) [0|15] ""  FR_CMR
 SG_ FLR_CT1_TimeStamp : 32|32@1+ (1,0) [0|4294967295] ""  FR_CMR
 SG_ FLR_CT1_Latency : 64|8@1+ (1,0) [0|255] "ms"  FR_CMR
 SG_ FLR_CT1_ClosestPointX : 72|12@1+ (0.05,-3) [-3|200] "m"  FR_CMR
 SG_ FLR_CT1_ClosestPointXStdDev : 84|7@1+ (0.05,0) [0|6] "m"  FR_CMR
 SG_ FLR_CT1_ClosestPointY : 91|10@1- (0.1,0) [-51|51] "m"  FR_CMR
 SG_ FLR_CT1_ClosestPointYStdDev : 101|6@1+ (0.1,0) [0|6] "m"  FR_CMR
 SG_ FLR_CT1_Confidence : 107|2@1+ (1,0) [0|3] ""  FR_CMR
 SG_ FLR_CT1_Elevation : 109|2@1+ (1,0) [0|3] ""  FR_CMR
 SG_ FLR_CT1_ElevationConfidence : 111|2@1+ (1,0) [0|3] ""  FR_CMR
 SG_ FLR_CT1_ExistanceProbability : 113|5@1+ (5,0) [0|100] "%"  FR_CMR
 SG_ FLR_CT1_Lifetime : 118|13@1+ (1,0) [0|8190] "Cycles"  FR_CMR
 SG_ FLR_CT1_ModelBoxHeading : 131|13@1- (0.001,0) [-3.15|3.15] "rad"  FR_CMR
 SG_ FLR_CT1_ModelBoxLength : 144|9@1+ (0.1,0) [0|50] "m"  FR_CMR
 SG_ FLR_CT1_ModelBoxWidth : 153|8@1+ (0.1,0) [0|25] "m"  FR_CMR
 SG_ FLR_CT1_ModelBoxX : 161|11@1+ (0.05,-25) [-25|75] "m"  FR_CMR
 SG_ FLR_CT1_ModelBoxY : 172|9@1- (0.1,0) [-25|25] "m"  FR_CMR
 SG_ FLR_CT1_MotionClass : 181|2@1+ (1,0) [0|3] ""  FR_CMR
 SG_ FLR_CT1_ObjectId : 183|16@1+ (1,0) [0|65535] ""  FR_CMR
 SG_ FLR_CT1_ObservationHistory : 199|16@1+ (1,0) [0|65535] ""  FR_CMR
 SG_ FLR_CT1_QualityBits : 215|18@1+ (1,0) [0|262143] ""  FR_CMR
 SG_ FLR_CT1_StationaryCounter : 233|16@1+ (1,0) [0|65535] ""  FR_CMR
 SG_ FLR_CT1_Type : 249|4@1+ (1,0) [0|8] ""  FR_CMR
 SG_ FLR_CT1_X_Acceleration : 253|9@1- (0.1,0) [-25|25] "m/s^2"  FR_CMR
 SG_ FLR_CT1_X_Velocity : 262|13@1- (0.05,0) [-120|120] "m/s"  FR_CMR
 SG_ FLR_CT1_X_VelocityStdDev : 275|7@1+ (0.05,0) [0|6] "m/s"  FR_CMR
 SG_ FLR_CT1_Y_Acceleration : 282|8@1- (0.25,0) [-25|25] "m/s^2"  FR_CMR
 SG_ FLR_CT1_Y_Velocity : 290|11@1- (0.1,0) [-100|100] "m/s"  FR_CMR
 SG_ FLR_CT1_Y_VelocityStdDev : 301|7@1+ (0.05,0) [0|6] "m/s"  FR_CMR

BO_ 386 L_FR_RDR_ClusterTrack2_50ms: 64 FR_RDR
 SG_ FLR_CT2_CrcVal : 0|16@1+ (1,0) [0|65535] ""  FR_CMR
 SG_ FLR_CT2_AlvCntVal : 16|8@1+ (1,0) [0|255] ""  FR_CMR
 SG_ FLR_CT2_ListIndex : 24|4@1+ (1,0) [0|15] ""  FR_CMR
 SG_ FLR_CT2_SequenceCounter : 28|4@1+ (1,0) [0|15] ""  FR_CMR
 SG_ FLR_CT2_TimeStamp : 32|32@1+ (1,0) [0|4294967295] ""  FR_CMR
 SG_ FLR_CT2_Latency : 64|8@1+ (1,0) [0|255] "ms"  FR_CMR
 SG_ FLR_CT2_ClosestPointX : 72|12@1+ (0.05,-3) [-3|200] "m"  FR_CMR
 SG_ FLR_CT2_ClosestPointXStdDev : 84|7@1+ (0.05,0) [0|6] "m"  FR_CMR
 SG_ FLR_CT2_ClosestPointY : 91|10@1- (0.1,0) [-51|51] "m"  FR_CMR
 SG_ FLR_CT2_ClosestPointYStdDev : 101|6@1+ (0.1,0) [0|6] "m"  FR_CMR
 SG_ FLR_CT2_Confidence : 107|2@1+ (1,0) [0|3] ""  FR_CMR
 SG_ FLR_CT2_Elevation : 109|2@1+ (1,0) [0|3] ""  FR_CMR
 SG_ FLR_CT2_ElevationConfidence : 111|2@1+ (1,0) [0|3] ""  FR_CMR
 SG_ FLR_CT2_ExistanceProbability : 113|5@1+ (5,0) [0|100] "%"  FR_CMR
 SG_ FLR_CT2_Lifetime : 118|13@1+ (1,0) [0|8190] "Cycles"  FR_CMR
 SG_ FLR_CT2_ModelBoxHeading : 131|13@1- (0.001,0) [-3.15|3.15] "rad"  FR_CMR
 SG_ FLR_CT2_ModelBoxLength : 144|9@1+ (0.1,0) [0|50] "m"  FR_CMR
 SG_ FLR_CT2_ModelBoxWidth : 153|8@1+ (0.1,0) [0|25] "m"  FR_CMR
 SG_ FLR_CT2_ModelBoxX : 161|11@1+ (0.05,-25) [-25|75] "m"  FR_CMR
 SG_ FLR_CT2_ModelBoxY : 172|9@1- (0.1,0) [-25|25] "m"  FR_CMR
 SG_ FLR_CT2_MotionClass : 181|2@1+ (1,0) [0|3] ""  FR_CMR
 SG_ FLR_CT2_ObjectId : 183|16@1+ (1,0) [0|65535] ""  FR_CMR
 SG_ FLR_CT2_ObservationHistory : 199|16@1+ (1,0) [0|65535] ""  FR_CMR
 SG_ FLR_CT2_QualityBits : 215|18@1+ (1,0) [0|262143] ""  FR_CMR
 SG_ FLR_CT2_StationaryCounter : 233|16@1+ (1,0) [0|65535] ""  FR_CMR
 SG_ FLR_CT2_Type : 249|4@1+ (1,0) [0|8] ""  FR_CMR
 SG_ FLR_CT2_X_Acceleration : 253|9@1- (0.1,0) [-25|25] "m/s^2"  FR_CMR
 SG_ FLR_CT2_X_Velocity : 262|13@1- (0.05,0) [-120|120] "m/s"  FR_CMR
 SG_ FLR_CT2_X_VelocityStdDev : 275|7@1+ (0.05,0) [0|6] "m/s"  FR_CMR
 SG_ FLR_CT2_Y_Acceleration : 282|8@1- (0.25,0) [-25|25] "m/s^2"  FR_CMR
 SG_ FLR_CT2_Y_Velocity : 290|11@1- (0.1,0) [-100|100] "m/s"  FR_CMR
 SG_ FLR_CT2_Y_VelocityStdDev : 301|7@1+ (0.05,0) [0|6] "m/s"  FR_CMR

BO_ 387 L_FR_RDR_ClusterTrack3_50ms: 64 FR_RDR
 SG_ FLR_CT3_CrcVal : 0|16@1+ (1,0) [0|65535] ""  FR_CMR
 SG_ FLR_CT3_AlvCntVal : 16|8@1+ (1,0) [0|255] ""  FR_CMR
 SG_ FLR_CT3_ListIndex : 24|4@1+ (1,0) [0|15] ""  FR_CMR
 SG_ FLR_CT3_SequenceCounter : 28|4@1+ (1,0) [0|15] ""  FR_CMR
 SG_ FLR_CT3_TimeStamp : 32|32@1+ (1,0) [0|4294967295] ""  FR_CMR
 SG_ FLR_CT3_Latency : 64|8@1+ (1,0) [0|255] "ms"  FR_CMR
 SG_ FLR_CT3_ClosestPointX : 72|12@1+ (0.05,-3) [-3|200] "m"  FR_CMR
 SG_ FLR_CT3_ClosestPointXStdDev : 84|7@1+ (0.05,0) [0|6] "m"  FR_CMR
 SG_ FLR_CT3_ClosestPointY : 91|10@1- (0.1,0) [-51|51] "m"  FR_CMR
 SG_ FLR_CT3_ClosestPointYStdDev : 101|6@1+ (0.1,0) [0|6] "m"  FR_CMR
 SG_ FLR_CT3_Confidence : 107|2@1+ (1,0) [0|3] ""  FR_CMR
 SG_ FLR_CT3_Elevation : 109|2@1+ (1,0) [0|3] ""  FR_CMR
 SG_ FLR_CT3_ElevationConfidence : 111|2@1+ (1,0) [0|3] ""  FR_CMR
 SG_ FLR_CT3_ExistanceProbability : 113|5@1+ (5,0) [0|100] "%"  FR_CMR
 SG_ FLR_CT3_Lifetime : 118|13@1+ (1,0) [0|8190] "Cycles"  FR_CMR
 SG_ FLR_CT3_ModelBoxHeading : 131|13@1- (0.001,0) [-3.15|3.15] "rad"  FR_CMR
 SG_ FLR_CT3_ModelBoxLength : 144|9@1+ (0.1,0) [0|50] "m"  FR_CMR
 SG_ FLR_CT3_ModelBoxWidth : 153|8@1+ (0.1,0) [0|25] "m"  FR_CMR
 SG_ FLR_CT3_ModelBoxX : 161|11@1+ (0.05,-25) [-25|75] "m"  FR_CMR
 SG_ FLR_CT3_ModelBoxY : 172|9@1- (0.1,0) [-25|25] "m"  FR_CMR
 SG_ FLR_CT3_MotionClass : 181|2@1+ (1,0) [0|3] ""  FR_CMR
 SG_ FLR_CT3_ObjectId : 183|16@1+ (1,0) [0|65535] ""  FR_CMR
 SG_ FLR_CT3_ObservationHistory : 199|16@1+ (1,0) [0|65535] ""  FR_CMR
 SG_ FLR_CT3_QualityBits : 215|18@1+ (1,0) [0|262143] ""  FR_CMR
 SG_ FLR_CT3_StationaryCounter : 233|16@1+ (1,0) [0|65535] ""  FR_CMR
 SG_ FLR_CT3_Type : 249|4@1+ (1,0) [0|8] ""  FR_CMR
 SG_ FLR_CT3_X_Acceleration : 253|9@1- (0.1,0) [-25|25] "m/s^2"  FR_CMR
 SG_ FLR_CT3_X_Velocity : 262|13@1- (0.05,0) [-120|120] "m/s"  FR_CMR
 SG_ FLR_CT3_X_VelocityStdDev : 275|7@1+ (0.05,0) [0|6] "m/s"  FR_CMR
 SG_ FLR_CT3_Y_Acceleration : 282|8@1- (0.25,0) [-25|25] "m/s^2"  FR_CMR
 SG_ FLR_CT3_Y_Velocity : 290|11@1- (0.1,0) [-100|100] "m/s"  FR_CMR
 SG_ FLR_CT3_Y_VelocityStdDev : 301|7@1+ (0.05,0) [0|6] "m/s"  FR_CMR

BO_ 388 L_FR_RDR_ClusterTrack4_50ms: 64 FR_RDR
 SG_ FLR_CT4_CrcVal : 0|16@1+ (1,0) [0|65535] ""  FR_CMR
 SG_ FLR_CT4_AlvCntVal : 16|8@1+ (1,0) [0|255] ""  FR_CMR
 SG_ FLR_CT4_ListIndex : 24|4@1+ (1,0) [0|15] ""  FR_CMR
 SG_ FLR_CT4_SequenceCounter : 28|4@1+ (1,0) [0|15] ""  FR_CMR
 SG_ FLR_CT4_TimeStamp : 32|32@1+ (1,0) [0|4294967295] ""  FR_CMR
 SG_ FLR_CT4_Latency : 64|8@1+ (1,0) [0|255] "ms"  FR_CMR
 SG_ FLR_CT4_ClosestPointX : 72|12@1+ (0.05,-3) [-3|200] "m"  FR_CMR
 SG_ FLR_CT4_ClosestPointXStdDev : 84|7@1+ (0.05,0) [0|6] "m"  FR_CMR
 SG_ FLR_CT4_ClosestPointY : 91|10@1- (0.1,0) [-51|51] "m"  FR_CMR
 SG_ FLR_CT4_ClosestPointYStdDev : 101|6@1+ (0.1,0) [0|6] "m"  FR_CMR
 SG_ FLR_CT4_Confidence : 107|2@1+ (1,0) [0|3] ""  FR_CMR
 SG_ FLR_CT4_Elevation : 109|2@1+ (1,0) [0|3] ""  FR_CMR
 SG_ FLR_CT4_ElevationConfidence : 111|2@1+ (1,0) [0|3] ""  FR_CMR
 SG_ FLR_CT4_ExistanceProbability : 113|5@1+ (5,0) [0|100] "%"  FR_CMR
 SG_ FLR_CT4_Lifetime : 118|13@1+ (1,0) [0|8190] "Cycles"  FR_CMR
 SG_ FLR_CT4_ModelBoxHeading : 131|13@1- (0.001,0) [-3.15|3.15] "rad"  FR_CMR
 SG_ FLR_CT4_ModelBoxLength : 144|9@1+ (0.1,0) [0|50] "m"  FR_CMR
 SG_ FLR_CT4_ModelBoxWidth : 153|8@1+ (0.1,0) [0|25] "m"  FR_CMR
 SG_ FLR_CT4_ModelBoxX : 161|11@1+ (0.05,-25) [-25|75] "m"  FR_CMR
 SG_ FLR_CT4_ModelBoxY : 172|9@1- (0.1,0) [-25|25] "m"  FR_CMR
 SG_ FLR_CT4_MotionClass : 181|2@1+ (1,0) [0|3] ""  FR_CMR
 SG_ FLR_CT4_ObjectId : 183|16@1+ (1,0) [0|65535] ""  FR_CMR
 SG_ FLR_CT4_ObservationHistory : 199|16@1+ (1,0) [0|65535] ""  FR_CMR
 SG_ FLR_CT4_QualityBits : 215|18@1+ (1,0) [0|262143] ""  FR_CMR
 SG_ FLR_CT4_StationaryCounter : 233|16@1+ (1,0) [0|65535] ""  FR_CMR
 SG_ FLR_CT4_Type : 249|4@1+ (1,0) [0|8] ""  FR_CMR
 SG_ FLR_CT4_X_Acceleration : 253|9@1- (0.1,0) [-25|25] "m/s^2"  FR_CMR
 SG_ FLR_CT4_X_Velocity : 262|13@1- (0.05,0) [-120|120] "m/s"  FR_CMR
 SG_ FLR_CT4_X_VelocityStdDev : 275|7@1+ (0.05,0) [0|6] "m/s"  FR_CMR
 SG_ FLR_CT4_Y_Acceleration : 282|8@1- (0.25,0) [-25|25] "m/s^2"  FR_CMR
 SG_ FLR_CT4_Y_Velocity : 290|11@1- (0.1,0) [-100|100] "m/s"  FR_CMR
 SG_ FLR_CT4_Y_VelocityStdDev : 301|7@1+ (0.05,0) [0|6] "m/s"  FR_CMR

BO_ 389 L_FR_RDR_ClusterTrack5_50ms: 64 FR_RDR
 SG_ FLR_CT5_CrcVal : 0|16@1+ (1,0) [0|65535] ""  FR_CMR
 SG_ FLR_CT5_AlvCntVal : 16|8@1+ (1,0) [0|255] ""  FR_CMR
 SG_ FLR_CT5_ListIndex : 24|4@1+ (1,0) [0|15] ""  FR_CMR
 SG_ FLR_CT5_SequenceCounter : 28|4@1+ (1,0) [0|15] ""  FR_CMR
 SG_ FLR_CT5_TimeStamp : 32|32@1+ (1,0) [0|4294967295] ""  FR_CMR
 SG_ FLR_CT5_Latency : 64|8@1+ (1,0) [0|255] "ms"  FR_CMR
 SG_ FLR_CT5_ClosestPointX : 72|12@1+ (0.05,-3) [-3|200] "m"  FR_CMR
 SG_ FLR_CT5_ClosestPointXStdDev : 84|7@1+ (0.05,0) [0|6] "m"  FR_CMR
 SG_ FLR_CT5_ClosestPointY : 91|10@1- (0.1,0) [-51|51] "m"  FR_CMR
 SG_ FLR_CT5_ClosestPointYStdDev : 101|6@1+ (0.1,0) [0|6] "m"  FR_CMR
 SG_ FLR_CT5_Confidence : 107|2@1+ (1,0) [0|3] ""  FR_CMR
 SG_ FLR_CT5_Elevation : 109|2@1+ (1,0) [0|3] ""  FR_CMR
 SG_ FLR_CT5_ElevationConfidence : 111|2@1+ (1,0) [0|3] ""  FR_CMR
 SG_ FLR_CT5_ExistanceProbability : 113|5@1+ (5,0) [0|100] "%"  FR_CMR
 SG_ FLR_CT5_Lifetime : 118|13@1+ (1,0) [0|8190] "Cycles"  FR_CMR
 SG_ FLR_CT5_ModelBoxHeading : 131|13@1- (0.001,0) [-3.15|3.15] "rad"  FR_CMR
 SG_ FLR_CT5_ModelBoxLength : 144|9@1+ (0.1,0) [0|50] "m"  FR_CMR
 SG_ FLR_CT5_ModelBoxWidth : 153|8@1+ (0.1,0) [0|25] "m"  FR_CMR
 SG_ FLR_CT5_ModelBoxX : 161|11@1+ (0.05,-25) [-25|75] "m"  FR_CMR
 SG_ FLR_CT5_ModelBoxY : 172|9@1- (0.1,0) [-25|25] "m"  FR_CMR
 SG_ FLR_CT5_MotionClass : 181|2@1+ (1,0) [0|3] ""  FR_CMR
 SG_ FLR_CT5_ObjectId : 183|16@1+ (1,0) [0|65535] ""  FR_CMR
 SG_ FLR_CT5_ObservationHistory : 199|16@1+ (1,0) [0|65535] ""  FR_CMR
 SG_ FLR_CT5_QualityBits : 215|18@1+ (1,0) [0|262143] ""  FR_CMR
 SG_ FLR_CT5_StationaryCounter : 233|16@1+ (1,0) [0|65535] ""  FR_CMR
 SG_ FLR_CT5_Type : 249|4@1+ (1,0) [0|8] ""  FR_CMR
 SG_ FLR_CT5_X_Acceleration : 253|9@1- (0.1,0) [-25|25] "m/s^2"  FR_CMR
 SG_ FLR_CT5_X_Velocity : 262|13@1- (0.05,0) [-120|120] "m/s"  FR_CMR
 SG_ FLR_CT5_X_VelocityStdDev : 275|7@1+ (0.05,0) [0|6] "m/s"  FR_CMR
 SG_ FLR_CT5_Y_Acceleration : 282|8@1- (0.25,0) [-25|25] "m/s^2"  FR_CMR
 SG_ FLR_CT5_Y_Velocity : 290|11@1- (0.1,0) [-100|100] "m/s"  FR_CMR
 SG_ FLR_CT5_Y_VelocityStdDev : 301|7@1+ (0.05,0) [0|6] "m/s"  FR_CMR

BO_ 390 L_FR_RDR_ClusterTrack6_50ms: 64 FR_RDR
 SG_ FLR_CT6_CrcVal : 0|16@1+ (1,0) [0|65535] ""  FR_CMR
 SG_ FLR_CT6_AlvCntVal : 16|8@1+ (1,0) [0|255] ""  FR_CMR
 SG_ FLR_CT6_ListIndex : 24|4@1+ (1,0) [0|15] ""  FR_CMR
 SG_ FLR_CT6_SequenceCounter : 28|4@1+ (1,0) [0|15] ""  FR_CMR
 SG_ FLR_CT6_TimeStamp : 32|32@1+ (1,0) [0|4294967295] ""  FR_CMR
 SG_ FLR_CT6_Latency : 64|8@1+ (1,0) [0|255] "ms"  FR_CMR
 SG_ FLR_CT6_ClosestPointX : 72|12@1+ (0.05,-3) [-3|200] "m"  FR_CMR
 SG_ FLR_CT6_ClosestPointXStdDev : 84|7@1+ (0.05,0) [0|6] "m"  FR_CMR
 SG_ FLR_CT6_ClosestPointY : 91|10@1- (0.1,0) [-51|51] "m"  FR_CMR
 SG_ FLR_CT6_ClosestPointYStdDev : 101|6@1+ (0.1,0) [0|6] "m"  FR_CMR
 SG_ FLR_CT6_Confidence : 107|2@1+ (1,0) [0|3] ""  FR_CMR
 SG_ FLR_CT6_Elevation : 109|2@1+ (1,0) [0|3] ""  FR_CMR
 SG_ FLR_CT6_ElevationConfidence : 111|2@1+ (1,0) [0|3] ""  FR_CMR
 SG_ FLR_CT6_ExistanceProbability : 113|5@1+ (5,0) [0|100] "%"  FR_CMR
 SG_ FLR_CT6_Lifetime : 118|13@1+ (1,0) [0|8190] "Cycles"  FR_CMR
 SG_ FLR_CT6_ModelBoxHeading : 131|13@1- (0.001,0) [-3.15|3.15] "rad"  FR_CMR
 SG_ FLR_CT6_ModelBoxLength : 144|9@1+ (0.1,0) [0|50] "m"  FR_CMR
 SG_ FLR_CT6_ModelBoxWidth : 153|8@1+ (0.1,0) [0|25] "m"  FR_CMR
 SG_ FLR_CT6_ModelBoxX : 161|11@1+ (0.05,-25) [-25|75] "m"  FR_CMR
 SG_ FLR_CT6_ModelBoxY : 172|9@1- (0.1,0) [-25|25] "m"  FR_CMR
 SG_ FLR_CT6_MotionClass : 181|2@1+ (1,0) [0|3] ""  FR_CMR
 SG_ FLR_CT6_ObjectId : 183|16@1+ (1,0) [0|65535] ""  FR_CMR
 SG_ FLR_CT6_ObservationHistory : 199|16@1+ (1,0) [0|65535] ""  FR_CMR
 SG_ FLR_CT6_QualityBits : 215|18@1+ (1,0) [0|262143] ""  FR_CMR
 SG_ FLR_CT6_StationaryCounter : 233|16@1+ (1,0) [0|65535] ""  FR_CMR
 SG_ FLR_CT6_Type : 249|4@1+ (1,0) [0|8] ""  FR_CMR
 SG_ FLR_CT6_X_Acceleration : 253|9@1- (0.1,0) [-25|25] "m/s^2"  FR_CMR
 SG_ FLR_CT6_X_Velocity : 262|13@1- (0.05,0) [-120|120] "m/s"  FR_CMR
 SG_ FLR_CT6_X_VelocityStdDev : 275|7@1+ (0.05,0) [0|6] "m/s"  FR_CMR
 SG_ FLR_CT6_Y_Acceleration : 282|8@1- (0.25,0) [-25|25] "m/s^2"  FR_CMR
 SG_ FLR_CT6_Y_Velocity : 290|11@1- (0.1,0) [-100|100] "m/s"  FR_CMR
 SG_ FLR_CT6_Y_VelocityStdDev : 301|7@1+ (0.05,0) [0|6] "m/s"  FR_CMR

BO_ 391 L_FR_RDR_ClusterTrack7_50ms: 64 FR_RDR
 SG_ FLR_CT7_CrcVal : 0|16@1+ (1,0) [0|65535] ""  FR_CMR
 SG_ FLR_CT7_AlvCntVal : 16|8@1+ (1,0) [0|255] ""  FR_CMR
 SG_ FLR_CT7_ListIndex : 24|4@1+ (1,0) [0|15] ""  FR_CMR
 SG_ FLR_CT7_SequenceCounter : 28|4@1+ (1,0) [0|15] ""  FR_CMR
 SG_ FLR_CT7_TimeStamp : 32|32@1+ (1,0) [0|4294967295] ""  FR_CMR
 SG_ FLR_CT7_Latency : 64|8@1+ (1,0) [0|255] "ms"  FR_CMR
 SG_ FLR_CT7_ClosestPointX : 72|12@1+ (0.05,-3) [-3|200] "m"  FR_CMR
 SG_ FLR_CT7_ClosestPointXStdDev : 84|7@1+ (0.05,0) [0|6] "m"  FR_CMR
 SG_ FLR_CT7_ClosestPointY : 91|10@1- (0.1,0) [-51|51] "m"  FR_CMR
 SG_ FLR_CT7_ClosestPointYStdDev : 101|6@1+ (0.1,0) [0|6] "m"  FR_CMR
 SG_ FLR_CT7_Confidence : 107|2@1+ (1,0) [0|3] ""  FR_CMR
 SG_ FLR_CT7_Elevation : 109|2@1+ (1,0) [0|3] ""  FR_CMR
 SG_ FLR_CT7_ElevationConfidence : 111|2@1+ (1,0) [0|3] ""  FR_CMR
 SG_ FLR_CT7_ExistanceProbability : 113|5@1+ (5,0) [0|100] "%"  FR_CMR
 SG_ FLR_CT7_Lifetime : 118|13@1+ (1,0) [0|8190] "Cycles"  FR_CMR
 SG_ FLR_CT7_ModelBoxHeading : 131|13@1- (0.001,0) [-3.15|3.15] "rad"  FR_CMR
 SG_ FLR_CT7_ModelBoxLength : 144|9@1+ (0.1,0) [0|50] "m"  FR_CMR
 SG_ FLR_CT7_ModelBoxWidth : 153|8@1+ (0.1,0) [0|25] "m"  FR_CMR
 SG_ FLR_CT7_ModelBoxX : 161|11@1+ (0.05,-25) [-25|75] "m"  FR_CMR
 SG_ FLR_CT7_ModelBoxY : 172|9@1- (0.1,0) [-25|25] "m"  FR_CMR
 SG_ FLR_CT7_MotionClass : 181|2@1+ (1,0) [0|3] ""  FR_CMR
 SG_ FLR_CT7_ObjectId : 183|16@1+ (1,0) [0|65535] ""  FR_CMR
 SG_ FLR_CT7_ObservationHistory : 199|16@1+ (1,0) [0|65535] ""  FR_CMR
 SG_ FLR_CT7_QualityBits : 215|18@1+ (1,0) [0|262143] ""  FR_CMR
 SG_ FLR_CT7_StationaryCounter : 233|16@1+ (1,0) [0|65535] ""  FR_CMR
 SG_ FLR_CT7_Type : 249|4@1+ (1,0) [0|8] ""  FR_CMR
 SG_ FLR_CT7_X_Acceleration : 253|9@1- (0.1,0) [-25|25] "m/s^2"  FR_CMR
 SG_ FLR_CT7_X_Velocity : 262|13@1- (0.05,0) [-120|120] "m/s"  FR_CMR
 SG_ FLR_CT7_X_VelocityStdDev : 275|7@1+ (0.05,0) [0|6] "m/s"  FR_CMR
 SG_ FLR_CT7_Y_Acceleration : 282|8@1- (0.25,0) [-25|25] "m/s^2"  FR_CMR
 SG_ FLR_CT7_Y_Velocity : 290|11@1- (0.1,0) [-100|100] "m/s"  FR_CMR
 SG_ FLR_CT7_Y_VelocityStdDev : 301|7@1+ (0.05,0) [0|6] "m/s"  FR_CMR

BO_ 392 L_FR_RDR_ClusterTrack8_50ms: 64 FR_RDR
 SG_ FLR_CT8_CrcVal : 0|16@1+ (1,0) [0|65535] ""  FR_CMR
 SG_ FLR_CT8_AlvCntVal : 16|8@1+ (1,0) [0|255] ""  FR_CMR
 SG_ FLR_CT8_ListIndex : 24|4@1+ (1,0) [0|15] ""  FR_CMR
 SG_ FLR_CT8_SequenceCounter : 28|4@1+ (1,0) [0|15] ""  FR_CMR
 SG_ FLR_CT8_TimeStamp : 32|32@1+ (1,0) [0|4294967295] ""  FR_CMR
 SG_ FLR_CT8_Latency : 64|8@1+ (1,0) [0|255] "ms"  FR_CMR
 SG_ FLR_CT8_ClosestPointX : 72|12@1+ (0.05,-3) [-3|200] "m"  FR_CMR
 SG_ FLR_CT8_ClosestPointXStdDev : 84|7@1+ (0.05,0) [0|6] "m"  FR_CMR
 SG_ FLR_CT8_ClosestPointY : 91|10@1- (0.1,0) [-51|51] "m"  FR_CMR
 SG_ FLR_CT8_ClosestPointYStdDev : 101|6@1+ (0.1,0) [0|6] "m"  FR_CMR
 SG_ FLR_CT8_Confidence : 107|2@1+ (1,0) [0|3] ""  FR_CMR
 SG_ FLR_CT8_Elevation : 109|2@1+ (1,0) [0|3] ""  FR_CMR
 SG_ FLR_CT8_ElevationConfidence : 111|2@1+ (1,0) [0|3] ""  FR_CMR
 SG_ FLR_CT8_ExistanceProbability : 113|5@1+ (5,0) [0|100] "%"  FR_CMR
 SG_ FLR_CT8_Lifetime : 118|13@1+ (1,0) [0|8190] "Cycles"  FR_CMR
 SG_ FLR_CT8_ModelBoxHeading : 131|13@1- (0.001,0) [-3.15|3.15] "rad"  FR_CMR
 SG_ FLR_CT8_ModelBoxLength : 144|9@1+ (0.1,0) [0|50] "m"  FR_CMR
 SG_ FLR_CT8_ModelBoxWidth : 153|8@1+ (0.1,0) [0|25] "m"  FR_CMR
 SG_ FLR_CT8_ModelBoxX : 161|11@1+ (0.05,-25) [-25|75] "m"  FR_CMR
 SG_ FLR_CT8_ModelBoxY : 172|9@1- (0.1,0) [-25|25] "m"  FR_CMR
 SG_ FLR_CT8_MotionClass : 181|2@1+ (1,0) [0|3] ""  FR_CMR
 SG_ FLR_CT8_ObjectId : 183|16@1+ (1,0) [0|65535] ""  FR_CMR
 SG_ FLR_CT8_ObservationHistory : 199|16@1+ (1,0) [0|65535] ""  FR_CMR
 SG_ FLR_CT8_QualityBits : 215|18@1+ (1,0) [0|262143] ""  FR_CMR
 SG_ FLR_CT8_StationaryCounter : 233|16@1+ (1,0) [0|65535] ""  FR_CMR
 SG_ FLR_CT8_Type : 249|4@1+ (1,0) [0|8] ""  FR_CMR
 SG_ FLR_CT8_X_Acceleration : 253|9@1- (0.1,0) [-25|25] "m/s^2"  FR_CMR
 SG_ FLR_CT8_X_Velocity : 262|13@1- (0.05,0) [-120|120] "m/s"  FR_CMR
 SG_ FLR_CT8_X_VelocityStdDev : 275|7@1+ (0.05,0) [0|6] "m/s"  FR_CMR
 SG_ FLR_CT8_Y_Acceleration : 282|8@1- (0.25,0) [-25|25] "m/s^2"  FR_CMR
 SG_ FLR_CT8_Y_Velocity : 290|11@1- (0.1,0) [-100|100] "m/s"  FR_CMR
 SG_ FLR_CT8_Y_VelocityStdDev : 301|7@1+ (0.05,0) [0|6] "m/s"  FR_CMR

BO_ 393 L_FR_RDR_ClusterTrack9_50ms: 64 FR_RDR
 SG_ FLR_CT9_CrcVal : 0|16@1+ (1,0) [0|65535] ""  FR_CMR
 SG_ FLR_CT9_AlvCntVal : 16|8@1+ (1,0) [0|255] ""  FR_CMR
 SG_ FLR_CT9_ListIndex : 24|4@1+ (1,0) [0|15] ""  FR_CMR
 SG_ FLR_CT9_SequenceCounter : 28|4@1+ (1,0) [0|15] ""  FR_CMR
 SG_ FLR_CT9_TimeStamp : 32|32@1+ (1,0) [0|4294967295] ""  FR_CMR
 SG_ FLR_CT9_Latency : 64|8@1+ (1,0) [0|255] "ms"  FR_CMR
 SG_ FLR_CT9_ClosestPointX : 72|12@1+ (0.05,-3) [-3|200] "m"  FR_CMR
 SG_ FLR_CT9_ClosestPointXStdDev : 84|7@1+ (0.05,0) [0|6] "m"  FR_CMR
 SG_ FLR_CT9_ClosestPointY : 91|10@1- (0.1,0) [-51|51] "m"  FR_CMR
 SG_ FLR_CT9_ClosestPointYStdDev : 101|6@1+ (0.1,0) [0|6] "m"  FR_CMR
 SG_ FLR_CT9_Confidence : 107|2@1+ (1,0) [0|3] ""  FR_CMR
 SG_ FLR_CT9_Elevation : 109|2@1+ (1,0) [0|3] ""  FR_CMR
 SG_ FLR_CT9_ElevationConfidence : 111|2@1+ (1,0) [0|3] ""  FR_CMR
 SG_ FLR_CT9_ExistanceProbability : 113|5@1+ (5,0) [0|100] "%"  FR_CMR
 SG_ FLR_CT9_Lifetime : 118|13@1+ (1,0) [0|8190] "Cycles"  FR_CMR
 SG_ FLR_CT9_ModelBoxHeading : 131|13@1- (0.001,0) [-3.15|3.15] "rad"  FR_CMR
 SG_ FLR_CT9_ModelBoxLength : 144|9@1+ (0.1,0) [0|50] "m"  FR_CMR
 SG_ FLR_CT9_ModelBoxWidth : 153|8@1+ (0.1,0) [0|25] "m"  FR_CMR
 SG_ FLR_CT9_ModelBoxX : 161|11@1+ (0.05,-25) [-25|75] "m"  FR_CMR
 SG_ FLR_CT9_ModelBoxY : 172|9@1- (0.1,0) [-25|25] "m"  FR_CMR
 SG_ FLR_CT9_MotionClass : 181|2@1+ (1,0) [0|3] ""  FR_CMR
 SG_ FLR_CT9_ObjectId : 183|16@1+ (1,0) [0|65535] ""  FR_CMR
 SG_ FLR_CT9_ObservationHistory : 199|16@1+ (1,0) [0|65535] ""  FR_CMR
 SG_ FLR_CT9_QualityBits : 215|18@1+ (1,0) [0|262143] ""  FR_CMR
 SG_ FLR_CT9_StationaryCounter : 233|16@1+ (1,0) [0|65535] ""  FR_CMR
 SG_ FLR_CT9_Type : 249|4@1+ (1,0) [0|8] ""  FR_CMR
 SG_ FLR_CT9_X_Acceleration : 253|9@1- (0.1,0) [-25|25] "m/s^2"  FR_CMR
 SG_ FLR_CT9_X_Velocity : 262|13@1- (0.05,0) [-120|120] "m/s"  FR_CMR
 SG_ FLR_CT9_X_VelocityStdDev : 275|7@1+ (0.05,0) [0|6] "m/s"  FR_CMR
 SG_ FLR_CT9_Y_Acceleration : 282|8@1- (0.25,0) [-25|25] "m/s^2"  FR_CMR
 SG_ FLR_CT9_Y_Velocity : 290|11@1- (0.1,0) [-100|100] "m/s"  FR_CMR
 SG_ FLR_CT9_Y_VelocityStdDev : 301|7@1+ (0.05,0) [0|6] "m/s"  FR_CMR

BO_ 394 L_FR_RDR_ClusterTrack10_50ms: 64 FR_RDR
 SG_ FLR_CT10_CrcVal : 0|16@1+ (1,0) [0|65535] ""  FR_CMR
 SG_ FLR_CT10_AlvCntVal : 16|8@1+ (1,0) [0|255] ""  FR_CMR
 SG_ FLR_CT10_ListIndex : 24|4@1+ (1,0) [0|15] ""  FR_CMR
 SG_ FLR_CT10_SequenceCounter : 28|4@1+ (1,0) [0|15] ""  FR_CMR
 SG_ FLR_CT10_TimeStamp : 32|32@1+ (1,0) [0|4294967295] ""  FR_CMR
 SG_ FLR_CT10_Latency : 64|8@1+ (1,0) [0|255] "ms"  FR_CMR
 SG_ FLR_CT10_ClosestPointX : 72|12@1+ (0.05,-3) [-3|200] "m"  FR_CMR
 SG_ FLR_CT10_ClosestPointXStdDev : 84|7@1+ (0.05,0) [0|6] "m"  FR_CMR
 SG_ FLR_CT10_ClosestPointY : 91|10@1- (0.1,0) [-51|51] "m"  FR_CMR
 SG_ FLR_CT10_ClosestPointYStdDev : 101|6@1+ (0.1,0) [0|6] "m"  FR_CMR
 SG_ FLR_CT10_Confidence : 107|2@1+ (1,0) [0|3] ""  FR_CMR
 SG_ FLR_CT10_Elevation : 109|2@1+ (1,0) [0|3] ""  FR_CMR
 SG_ FLR_CT10_ElevationConfidence : 111|2@1+ (1,0) [0|3] ""  FR_CMR
 SG_ FLR_CT10_ExistanceProbability : 113|5@1+ (5,0) [0|100] "%"  FR_CMR
 SG_ FLR_CT10_Lifetime : 118|13@1+ (1,0) [0|8190] "Cycles"  FR_CMR
 SG_ FLR_CT10_ModelBoxHeading : 131|13@1- (0.001,0) [-3.15|3.15] "rad"  FR_CMR
 SG_ FLR_CT10_ModelBoxLength : 144|9@1+ (0.1,0) [0|50] "m"  FR_CMR
 SG_ FLR_CT10_ModelBoxWidth : 153|8@1+ (0.1,0) [0|25] "m"  FR_CMR
 SG_ FLR_CT10_ModelBoxX : 161|11@1+ (0.05,-25) [-25|75] "m"  FR_CMR
 SG_ FLR_CT10_ModelBoxY : 172|9@1- (0.1,0) [-25|25] "m"  FR_CMR
 SG_ FLR_CT10_MotionClass : 181|2@1+ (1,0) [0|3] ""  FR_CMR
 SG_ FLR_CT10_ObjectId : 183|16@1+ (1,0) [0|65535] ""  FR_CMR
 SG_ FLR_CT10_ObservationHistory : 199|16@1+ (1,0) [0|65535] ""  FR_CMR
 SG_ FLR_CT10_QualityBits : 215|18@1+ (1,0) [0|262143] ""  FR_CMR
 SG_ FLR_CT10_StationaryCounter : 233|16@1+ (1,0) [0|65535] ""  FR_CMR
 SG_ FLR_CT10_Type : 249|4@1+ (1,0) [0|8] ""  FR_CMR
 SG_ FLR_CT10_X_Acceleration : 253|9@1- (0.1,0) [-25|25] "m/s^2"  FR_CMR
 SG_ FLR_CT10_X_Velocity : 262|13@1- (0.05,0) [-120|120] "m/s"  FR_CMR
 SG_ FLR_CT10_X_VelocityStdDev : 275|7@1+ (0.05,0) [0|6] "m/s"  FR_CMR
 SG_ FLR_CT10_Y_Acceleration : 282|8@1- (0.25,0) [-25|25] "m/s^2"  FR_CMR
 SG_ FLR_CT10_Y_Velocity : 290|11@1- (0.1,0) [-100|100] "m/s"  FR_CMR
 SG_ FLR_CT10_Y_VelocityStdDev : 301|7@1+ (0.05,0) [0|6] "m/s"  FR_CMR

BO_ 395 L_FR_RDR_ClusterTrack11_50ms: 64 FR_RDR
 SG_ FLR_CT11_CrcVal : 0|16@1+ (1,0) [0|65535] ""  FR_CMR
 SG_ FLR_CT11_AlvCntVal : 16|8@1+ (1,0) [0|255] ""  FR_CMR
 SG_ FLR_CT11_ListIndex : 24|4@1+ (1,0) [0|15] ""  FR_CMR
 SG_ FLR_CT11_SequenceCounter : 28|4@1+ (1,0) [0|15] ""  FR_CMR
 SG_ FLR_CT11_TimeStamp : 32|32@1+ (1,0) [0|4294967295] ""  FR_CMR
 SG_ FLR_CT11_Latency : 64|8@1+ (1,0) [0|255] "ms"  FR_CMR
 SG_ FLR_CT11_ClosestPointX : 72|12@1+ (0.05,-3) [-3|200] "m"  FR_CMR
 SG_ FLR_CT11_ClosestPointXStdDev : 84|7@1+ (0.05,0) [0|6] "m"  FR_CMR
 SG_ FLR_CT11_ClosestPointY : 91|10@1- (0.1,0) [-51|51] "m"  FR_CMR
 SG_ FLR_CT11_ClosestPointYStdDev : 101|6@1+ (0.1,0) [0|6] "m"  FR_CMR
 SG_ FLR_CT11_Confidence : 107|2@1+ (1,0) [0|3] ""  FR_CMR
 SG_ FLR_CT11_Elevation : 109|2@1+ (1,0) [0|3] ""  FR_CMR
 SG_ FLR_CT11_ElevationConfidence : 111|2@1+ (1,0) [0|3] ""  FR_CMR
 SG_ FLR_CT11_ExistanceProbability : 113|5@1+ (5,0) [0|100] "%"  FR_CMR
 SG_ FLR_CT11_Lifetime : 118|13@1+ (1,0) [0|8190] "Cycles"  FR_CMR
 SG_ FLR_CT11_ModelBoxHeading : 131|13@1- (0.001,0) [-3.15|3.15] "rad"  FR_CMR
 SG_ FLR_CT11_ModelBoxLength : 144|9@1+ (0.1,0) [0|50] "m"  FR_CMR
 SG_ FLR_CT11_ModelBoxWidth : 153|8@1+ (0.1,0) [0|25] "m"  FR_CMR
 SG_ FLR_CT11_ModelBoxX : 161|11@1+ (0.05,-25) [-25|75] "m"  FR_CMR
 SG_ FLR_CT11_ModelBoxY : 172|9@1- (0.1,0) [-25|25] "m"  FR_CMR
 SG_ FLR_CT11_MotionClass : 181|2@1+ (1,0) [0|3] ""  FR_CMR
 SG_ FLR_CT11_ObjectId : 183|16@1+ (1,0) [0|65535] ""  FR_CMR
 SG_ FLR_CT11_ObservationHistory : 199|16@1+ (1,0) [0|65535] ""  FR_CMR
 SG_ FLR_CT11_QualityBits : 215|18@1+ (1,0) [0|262143] ""  FR_CMR
 SG_ FLR_CT11_StationaryCounter : 233|16@1+ (1,0) [0|65535] ""  FR_CMR
 SG_ FLR_CT11_Type : 249|4@1+ (1,0) [0|8] ""  FR_CMR
 SG_ FLR_CT11_X_Acceleration : 253|9@1- (0.1,0) [-25|25] "m/s^2"  FR_CMR
 SG_ FLR_CT11_X_Velocity : 262|13@1- (0.05,0) [-120|120] "m/s"  FR_CMR
 SG_ FLR_CT11_X_VelocityStdDev : 275|7@1+ (0.05,0) [0|6] "m/s"  FR_CMR
 SG_ FLR_CT11_Y_Acceleration : 282|8@1- (0.25,0) [-25|25] "m/s^2"  FR_CMR
 SG_ FLR_CT11_Y_Velocity : 290|11@1- (0.1,0) [-100|100] "m/s"  FR_CMR
 SG_ FLR_CT11_Y_VelocityStdDev : 301|7@1+ (0.05,0) [0|6] "m/s"  FR_CMR

BO_ 396 L_FR_RDR_ClusterTrack12_50ms: 64 FR_RDR
 SG_ FLR_CT12_CrcVal : 0|16@1+ (1,0) [0|65535] ""  FR_CMR
 SG_ FLR_CT12_AlvCntVal : 16|8@1+ (1,0) [0|255] ""  FR_CMR
 SG_ FLR_CT12_ListIndex : 24|4@1+ (1,0) [0|15] ""  FR_CMR
 SG_ FLR_CT12_SequenceCounter : 28|4@1+ (1,0) [0|15] ""  FR_CMR
 SG_ FLR_CT12_TimeStamp : 32|32@1+ (1,0) [0|4294967295] ""  FR_CMR
 SG_ FLR_CT12_Latency : 64|8@1+ (1,0) [0|255] "ms"  FR_CMR
 SG_ FLR_CT12_ClosestPointX : 72|12@1+ (0.05,-3) [-3|200] "m"  FR_CMR
 SG_ FLR_CT12_ClosestPointXStdDev : 84|7@1+ (0.05,0) [0|6] "m"  FR_CMR
 SG_ FLR_CT12_ClosestPointY : 91|10@1- (0.1,0) [-51|51] "m"  FR_CMR
 SG_ FLR_CT12_ClosestPointYStdDev : 101|6@1+ (0.1,0) [0|6] "m"  FR_CMR
 SG_ FLR_CT12_Confidence : 107|2@1+ (1,0) [0|3] ""  FR_CMR
 SG_ FLR_CT12_Elevation : 109|2@1+ (1,0) [0|3] ""  FR_CMR
 SG_ FLR_CT12_ElevationConfidence : 111|2@1+ (1,0) [0|3] ""  FR_CMR
 SG_ FLR_CT12_ExistanceProbability : 113|5@1+ (5,0) [0|100] "%"  FR_CMR
 SG_ FLR_CT12_Lifetime : 118|13@1+ (1,0) [0|8190] "Cycles"  FR_CMR
 SG_ FLR_CT12_ModelBoxHeading : 131|13@1- (0.001,0) [-3.15|3.15] "rad"  FR_CMR
 SG_ FLR_CT12_ModelBoxLength : 144|9@1+ (0.1,0) [0|50] "m"  FR_CMR
 SG_ FLR_CT12_ModelBoxWidth : 153|8@1+ (0.1,0) [0|25] "m"  FR_CMR
 SG_ FLR_CT12_ModelBoxX : 161|11@1+ (0.05,-25) [-25|75] "m"  FR_CMR
 SG_ FLR_CT12_ModelBoxY : 172|9@1- (0.1,0) [-25|25] "m"  FR_CMR
 SG_ FLR_CT12_MotionClass : 181|2@1+ (1,0) [0|3] ""  FR_CMR
 SG_ FLR_CT12_ObjectId : 183|16@1+ (1,0) [0|65535] ""  FR_CMR
 SG_ FLR_CT12_ObservationHistory : 199|16@1+ (1,0) [0|65535] ""  FR_CMR
 SG_ FLR_CT12_QualityBits : 215|18@1+ (1,0) [0|262143] ""  FR_CMR
 SG_ FLR_CT12_StationaryCounter : 233|16@1+ (1,0) [0|65535] ""  FR_CMR
 SG_ FLR_CT12_Type : 249|4@1+ (1,0) [0|8] ""  FR_CMR
 SG_ FLR_CT12_X_Acceleration : 253|9@1- (0.1,0) [-25|25] "m/s^2"  FR_CMR
 SG_ FLR_CT12_X_Velocity : 262|13@1- (0.05,0) [-120|120] "m/s"  FR_CMR
 SG_ FLR_CT12_X_VelocityStdDev : 275|7@1+ (0.05,0) [0|6] "m/s"  FR_CMR
 SG_ FLR_CT12_Y_Acceleration : 282|8@1- (0.25,0) [-25|25] "m/s^2"  FR_CMR
 SG_ FLR_CT12_Y_Velocity : 290|11@1- (0.1,0) [-100|100] "m/s"  FR_CMR
 SG_ FLR_CT12_Y_VelocityStdDev : 301|7@1+ (0.05,0) [0|6] "m/s"  FR_CMR

BO_ 397 L_FR_RDR_ClusterTrack13_50ms: 64 FR_RDR
 SG_ FLR_CT13_CrcVal : 0|16@1+ (1,0) [0|65535] ""  FR_CMR
 SG_ FLR_CT13_AlvCntVal : 16|8@1+ (1,0) [0|255] ""  FR_CMR
 SG_ FLR_CT13_ListIndex : 24|4@1+ (1,0) [0|15] ""  FR_CMR
 SG_ FLR_CT13_SequenceCounter : 28|4@1+ (1,0) [0|15] ""  FR_CMR
 SG_ FLR_CT13_TimeStamp : 32|32@1+ (1,0) [0|4294967295] ""  FR_CMR
 SG_ FLR_CT13_Latency : 64|8@1+ (1,0) [0|255] "ms"  FR_CMR
 SG_ FLR_CT13_ClosestPointX : 72|12@1+ (0.05,-3) [-3|200] "m"  FR_CMR
 SG_ FLR_CT13_ClosestPointXStdDev : 84|7@1+ (0.05,0) [0|6] "m"  FR_CMR
 SG_ FLR_CT13_ClosestPointY : 91|10@1- (0.1,0) [-51|51] "m"  FR_CMR
 SG_ FLR_CT13_ClosestPointYStdDev : 101|6@1+ (0.1,0) [0|6] "m"  FR_CMR
 SG_ FLR_CT13_Confidence : 107|2@1+ (1,0) [0|3] ""  FR_CMR
 SG_ FLR_CT13_Elevation : 109|2@1+ (1,0) [0|3] ""  FR_CMR
 SG_ FLR_CT13_ElevationConfidence : 111|2@1+ (1,0) [0|3] ""  FR_CMR
 SG_ FLR_CT13_ExistanceProbability : 113|5@1+ (5,0) [0|100] "%"  FR_CMR
 SG_ FLR_CT13_Lifetime : 118|13@1+ (1,0) [0|8190] "Cycles"  FR_CMR
 SG_ FLR_CT13_ModelBoxHeading : 131|13@1- (0.001,0) [-3.15|3.15] "rad"  FR_CMR
 SG_ FLR_CT13_ModelBoxLength : 144|9@1+ (0.1,0) [0|50] "m"  FR_CMR
 SG_ FLR_CT13_ModelBoxWidth : 153|8@1+ (0.1,0) [0|25] "m"  FR_CMR
 SG_ FLR_CT13_ModelBoxX : 161|11@1+ (0.05,-25) [-25|75] "m"  FR_CMR
 SG_ FLR_CT13_ModelBoxY : 172|9@1- (0.1,0) [-25|25] "m"  FR_CMR
 SG_ FLR_CT13_MotionClass : 181|2@1+ (1,0) [0|3] ""  FR_CMR
 SG_ FLR_CT13_ObjectId : 183|16@1+ (1,0) [0|65535] ""  FR_CMR
 SG_ FLR_CT13_ObservationHistory : 199|16@1+ (1,0) [0|65535] ""  FR_CMR
 SG_ FLR_CT13_QualityBits : 215|18@1+ (1,0) [0|262143] ""  FR_CMR
 SG_ FLR_CT13_StationaryCounter : 233|16@1+ (1,0) [0|65535] ""  FR_CMR
 SG_ FLR_CT13_Type : 249|4@1+ (1,0) [0|8] ""  FR_CMR
 SG_ FLR_CT13_X_Acceleration : 253|9@1- (0.1,0) [-25|25] "m/s^2"  FR_CMR
 SG_ FLR_CT13_X_Velocity : 262|13@1- (0.05,0) [-120|120] "m/s"  FR_CMR
 SG_ FLR_CT13_X_VelocityStdDev : 275|7@1+ (0.05,0) [0|6] "m/s"  FR_CMR
 SG_ FLR_CT13_Y_Acceleration : 282|8@1- (0.25,0) [-25|25] "m/s^2"  FR_CMR
 SG_ FLR_CT13_Y_Velocity : 290|11@1- (0.1,0) [-100|100] "m/s"  FR_CMR
 SG_ FLR_CT13_Y_VelocityStdDev : 301|7@1+ (0.05,0) [0|6] "m/s"  FR_CMR

BO_ 398 L_FR_RDR_ClusterTrack14_50ms: 64 FR_RDR
 SG_ FLR_CT14_CrcVal : 0|16@1+ (1,0) [0|65535] ""  FR_CMR
 SG_ FLR_CT14_AlvCntVal : 16|8@1+ (1,0) [0|255] ""  FR_CMR
 SG_ FLR_CT14_ListIndex : 24|4@1+ (1,0) [0|15] ""  FR_CMR
 SG_ FLR_CT14_SequenceCounter : 28|4@1+ (1,0) [0|15] ""  FR_CMR
 SG_ FLR_CT14_TimeStamp : 32|32@1+ (1,0) [0|4294967295] ""  FR_CMR
 SG_ FLR_CT14_Latency : 64|8@1+ (1,0) [0|255] "ms"  FR_CMR
 SG_ FLR_CT14_ClosestPointX : 72|12@1+ (0.05,-3) [-3|200] "m"  FR_CMR
 SG_ FLR_CT14_ClosestPointXStdDev : 84|7@1+ (0.05,0) [0|6] "m"  FR_CMR
 SG_ FLR_CT14_ClosestPointY : 91|10@1- (0.1,0) [-51|51] "m"  FR_CMR
 SG_ FLR_CT14_ClosestPointYStdDev : 101|6@1+ (0.1,0) [0|6] "m"  FR_CMR
 SG_ FLR_CT14_Confidence : 107|2@1+ (1,0) [0|3] ""  FR_CMR
 SG_ FLR_CT14_Elevation : 109|2@1+ (1,0) [0|3] ""  FR_CMR
 SG_ FLR_CT14_ElevationConfidence : 111|2@1+ (1,0) [0|3] ""  FR_CMR
 SG_ FLR_CT14_ExistanceProbability : 113|5@1+ (5,0) [0|100] "%"  FR_CMR
 SG_ FLR_CT14_Lifetime : 118|13@1+ (1,0) [0|8190] "Cycles"  FR_CMR
 SG_ FLR_CT14_ModelBoxHeading : 131|13@1- (0.001,0) [-3.15|3.15] "rad"  FR_CMR
 SG_ FLR_CT14_ModelBoxLength : 144|9@1+ (0.1,0) [0|50] "m"  FR_CMR
 SG_ FLR_CT14_ModelBoxWidth : 153|8@1+ (0.1,0) [0|25] "m"  FR_CMR
 SG_ FLR_CT14_ModelBoxX : 161|11@1+ (0.05,-25) [-25|75] "m"  FR_CMR
 SG_ FLR_CT14_ModelBoxY : 172|9@1- (0.1,0) [-25|25] "m"  FR_CMR
 SG_ FLR_CT14_MotionClass : 181|2@1+ (1,0) [0|3] ""  FR_CMR
 SG_ FLR_CT14_ObjectId : 183|16@1+ (1,0) [0|65535] ""  FR_CMR
 SG_ FLR_CT14_ObservationHistory : 199|16@1+ (1,0) [0|65535] ""  FR_CMR
 SG_ FLR_CT14_QualityBits : 215|18@1+ (1,0) [0|262143] ""  FR_CMR
 SG_ FLR_CT14_StationaryCounter : 233|16@1+ (1,0) [0|65535] ""  FR_CMR
 SG_ FLR_CT14_Type : 249|4@1+ (1,0) [0|8] ""  FR_CMR
 SG_ FLR_CT14_X_Acceleration : 253|9@1- (0.1,0) [-25|25] "m/s^2"  FR_CMR
 SG_ FLR_CT14_X_Velocity : 262|13@1- (0.05,0) [-120|120] "m/s"  FR_CMR
 SG_ FLR_CT14_X_VelocityStdDev : 275|7@1+ (0.05,0) [0|6] "m/s"  FR_CMR
 SG_ FLR_CT14_Y_Acceleration : 282|8@1- (0.25,0) [-25|25] "m/s^2"  FR_CMR
 SG_ FLR_CT14_Y_Velocity : 290|11@1- (0.1,0) [-100|100] "m/s"  FR_CMR
 SG_ FLR_CT14_Y_VelocityStdDev : 301|7@1+ (0.05,0) [0|6] "m/s"  FR_CMR

BO_ 399 L_FR_RDR_ClusterTrack15_50ms: 64 FR_RDR
 SG_ FLR_CT15_CrcVal : 0|16@1+ (1,0) [0|65535] ""  FR_CMR
 SG_ FLR_CT15_AlvCntVal : 16|8@1+ (1,0) [0|255] ""  FR_CMR
 SG_ FLR_CT15_ListIndex : 24|4@1+ (1,0) [0|15] ""  FR_CMR
 SG_ FLR_CT15_SequenceCounter : 28|4@1+ (1,0) [0|15] ""  FR_CMR
 SG_ FLR_CT15_TimeStamp : 32|32@1+ (1,0) [0|4294967295] ""  FR_CMR
 SG_ FLR_CT15_Latency : 64|8@1+ (1,0) [0|255] "ms"  FR_CMR
 SG_ FLR_CT15_ClosestPointX : 72|12@1+ (0.05,-3) [-3|200] "m"  FR_CMR
 SG_ FLR_CT15_ClosestPointXStdDev : 84|7@1+ (0.05,0) [0|6] "m"  FR_CMR
 SG_ FLR_CT15_ClosestPointY : 91|10@1- (0.1,0) [-51|51] "m"  FR_CMR
 SG_ FLR_CT15_ClosestPointYStdDev : 101|6@1+ (0.1,0) [0|6] "m"  FR_CMR
 SG_ FLR_CT15_Confidence : 107|2@1+ (1,0) [0|3] ""  FR_CMR
 SG_ FLR_CT15_Elevation : 109|2@1+ (1,0) [0|3] ""  FR_CMR
 SG_ FLR_CT15_ElevationConfidence : 111|2@1+ (1,0) [0|3] ""  FR_CMR
 SG_ FLR_CT15_ExistanceProbability : 113|5@1+ (5,0) [0|100] "%"  FR_CMR
 SG_ FLR_CT15_Lifetime : 118|13@1+ (1,0) [0|8190] "Cycles"  FR_CMR
 SG_ FLR_CT15_ModelBoxHeading : 131|13@1- (0.001,0) [-3.15|3.15] "rad"  FR_CMR
 SG_ FLR_CT15_ModelBoxLength : 144|9@1+ (0.1,0) [0|50] "m"  FR_CMR
 SG_ FLR_CT15_ModelBoxWidth : 153|8@1+ (0.1,0) [0|25] "m"  FR_CMR
 SG_ FLR_CT15_ModelBoxX : 161|11@1+ (0.05,-25) [-25|75] "m"  FR_CMR
 SG_ FLR_CT15_ModelBoxY : 172|9@1- (0.1,0) [-25|25] "m"  FR_CMR
 SG_ FLR_CT15_MotionClass : 181|2@1+ (1,0) [0|3] ""  FR_CMR
 SG_ FLR_CT15_ObjectId : 183|16@1+ (1,0) [0|65535] ""  FR_CMR
 SG_ FLR_CT15_ObservationHistory : 199|16@1+ (1,0) [0|65535] ""  FR_CMR
 SG_ FLR_CT15_QualityBits : 215|18@1+ (1,0) [0|262143] ""  FR_CMR
 SG_ FLR_CT15_StationaryCounter : 233|16@1+ (1,0) [0|65535] ""  FR_CMR
 SG_ FLR_CT15_Type : 249|4@1+ (1,0) [0|8] ""  FR_CMR
 SG_ FLR_CT15_X_Acceleration : 253|9@1- (0.1,0) [-25|25] "m/s^2"  FR_CMR
 SG_ FLR_CT15_X_Velocity : 262|13@1- (0.05,0) [-120|120] "m/s"  FR_CMR
 SG_ FLR_CT15_X_VelocityStdDev : 275|7@1+ (0.05,0) [0|6] "m/s"  FR_CMR
 SG_ FLR_CT15_Y_Acceleration : 282|8@1- (0.25,0) [-25|25] "m/s^2"  FR_CMR
 SG_ FLR_CT15_Y_Velocity : 290|11@1- (0.1,0) [-100|100] "m/s"  FR_CMR
 SG_ FLR_CT15_Y_VelocityStdDev : 301|7@1+ (0.05,0) [0|6] "m/s"  FR_CMR

CM_ BO_ 384 "[P] Periodic";
CM_ SG_ 384 FLR_CT0_CrcVal "CyclicRedundancyCheckValue";
CM_ SG_ 384 FLR_CT0_AlvCntVal "AliveCounter";
CM_ SG_ 384 FLR_CT0_ListIndex "TrackListIndex";
CM_ SG_ 384 FLR_CT0_SequenceCounter "SequenceCounter";
CM_ SG_ 384 FLR_CT0_TimeStamp "TimeStamp";
CM_ SG_ 384 FLR_CT0_Latency "Sensor latency";
CM_ SG_ 384 FLR_CT0_ClosestPointX "ClosestPointX";
CM_ SG_ 384 FLR_CT0_ClosestPointXStdDev "ClosestPointXStdDev";
CM_ SG_ 384 FLR_CT0_ClosestPointY "ClosestPointY";
CM_ SG_ 384 FLR_CT0_ClosestPointYStdDev "ClosestPointYStdDev";
CM_ SG_ 384 FLR_CT0_Confidence "Confidence";
CM_ SG_ 384 FLR_CT0_Elevation "Elevation";
CM_ SG_ 384 FLR_CT0_ElevationConfidence "ElevationConfidence";
CM_ SG_ 384 FLR_CT0_ExistanceProbability "ExistanceProbability";
CM_ SG_ 384 FLR_CT0_Lifetime "Lifetime";
CM_ SG_ 384 FLR_CT0_ModelBoxHeading "ModelBoxHeading";
CM_ SG_ 384 FLR_CT0_ModelBoxLength "ModelBoxLength";
CM_ SG_ 384 FLR_CT0_ModelBoxWidth "ModelBoxWidth";
CM_ SG_ 384 FLR_CT0_ModelBoxX "ModelBoxX";
CM_ SG_ 384 FLR_CT0_ModelBoxY "ModelBoxY";
CM_ SG_ 384 FLR_CT0_MotionClass "MotionClass";
CM_ SG_ 384 FLR_CT0_ObjectId "ObjectId";
CM_ SG_ 384 FLR_CT0_ObservationHistory "ObservationHistory";
CM_ SG_ 384 FLR_CT0_QualityBits "QualityBits";
CM_ SG_ 384 FLR_CT0_StationaryCounter "StationaryCounter";
CM_ SG_ 384 FLR_CT0_Type "Type";
CM_ SG_ 384 FLR_CT0_X_Acceleration "X_Acceleration";
CM_ SG_ 384 FLR_CT0_X_Velocity "X_Velocity";
CM_ SG_ 384 FLR_CT0_X_VelocityStdDev "X_VelocityStdDev";
CM_ SG_ 384 FLR_CT0_Y_Acceleration "Y_Acceleration";
CM_ SG_ 384 FLR_CT0_Y_Velocity "Y_Velocity";
CM_ SG_ 384 FLR_CT0_Y_VelocityStdDev "Y_VelocityStdDev";
CM_ BO_ 385 "[P] Periodic";
CM_ SG_ 385 FLR_CT1_CrcVal "CyclicRedundancyCheckValue";
CM_ SG_ 385 FLR_CT1_AlvCntVal "AliveCounter";
CM_ SG_ 385 FLR_CT1_ListIndex "TrackListIndex";
CM_ SG_ 385 FLR_CT1_SequenceCounter "SequenceCounter";
CM_ SG_ 385 FLR_CT1_TimeStamp "TimeStamp";
CM_ SG_ 385 FLR_CT1_Latency "Sensor latency";
CM_ SG_ 385 FLR_CT1_ClosestPointX "ClosestPointX";
CM_ SG_ 385 FLR_CT1_ClosestPointXStdDev "ClosestPointXStdDev";
CM_ SG_ 385 FLR_CT1_ClosestPointY "ClosestPointY";
CM_ SG_ 385 FLR_CT1_ClosestPointYStdDev "ClosestPointYStdDev";
CM_ SG_ 385 FLR_CT1_Confidence "Confidence";
CM_ SG_ 385 FLR_CT1_Elevation "Elevation";
CM_ SG_ 385 FLR_CT1_ElevationConfidence "ElevationConfidence";
CM_ SG_ 385 FLR_CT1_ExistanceProbability "ExistanceProbability";
CM_ SG_ 385 FLR_CT1_Lifetime "Lifetime";
CM_ SG_ 385 FLR_CT1_ModelBoxHeading "ModelBoxHeading";
CM_ SG_ 385 FLR_CT1_ModelBoxLength "ModelBoxLength";
CM_ SG_ 385 FLR_CT1_ModelBoxWidth "ModelBoxWidth";
CM_ SG_ 385 FLR_CT1_ModelBoxX "ModelBoxX";
CM_ SG_ 385 FLR_CT1_ModelBoxY "ModelBoxY";
CM_ SG_ 385 FLR_CT1_MotionClass "MotionClass";
CM_ SG_ 385 FLR_CT1_ObjectId "ObjectId";
CM_ SG_ 385 FLR_CT1_ObservationHistory "ObservationHistory";
CM_ SG_ 385 FLR_CT1_QualityBits "QualityBits";
CM_ SG_ 385 FLR_CT1_StationaryCounter "StationaryCounter";
CM_ SG_ 385 FLR_CT1_Type "Type";
CM_ SG_ 385 FLR_CT1_X_Acceleration "X_Acceleration";
CM_ SG_ 385 FLR_CT1_X_Velocity "X_Velocity";
CM_ SG_ 385 FLR_CT1_X_VelocityStdDev "X_VelocityStdDev";
CM_ SG_ 385 FLR_CT1_Y_Acceleration "Y_Acceleration";
CM_ SG_ 385 FLR_CT1_Y_Velocity "Y_Velocity";
CM_ SG_ 385 FLR_CT1_Y_VelocityStdDev "Y_VelocityStdDev";
CM_ BO_ 386 "[P] Periodic";
CM_ SG_ 386 FLR_CT2_CrcVal "CyclicRedundancyCheckValue";
CM_ SG_ 386 FLR_CT2_AlvCntVal "AliveCounter";
CM_ SG_ 386 FLR_CT2_ListIndex "TrackListIndex";
CM_ SG_ 386 FLR_CT2_SequenceCounter "SequenceCounter";
CM_ SG_ 386 FLR_CT2_TimeStamp "TimeStamp";
CM_ SG_ 386 FLR_CT2_Latency "Sensor latency";
CM_ SG_ 386 FLR_CT2_ClosestPointX "ClosestPointX";
CM_ SG_ 386 FLR_CT2_ClosestPointXStdDev "ClosestPointXStdDev";
CM_ SG_ 386 FLR_CT2_ClosestPointY "ClosestPointY";
CM_ SG_ 386 FLR_CT2_ClosestPointYStdDev "ClosestPointYStdDev";
CM_ SG_ 386 FLR_CT2_Confidence "Confidence";
CM_ SG_ 386 FLR_CT2_Elevation "Elevation";
CM_ SG_ 386 FLR_CT2_ElevationConfidence "ElevationConfidence";
CM_ SG_ 386 FLR_CT2_ExistanceProbability "ExistanceProbability";
CM_ SG_ 386 FLR_CT2_Lifetime "Lifetime";
CM_ SG_ 386 FLR_CT2_ModelBoxHeading "ModelBoxHeading";
CM_ SG_ 386 FLR_CT2_ModelBoxLength "ModelBoxLength";
CM_ SG_ 386 FLR_CT2_ModelBoxWidth "ModelBoxWidth";
CM_ SG_ 386 FLR_CT2_ModelBoxX "ModelBoxX";
CM_ SG_ 386 FLR_CT2_ModelBoxY "ModelBoxY";
CM_ SG_ 386 FLR_CT2_MotionClass "MotionClass";
CM_ SG_ 386 FLR_CT2_ObjectId "ObjectId";
CM_ SG_ 386 FLR_CT2_ObservationHistory "ObservationHistory";
CM_ SG_ 386 FLR_CT2_QualityBits "QualityBits";
CM_ SG_ 386 FLR_CT2_StationaryCounter "StationaryCounter";
CM_ SG_ 386 FLR_CT2_Type "Type";
CM_ SG_ 386 FLR_CT2_X_Acceleration "X_Acceleration";
CM_ SG_ 386 FLR_CT2_X_Velocity "X_Velocity";
CM_ SG_ 386 FLR_CT2_X_VelocityStdDev "X_VelocityStdDev";
CM_ SG_ 386 FLR_CT2_Y_Acceleration "Y_Acceleration";
CM_ SG_ 386 FLR_CT2_Y_Velocity "Y_Velocity";
CM_ SG_ 386 FLR_CT2_Y_VelocityStdDev "Y_VelocityStdDev";
CM_ BO_ 387 "[P] Periodic";
CM_ SG_ 387 FLR_CT3_CrcVal "CyclicRedundancyCheckValue";
CM_ SG_ 387 FLR_CT3_AlvCntVal "AliveCounter";
CM_ SG_ 387 FLR_CT3_ListIndex "TrackListIndex";
CM_ SG_ 387 FLR_CT3_SequenceCounter "SequenceCounter";
CM_ SG_ 387 FLR_CT3_TimeStamp "TimeStamp";
CM_ SG_ 387 FLR_CT3_Latency "Sensor latency";
CM_ SG_ 387 FLR_CT3_ClosestPointX "ClosestPointX";
CM_ SG_ 387 FLR_CT3_ClosestPointXStdDev "ClosestPointXStdDev";
CM_ SG_ 387 FLR_CT3_ClosestPointY "ClosestPointY";
CM_ SG_ 387 FLR_CT3_ClosestPointYStdDev "ClosestPointYStdDev";
CM_ SG_ 387 FLR_CT3_Confidence "Confidence";
CM_ SG_ 387 FLR_CT3_Elevation "Elevation";
CM_ SG_ 387 FLR_CT3_ElevationConfidence "ElevationConfidence";
CM_ SG_ 387 FLR_CT3_ExistanceProbability "ExistanceProbability";
CM_ SG_ 387 FLR_CT3_Lifetime "Lifetime";
CM_ SG_ 387 FLR_CT3_ModelBoxHeading "ModelBoxHeading";
CM_ SG_ 387 FLR_CT3_ModelBoxLength "ModelBoxLength";
CM_ SG_ 387 FLR_CT3_ModelBoxWidth "ModelBoxWidth";
CM_ SG_ 387 FLR_CT3_ModelBoxX "ModelBoxX";
CM_ SG_ 387 FLR_CT3_ModelBoxY "ModelBoxY";
CM_ SG_ 387 FLR_CT3_MotionClass "MotionClass";
CM_ SG_ 387 FLR_CT3_ObjectId "ObjectId";
CM_ SG_ 387 FLR_CT3_ObservationHistory "ObservationHistory";
CM_ SG_ 387 FLR_CT3_QualityBits "QualityBits";
CM_ SG_ 387 FLR_CT3_StationaryCounter "StationaryCounter";
CM_ SG_ 387 FLR_CT3_Type "Type";
CM_ SG_ 387 FLR_CT3_X_Acceleration "X_Acceleration";
CM_ SG_ 387 FLR_CT3_X_Velocity "X_Velocity";
CM_ SG_ 387 FLR_CT3_X_VelocityStdDev "X_VelocityStdDev";
CM_ SG_ 387 FLR_CT3_Y_Acceleration "Y_Acceleration";
CM_ SG_ 387 FLR_CT3_Y_Velocity "Y_Velocity";
CM_ SG_ 387 FLR_CT3_Y_VelocityStdDev "Y_VelocityStdDev";
CM_ BO_ 388 "[P] Periodic";
CM_ SG_ 388 FLR_CT4_CrcVal "CyclicRedundancyCheckValue";
CM_ SG_ 388 FLR_CT4_AlvCntVal "AliveCounter";
CM_ SG_ 388 FLR_CT4_ListIndex "TrackListIndex";
CM_ SG_ 388 FLR_CT4_SequenceCounter "SequenceCounter";
CM_ SG_ 388 FLR_CT4_TimeStamp "TimeStamp";
CM_ SG_ 388 FLR_CT4_Latency "Sensor latency";
CM_ SG_ 388 FLR_CT4_ClosestPointX "ClosestPointX";
CM_ SG_ 388 FLR_CT4_ClosestPointXStdDev "ClosestPointXStdDev";
CM_ SG_ 388 FLR_CT4_ClosestPointY "ClosestPointY";
CM_ SG_ 388 FLR_CT4_ClosestPointYStdDev "ClosestPointYStdDev";
CM_ SG_ 388 FLR_CT4_Confidence "Confidence";
CM_ SG_ 388 FLR_CT4_Elevation "Elevation";
CM_ SG_ 388 FLR_CT4_ElevationConfidence "ElevationConfidence";
CM_ SG_ 388 FLR_CT4_ExistanceProbability "ExistanceProbability";
CM_ SG_ 388 FLR_CT4_Lifetime "Lifetime";
CM_ SG_ 388 FLR_CT4_ModelBoxHeading "ModelBoxHeading";
CM_ SG_ 388 FLR_CT4_ModelBoxLength "ModelBoxLength";
CM_ SG_ 388 FLR_CT4_ModelBoxWidth "ModelBoxWidth";
CM_ SG_ 388 FLR_CT4_ModelBoxX "ModelBoxX";
CM_ SG_ 388 FLR_CT4_ModelBoxY "ModelBoxY";
CM_ SG_ 388 FLR_CT4_MotionClass "MotionClass";
CM_ SG_ 388 FLR_CT4_ObjectId "ObjectId";
CM_ SG_ 388 FLR_CT4_ObservationHistory "ObservationHistory";
CM_ SG_ 388 FLR_CT4_QualityBits "QualityBits";
CM_ SG_ 388 FLR_CT4_StationaryCounter "StationaryCounter";
CM_ SG_ 388 FLR_CT4_Type "Type";
CM_ SG_ 388 FLR_CT4_X_Acceleration "X_Acceleration";
CM_ SG_ 388 FLR_CT4_X_Velocity "X_Velocity";
CM_ SG_ 388 FLR_CT4_X_VelocityStdDev "X_VelocityStdDev";
CM_ SG_ 388 FLR_CT4_Y_Acceleration "Y_Acceleration";
CM_ SG_ 388 FLR_CT4_Y_Velocity "Y_Velocity";
CM_ SG_ 388 FLR_CT4_Y_VelocityStdDev "Y_VelocityStdDev";
CM_ BO_ 389 "[P] Periodic";
CM_ SG_ 389 FLR_CT5_CrcVal "CyclicRedundancyCheckValue";
CM_ SG_ 389 FLR_CT5_AlvCntVal "AliveCounter";
CM_ SG_ 389 FLR_CT5_ListIndex "TrackListIndex";
CM_ SG_ 389 FLR_CT5_SequenceCounter "SequenceCounter";
CM_ SG_ 389 FLR_CT5_TimeStamp "TimeStamp";
CM_ SG_ 389 FLR_CT5_Latency "Sensor latency";
CM_ SG_ 389 FLR_CT5_ClosestPointX "ClosestPointX";
CM_ SG_ 389 FLR_CT5_ClosestPointXStdDev "ClosestPointXStdDev";
CM_ SG_ 389 FLR_CT5_ClosestPointY "ClosestPointY";
CM_ SG_ 389 FLR_CT5_ClosestPointYStdDev "ClosestPointYStdDev";
CM_ SG_ 389 FLR_CT5_Confidence "Confidence";
CM_ SG_ 389 FLR_CT5_Elevation "Elevation";
CM_ SG_ 389 FLR_CT5_ElevationConfidence "ElevationConfidence";
CM_ SG_ 389 FLR_CT5_ExistanceProbability "ExistanceProbability";
CM_ SG_ 389 FLR_CT5_Lifetime "Lifetime";
CM_ SG_ 389 FLR_CT5_ModelBoxHeading "ModelBoxHeading";
CM_ SG_ 389 FLR_CT5_ModelBoxLength "ModelBoxLength";
CM_ SG_ 389 FLR_CT5_ModelBoxWidth "ModelBoxWidth";
CM_ SG_ 389 FLR_CT5_ModelBoxX "ModelBoxX";
CM_ SG_ 389 FLR_CT5_ModelBoxY "ModelBoxY";
CM_ SG_ 389 FLR_CT5_MotionClass "MotionClass";
CM_ SG_ 389 FLR_CT5_ObjectId "ObjectId";
CM_ SG_ 389 FLR_CT5_ObservationHistory "ObservationHistory";
CM_ SG_ 389 FLR_CT5_QualityBits "QualityBits";
CM_ SG_ 389 FLR_CT5_StationaryCounter "StationaryCounter";
CM_ SG_ 389 FLR_CT5_Type "Type";
CM_ SG_ 389 FLR_CT5_X_Acceleration "X_Acceleration";
CM_ SG_ 389 FLR_CT5_X_Velocity "X_Velocity";
CM_ SG_ 389 FLR_CT5_X_VelocityStdDev "X_VelocityStdDev";
CM_ SG_ 389 FLR_CT5_Y_Acceleration "Y_Acceleration";
CM_ SG_ 389 FLR_CT5_Y_Velocity "Y_Velocity";
CM_ SG_ 389 FLR_CT5_Y_VelocityStdDev "Y_VelocityStdDev";
CM_ BO_ 390 "[P] Periodic";
CM_ SG_ 390 FLR_CT6_CrcVal "CyclicRedundancyCheckValue";
CM_ SG_ 390 FLR_CT6_AlvCntVal "AliveCounter";
CM_ SG_ 390 FLR_CT6_ListIndex "TrackListIndex";
CM_ SG_ 390 FLR_CT6_SequenceCounter "SequenceCounter";
CM_ SG_ 390 FLR_CT6_TimeStamp "TimeStamp";
CM_ SG_ 390 FLR_CT6_Latency "Sensor latency";
CM_ SG_ 390 FLR_CT6_ClosestPointX "ClosestPointX";
CM_ SG_ 390 FLR_CT6_ClosestPointXStdDev "ClosestPointXStdDev";
CM_ SG_ 390 FLR_CT6_ClosestPointY "ClosestPointY";
CM_ SG_ 390 FLR_CT6_ClosestPointYStdDev "ClosestPointYStdDev";
CM_ SG_ 390 FLR_CT6_Confidence "Confidence";
CM_ SG_ 390 FLR_CT6_Elevation "Elevation";
CM_ SG_ 390 FLR_CT6_ElevationConfidence "ElevationConfidence";
CM_ SG_ 390 FLR_CT6_ExistanceProbability "ExistanceProbability";
CM_ SG_ 390 FLR_CT6_Lifetime "Lifetime";
CM_ SG_ 390 FLR_CT6_ModelBoxHeading "ModelBoxHeading";
CM_ SG_ 390 FLR_CT6_ModelBoxLength "ModelBoxLength";
CM_ SG_ 390 FLR_CT6_ModelBoxWidth "ModelBoxWidth";
CM_ SG_ 390 FLR_CT6_ModelBoxX "ModelBoxX";
CM_ SG_ 390 FLR_CT6_ModelBoxY "ModelBoxY";
CM_ SG_ 390 FLR_CT6_MotionClass "MotionClass";
CM_ SG_ 390 FLR_CT6_ObjectId "ObjectId";
CM_ SG_ 390 FLR_CT6_ObservationHistory "ObservationHistory";
CM_ SG_ 390 FLR_CT6_QualityBits "QualityBits";
CM_ SG_ 390 FLR_CT6_StationaryCounter "StationaryCounter";
CM_ SG_ 390 FLR_CT6_Type "Type";
CM_ SG_ 390 FLR_CT6_X_Acceleration "X_Acceleration";
CM_ SG_ 390 FLR_CT6_X_Velocity "X_Velocity";
CM_ SG_ 390 FLR_CT6_X_VelocityStdDev "X_VelocityStdDev";
CM_ SG_ 390 FLR_CT6_Y_Acceleration "Y_Acceleration";
CM_ SG_ 390 FLR_CT6_Y_Velocity "Y_Velocity";
CM_ SG_ 390 FLR_CT6_Y_VelocityStdDev "Y_VelocityStdDev";
CM_ BO_ 391 "[P] Periodic";
CM_ SG_ 391 FLR_CT7_CrcVal "CyclicRedundancyCheckValue";
CM_ SG_ 391 FLR_CT7_AlvCntVal "AliveCounter";
CM_ SG_ 391 FLR_CT7_ListIndex "TrackListIndex";
CM_ SG_ 391 FLR_CT7_SequenceCounter "SequenceCounter";
CM_ SG_ 391 FLR_CT7_TimeStamp "TimeStamp";
CM_ SG_ 391 FLR_CT7_Latency "Sensor latency";
CM_ SG_ 391 FLR_CT7_ClosestPointX "ClosestPointX";
CM_ SG_ 391 FLR_CT7_ClosestPointXStdDev "ClosestPointXStdDev";
CM_ SG_ 391 FLR_CT7_ClosestPointY "ClosestPointY";
CM_ SG_ 391 FLR_CT7_ClosestPointYStdDev "ClosestPointYStdDev";
CM_ SG_ 391 FLR_CT7_Confidence "Confidence";
CM_ SG_ 391 FLR_CT7_Elevation "Elevation";
CM_ SG_ 391 FLR_CT7_ElevationConfidence "ElevationConfidence";
CM_ SG_ 391 FLR_CT7_ExistanceProbability "ExistanceProbability";
CM_ SG_ 391 FLR_CT7_Lifetime "Lifetime";
CM_ SG_ 391 FLR_CT7_ModelBoxHeading "ModelBoxHeading";
CM_ SG_ 391 FLR_CT7_ModelBoxLength "ModelBoxLength";
CM_ SG_ 391 FLR_CT7_ModelBoxWidth "ModelBoxWidth";
CM_ SG_ 391 FLR_CT7_ModelBoxX "ModelBoxX";
CM_ SG_ 391 FLR_CT7_ModelBoxY "ModelBoxY";
CM_ SG_ 391 FLR_CT7_MotionClass "MotionClass";
CM_ SG_ 391 FLR_CT7_ObjectId "ObjectId";
CM_ SG_ 391 FLR_CT7_ObservationHistory "ObservationHistory";
CM_ SG_ 391 FLR_CT7_QualityBits "QualityBits";
CM_ SG_ 391 FLR_CT7_StationaryCounter "StationaryCounter";
CM_ SG_ 391 FLR_CT7_Type "Type";
CM_ SG_ 391 FLR_CT7_X_Acceleration "X_Acceleration";
CM_ SG_ 391 FLR_CT7_X_Velocity "X_Velocity";
CM_ SG_ 391 FLR_CT7_X_VelocityStdDev "X_VelocityStdDev";
CM_ SG_ 391 FLR_CT7_Y_Acceleration "Y_Acceleration";
CM_ SG_ 391 FLR_CT7_Y_Velocity "Y_Velocity";
CM_ SG_ 391 FLR_CT7_Y_VelocityStdDev "Y_VelocityStdDev";
CM_ BO_ 392 "[P] Periodic";
CM_ SG_ 392 FLR_CT8_CrcVal "CyclicRedundancyCheckValue";
CM_ SG_ 392 FLR_CT8_AlvCntVal "AliveCounter";
CM_ SG_ 392 FLR_CT8_ListIndex "TrackListIndex";
CM_ SG_ 392 FLR_CT8_SequenceCounter "SequenceCounter";
CM_ SG_ 392 FLR_CT8_TimeStamp "TimeStamp";
CM_ SG_ 392 FLR_CT8_Latency "Sensor latency";
CM_ SG_ 392 FLR_CT8_ClosestPointX "ClosestPointX";
CM_ SG_ 392 FLR_CT8_ClosestPointXStdDev "ClosestPointXStdDev";
CM_ SG_ 392 FLR_CT8_ClosestPointY "ClosestPointY";
CM_ SG_ 392 FLR_CT8_ClosestPointYStdDev "ClosestPointYStdDev";
CM_ SG_ 392 FLR_CT8_Confidence "Confidence";
CM_ SG_ 392 FLR_CT8_Elevation "Elevation";
CM_ SG_ 392 FLR_CT8_ElevationConfidence "ElevationConfidence";
CM_ SG_ 392 FLR_CT8_ExistanceProbability "ExistanceProbability";
CM_ SG_ 392 FLR_CT8_Lifetime "Lifetime";
CM_ SG_ 392 FLR_CT8_ModelBoxHeading "ModelBoxHeading";
CM_ SG_ 392 FLR_CT8_ModelBoxLength "ModelBoxLength";
CM_ SG_ 392 FLR_CT8_ModelBoxWidth "ModelBoxWidth";
CM_ SG_ 392 FLR_CT8_ModelBoxX "ModelBoxX";
CM_ SG_ 392 FLR_CT8_ModelBoxY "ModelBoxY";
CM_ SG_ 392 FLR_CT8_MotionClass "MotionClass";
CM_ SG_ 392 FLR_CT8_ObjectId "ObjectId";
CM_ SG_ 392 FLR_CT8_ObservationHistory "ObservationHistory";
CM_ SG_ 392 FLR_CT8_QualityBits "QualityBits";
CM_ SG_ 392 FLR_CT8_StationaryCounter "StationaryCounter";
CM_ SG_ 392 FLR_CT8_Type "Type";
CM_ SG_ 392 FLR_CT8_X_Acceleration "X_Acceleration";
CM_ SG_ 392 FLR_CT8_X_Velocity "X_Velocity";
CM_ SG_ 392 FLR_CT8_X_VelocityStdDev "X_VelocityStdDev";
CM_ SG_ 392 FLR_CT8_Y_Acceleration "Y_Acceleration";
CM_ SG_ 392 FLR_CT8_Y_Velocity "Y_Velocity";
CM_ SG_ 392 FLR_CT8_Y_VelocityStdDev "Y_VelocityStdDev";
CM_ BO_ 393 "[P] Periodic";
CM_ SG_ 393 FLR_CT9_CrcVal "CyclicRedundancyCheckValue";
CM_ SG_ 393 FLR_CT9_AlvCntVal "AliveCounter";
CM_ SG_ 393 FLR_CT9_ListIndex "TrackListIndex";
CM_ SG_ 393 FLR_CT9_SequenceCounter "SequenceCounter";
CM_ SG_ 393 FLR_CT9_TimeStamp "TimeStamp";
CM_ SG_ 393 FLR_CT9_Latency "Sensor latency";
CM_ SG_ 393 FLR_CT9_ClosestPointX "ClosestPointX";
CM_ SG_ 393 FLR_CT9_ClosestPointXStdDev "ClosestPointXStdDev";
CM_ SG_ 393 FLR_CT9_ClosestPointY "ClosestPointY";
CM_ SG_ 393 FLR_CT9_ClosestPointYStdDev "ClosestPointYStdDev";
CM_ SG_ 393 FLR_CT9_Confidence "Confidence";
CM_ SG_ 393 FLR_CT9_Elevation "Elevation";
CM_ SG_ 393 FLR_CT9_ElevationConfidence "ElevationConfidence";
CM_ SG_ 393 FLR_CT9_ExistanceProbability "ExistanceProbability";
CM_ SG_ 393 FLR_CT9_Lifetime "Lifetime";
CM_ SG_ 393 FLR_CT9_ModelBoxHeading "ModelBoxHeading";
CM_ SG_ 393 FLR_CT9_ModelBoxLength "ModelBoxLength";
CM_ SG_ 393 FLR_CT9_ModelBoxWidth "ModelBoxWidth";
CM_ SG_ 393 FLR_CT9_ModelBoxX "ModelBoxX";
CM_ SG_ 393 FLR_CT9_ModelBoxY "ModelBoxY";
CM_ SG_ 393 FLR_CT9_MotionClass "MotionClass";
CM_ SG_ 393 FLR_CT9_ObjectId "ObjectId";
CM_ SG_ 393 FLR_CT9_ObservationHistory "ObservationHistory";
CM_ SG_ 393 FLR_CT9_QualityBits "QualityBits";
CM_ SG_ 393 FLR_CT9_StationaryCounter "StationaryCounter";
CM_ SG_ 393 FLR_CT9_Type "Type";
CM_ SG_ 393 FLR_CT9_X_Acceleration "X_Acceleration";
CM_ SG_ 393 FLR_CT9_X_Velocity "X_Velocity";
CM_ SG_ 393 FLR_CT9_X_VelocityStdDev "X_VelocityStdDev";
CM_ SG_ 393 FLR_CT9_Y_Acceleration "Y_Acceleration";
CM_ SG_ 393 FLR_CT9_Y_Velocity "Y_Velocity";
CM_ SG_ 393 FLR_CT9_Y_VelocityStdDev "Y_VelocityStdDev";
CM_ BO_ 394 "[P] Periodic";
CM_ SG_ 394 FLR_CT10_CrcVal "CyclicRedundancyCheckValue";
CM_ SG_ 394 FLR_CT10_AlvCntVal "AliveCounter";
CM_ SG_ 394 FLR_CT10_ListIndex "TrackListIndex";
CM_ SG_ 394 FLR_CT10_SequenceCounter "SequenceCounter";
CM_ SG_ 394 FLR_CT10_TimeStamp "TimeStamp";
CM_ SG_ 394 FLR_CT10_Latency "Sensor latency";
CM_ SG_ 394 FLR_CT10_ClosestPointX "ClosestPointX";
CM_ SG_ 394 FLR_CT10_ClosestPointXStdDev "ClosestPointXStdDev";
CM_ SG_ 394 FLR_CT10_ClosestPointY "ClosestPointY";
CM_ SG_ 394 FLR_CT10_ClosestPointYStdDev "ClosestPointYStdDev";
CM_ SG_ 394 FLR_CT10_Confidence "Confidence";
CM_ SG_ 394 FLR_CT10_Elevation "Elevation";
CM_ SG_ 394 FLR_CT10_ElevationConfidence "ElevationConfidence";
CM_ SG_ 394 FLR_CT10_ExistanceProbability "ExistanceProbability";
CM_ SG_ 394 FLR_CT10_Lifetime "Lifetime";
CM_ SG_ 394 FLR_CT10_ModelBoxHeading "ModelBoxHeading";
CM_ SG_ 394 FLR_CT10_ModelBoxLength "ModelBoxLength";
CM_ SG_ 394 FLR_CT10_ModelBoxWidth "ModelBoxWidth";
CM_ SG_ 394 FLR_CT10_ModelBoxX "ModelBoxX";
CM_ SG_ 394 FLR_CT10_ModelBoxY "ModelBoxY";
CM_ SG_ 394 FLR_CT10_MotionClass "MotionClass";
CM_ SG_ 394 FLR_CT10_ObjectId "ObjectId";
CM_ SG_ 394 FLR_CT10_ObservationHistory "ObservationHistory";
CM_ SG_ 394 FLR_CT10_QualityBits "QualityBits";
CM_ SG_ 394 FLR_CT10_StationaryCounter "StationaryCounter";
CM_ SG_ 394 FLR_CT10_Type "Type";
CM_ SG_ 394 FLR_CT10_X_Acceleration "X_Acceleration";
CM_ SG_ 394 FLR_CT10_X_Velocity "X_Velocity";
CM_ SG_ 394 FLR_CT10_X_VelocityStdDev "X_VelocityStdDev";
CM_ SG_ 394 FLR_CT10_Y_Acceleration "Y_Acceleration";
CM_ SG_ 394 FLR_CT10_Y_Velocity "Y_Velocity";
CM_ SG_ 394 FLR_CT10_Y_VelocityStdDev "Y_VelocityStdDev";
CM_ BO_ 395 "[P] Periodic";
CM_ SG_ 395 FLR_CT11_CrcVal "CyclicRedundancyCheckValue";
CM_ SG_ 395 FLR_CT11_AlvCntVal "AliveCounter";
CM_ SG_ 395 FLR_CT11_ListIndex "TrackListIndex";
CM_ SG_ 395 FLR_CT11_SequenceCounter "SequenceCounter";
CM_ SG_ 395 FLR_CT11_TimeStamp "TimeStamp";
CM_ SG_ 395 FLR_CT11_Latency "Sensor latency";
CM_ SG_ 395 FLR_CT11_ClosestPointX "ClosestPointX";
CM_ SG_ 395 FLR_CT11_ClosestPointXStdDev "ClosestPointXStdDev";
CM_ SG_ 395 FLR_CT11_ClosestPointY "ClosestPointY";
CM_ SG_ 395 FLR_CT11_ClosestPointYStdDev "ClosestPointYStdDev";
CM_ SG_ 395 FLR_CT11_Confidence "Confidence";
CM_ SG_ 395 FLR_CT11_Elevation "Elevation";
CM_ SG_ 395 FLR_CT11_ElevationConfidence "ElevationConfidence";
CM_ SG_ 395 FLR_CT11_ExistanceProbability "ExistanceProbability";
CM_ SG_ 395 FLR_CT11_Lifetime "Lifetime";
CM_ SG_ 395 FLR_CT11_ModelBoxHeading "ModelBoxHeading";
CM_ SG_ 395 FLR_CT11_ModelBoxLength "ModelBoxLength";
CM_ SG_ 395 FLR_CT11_ModelBoxWidth "ModelBoxWidth";
CM_ SG_ 395 FLR_CT11_ModelBoxX "ModelBoxX";
CM_ SG_ 395 FLR_CT11_ModelBoxY "ModelBoxY";
CM_ SG_ 395 FLR_CT11_MotionClass "MotionClass";
CM_ SG_ 395 FLR_CT11_ObjectId "ObjectId";
CM_ SG_ 395 FLR_CT11_ObservationHistory "ObservationHistory";
CM_ SG_ 395 FLR_CT11_QualityBits "QualityBits";
CM_ SG_ 395 FLR_CT11_StationaryCounter "StationaryCounter";
CM_ SG_ 395 FLR_CT11_Type "Type";
CM_ SG_ 395 FLR_CT11_X_Acceleration "X_Acceleration";
CM_ SG_ 395 FLR_CT11_X_Velocity "X_Velocity";
CM_ SG_ 395 FLR_CT11_X_VelocityStdDev "X_VelocityStdDev";
CM_ SG_ 395 FLR_CT11_Y_Acceleration "Y_Acceleration";
CM_ SG_ 395 FLR_CT11_Y_Velocity "Y_Velocity";
CM_ SG_ 395 FLR_CT11_Y_VelocityStdDev "Y_VelocityStdDev";
CM_ BO_ 396 "[P] Periodic";
CM_ SG_ 396 FLR_CT12_CrcVal "CyclicRedundancyCheckValue";
CM_ SG_ 396 FLR_CT12_AlvCntVal "AliveCounter";
CM_ SG_ 396 FLR_CT12_ListIndex "TrackListIndex";
CM_ SG_ 396 FLR_CT12_SequenceCounter "SequenceCounter";
CM_ SG_ 396 FLR_CT12_TimeStamp "TimeStamp";
CM_ SG_ 396 FLR_CT12_Latency "Sensor latency";
CM_ SG_ 396 FLR_CT12_ClosestPointX "ClosestPointX";
CM_ SG_ 396 FLR_CT12_ClosestPointXStdDev "ClosestPointXStdDev";
CM_ SG_ 396 FLR_CT12_ClosestPointY "ClosestPointY";
CM_ SG_ 396 FLR_CT12_ClosestPointYStdDev "ClosestPointYStdDev";
CM_ SG_ 396 FLR_CT12_Confidence "Confidence";
CM_ SG_ 396 FLR_CT12_Elevation "Elevation";
CM_ SG_ 396 FLR_CT12_ElevationConfidence "ElevationConfidence";
CM_ SG_ 396 FLR_CT12_ExistanceProbability "ExistanceProbability";
CM_ SG_ 396 FLR_CT12_Lifetime "Lifetime";
CM_ SG_ 396 FLR_CT12_ModelBoxHeading "ModelBoxHeading";
CM_ SG_ 396 FLR_CT12_ModelBoxLength "ModelBoxLength";
CM_ SG_ 396 FLR_CT12_ModelBoxWidth "ModelBoxWidth";
CM_ SG_ 396 FLR_CT12_ModelBoxX "ModelBoxX";
CM_ SG_ 396 FLR_CT12_ModelBoxY "ModelBoxY";
CM_ SG_ 396 FLR_CT12_MotionClass "MotionClass";
CM_ SG_ 396 FLR_CT12_ObjectId "ObjectId";
CM_ SG_ 396 FLR_CT12_ObservationHistory "ObservationHistory";
CM_ SG_ 396 FLR_CT12_QualityBits "QualityBits";
CM_ SG_ 396 FLR_CT12_StationaryCounter "StationaryCounter";
CM_ SG_ 396 FLR_CT12_Type "Type";
CM_ SG_ 396 FLR_CT12_X_Acceleration "X_Acceleration";
CM_ SG_ 396 FLR_CT12_X_Velocity "X_Velocity";
CM_ SG_ 396 FLR_CT12_X_VelocityStdDev "X_VelocityStdDev";
CM_ SG_ 396 FLR_CT12_Y_Acceleration "Y_Acceleration";
CM_ SG_ 396 FLR_CT12_Y_Velocity "Y_Velocity";
CM_ SG_ 396 FLR_CT12_Y_VelocityStdDev "Y_VelocityStdDev";
CM_ BO_ 397 "[P] Periodic";
CM_ SG_ 397 FLR_CT13_CrcVal "CyclicRedundancyCheckValue";
CM_ SG_ 397 FLR_CT13_AlvCntVal "AliveCounter";
CM_ SG_ 397 FLR_CT13_ListIndex "TrackListIndex";
CM_ SG_ 397 FLR_CT13_SequenceCounter "SequenceCounter";
CM_ SG_ 397 FLR_CT13_TimeStamp "TimeStamp";
CM_ SG_ 397 FLR_CT13_Latency "Sensor latency";
CM_ SG_ 397 FLR_CT13_ClosestPointX "ClosestPointX";
CM_ SG_ 397 FLR_CT13_ClosestPointXStdDev "ClosestPointXStdDev";
CM_ SG_ 397 FLR_CT13_ClosestPointY "ClosestPointY";
CM_ SG_ 397 FLR_CT13_ClosestPointYStdDev "ClosestPointYStdDev";
CM_ SG_ 397 FLR_CT13_Confidence "Confidence";
CM_ SG_ 397 FLR_CT13_Elevation "Elevation";
CM_ SG_ 397 FLR_CT13_ElevationConfidence "ElevationConfidence";
CM_ SG_ 397 FLR_CT13_ExistanceProbability "ExistanceProbability";
CM_ SG_ 397 FLR_CT13_Lifetime "Lifetime";
CM_ SG_ 397 FLR_CT13_ModelBoxHeading "ModelBoxHeading";
CM_ SG_ 397 FLR_CT13_ModelBoxLength "ModelBoxLength";
CM_ SG_ 397 FLR_CT13_ModelBoxWidth "ModelBoxWidth";
CM_ SG_ 397 FLR_CT13_ModelBoxX "ModelBoxX";
CM_ SG_ 397 FLR_CT13_ModelBoxY "ModelBoxY";
CM_ SG_ 397 FLR_CT13_MotionClass "MotionClass";
CM_ SG_ 397 FLR_CT13_ObjectId "ObjectId";
CM_ SG_ 397 FLR_CT13_ObservationHistory "ObservationHistory";
CM_ SG_ 397 FLR_CT13_QualityBits "QualityBits";
CM_ SG_ 397 FLR_CT13_StationaryCounter "StationaryCounter";
CM_ SG_ 397 FLR_CT13_Type "Type";
CM_ SG_ 397 FLR_CT13_X_Acceleration "X_Acceleration";
CM_ SG_ 397 FLR_CT13_X_Velocity "X_Velocity";
CM_ SG_ 397 FLR_CT13_X_VelocityStdDev "X_VelocityStdDev";
CM_ SG_ 397 FLR_CT13_Y_Acceleration "Y_Acceleration";
CM_ SG_ 397 FLR_CT13_Y_Velocity "Y_Velocity";
CM_ SG_ 397 FLR_CT13_Y_VelocityStdDev "Y_VelocityStdDev";
CM_ BO_ 398 "[P] Periodic";
CM_ SG_ 398 FLR_CT14_CrcVal "CyclicRedundancyCheckValue";
CM_ SG_ 398 FLR_CT14_AlvCntVal "AliveCounter";
CM_ SG_ 398 FLR_CT14_ListIndex "TrackListIndex";
CM_ SG_ 398 FLR_CT14_SequenceCounter "SequenceCounter";
CM_ SG_ 398 FLR_CT14_TimeStamp "TimeStamp";
CM_ SG_ 398 FLR_CT14_Latency "Sensor latency";
CM_ SG_ 398 FLR_CT14_ClosestPointX "ClosestPointX";
CM_ SG_ 398 FLR_CT14_ClosestPointXStdDev "ClosestPointXStdDev";
CM_ SG_ 398 FLR_CT14_ClosestPointY "ClosestPointY";
CM_ SG_ 398 FLR_CT14_ClosestPointYStdDev "ClosestPointYStdDev";
CM_ SG_ 398 FLR_CT14_Confidence "Confidence";
CM_ SG_ 398 FLR_CT14_Elevation "Elevation";
CM_ SG_ 398 FLR_CT14_ElevationConfidence "ElevationConfidence";
CM_ SG_ 398 FLR_CT14_ExistanceProbability "ExistanceProbability";
CM_ SG_ 398 FLR_CT14_Lifetime "Lifetime";
CM_ SG_ 398 FLR_CT14_ModelBoxHeading "ModelBoxHeading";
CM_ SG_ 398 FLR_CT14_ModelBoxLength "ModelBoxLength";
CM_ SG_ 398 FLR_CT14_ModelBoxWidth "ModelBoxWidth";
CM_ SG_ 398 FLR_CT14_ModelBoxX "ModelBoxX";
CM_ SG_ 398 FLR_CT14_ModelBoxY "ModelBoxY";
CM_ SG_ 398 FLR_CT14_MotionClass "MotionClass";
CM_ SG_ 398 FLR_CT14_ObjectId "ObjectId";
CM_ SG_ 398 FLR_CT14_ObservationHistory "ObservationHistory";
CM_ SG_ 398 FLR_CT14_QualityBits "QualityBits";
CM_ SG_ 398 FLR_CT14_StationaryCounter "StationaryCounter";
CM_ SG_ 398 FLR_CT14_Type "Type";
CM_ SG_ 398 FLR_CT14_X_Acceleration "X_Acceleration";
CM_ SG_ 398 FLR_CT14_X_Velocity "X_Velocity";
CM_ SG_ 398 FLR_CT14_X_VelocityStdDev "X_VelocityStdDev";
CM_ SG_ 398 FLR_CT14_Y_Acceleration "Y_Acceleration";
CM_ SG_ 398 FLR_CT14_Y_Velocity "Y_Velocity";
CM_ SG_ 398 FLR_CT14_Y_VelocityStdDev "Y_VelocityStdDev";
CM_ BO_ 399 "[P] Periodic";
CM_ SG_ 399 FLR_CT15_CrcVal "CyclicRedundancyCheckValue";
CM_ SG_ 399 FLR_CT15_AlvCntVal "AliveCounter";
CM_ SG_ 399 FLR_CT15_ListIndex "TrackListIndex";
CM_ SG_ 399 FLR_CT15_SequenceCounter "SequenceCounter";
CM_ SG_ 399 FLR_CT15_TimeStamp "TimeStamp";
CM_ SG_ 399 FLR_CT15_Latency "Sensor latency";
CM_ SG_ 399 FLR_CT15_ClosestPointX "ClosestPointX";
CM_ SG_ 399 FLR_CT15_ClosestPointXStdDev "ClosestPointXStdDev";
CM_ SG_ 399 FLR_CT15_ClosestPointY "ClosestPointY";
CM_ SG_ 399 FLR_CT15_ClosestPointYStdDev "ClosestPointYStdDev";
CM_ SG_ 399 FLR_CT15_Confidence "Confidence";
CM_ SG_ 399 FLR_CT15_Elevation "Elevation";
CM_ SG_ 399 FLR_CT15_ElevationConfidence "ElevationConfidence";
CM_ SG_ 399 FLR_CT15_ExistanceProbability "ExistanceProbability";
CM_ SG_ 399 FLR_CT15_Lifetime "Lifetime";
CM_ SG_ 399 FLR_CT15_ModelBoxHeading "ModelBoxHeading";
CM_ SG_ 399 FLR_CT15_ModelBoxLength "ModelBoxLength";
CM_ SG_ 399 FLR_CT15_ModelBoxWidth "ModelBoxWidth";
CM_ SG_ 399 FLR_CT15_ModelBoxX "ModelBoxX";
CM_ SG_ 399 FLR_CT15_ModelBoxY "ModelBoxY";
CM_ SG_ 399 FLR_CT15_MotionClass "MotionClass";
CM_ SG_ 399 FLR_CT15_ObjectId "ObjectId";
CM_ SG_ 399 FLR_CT15_ObservationHistory "ObservationHistory";
CM_ SG_ 399 FLR_CT15_QualityBits "QualityBits";
CM_ SG_ 399 FLR_CT15_StationaryCounter "StationaryCounter";
CM_ SG_ 399 FLR_CT15_Type "Type";
CM_ SG_ 399 FLR_CT15_X_Acceleration "X_Acceleration";
CM_ SG_ 399 FLR_CT15_X_Velocity "X_Velocity";
CM_ SG_ 399 FLR_CT15_X_VelocityStdDev "X_VelocityStdDev";
CM_ SG_ 399 FLR_CT15_Y_Acceleration "Y_Acceleration";
CM_ SG_ 399 FLR_CT15_Y_Velocity "Y_Velocity";
CM_ SG_ 399 FLR_CT15_Y_VelocityStdDev "Y_VelocityStdDev";
BA_DEF_ BO_  "GenMsgILSupport" ENUM  "No","Yes","vector_leerstring";
BA_DEF_ BO_  "DiagState" ENUM  "No","Yes","vector_leerstring";
BA_DEF_ BO_  "DiagRequest" ENUM  "No","Yes","vector_leerstring";
BA_DEF_ BO_  "VFrameFormat" ENUM  "StandardCAN","ExtendedCAN","reserved","reserved","reserved","reserved","reserved","reserved","reserved","reserved","reserved","reserved","reserved","reserved","StandardCAN_FD","ExtendedCAN_FD";
BA_DEF_ BO_  "GenMsgSendType" ENUM  "Cyclic","NoMsgSendType";
BA_DEF_ SG_  "UserSigValidity" ENUM  "B+","ACC","IG","IG1","IG2","IG3","IG1 or IG2","IG1 or IG3","Undef";
BA_DEF_ SG_  "RoutingFactor" INT 1 1215752192;
BA_DEF_ SG_  "Description" STRING ;
BA_DEF_ SG_  "Version" STRING ;
BA_DEF_ BO_  "GenMsgCycleTime" INT 0 2000;
BA_DEF_ BO_  "GenMsgStartDelayTime" INT 0 2000;
BA_DEF_ SG_  "UsrSigPurpose" ENUM  "Undef","FN","DIAG","DEV","NM";
BA_DEF_ SG_  "GenSigStartValue" INT 0 0;
BA_DEF_DEF_  "GenMsgILSupport" "Yes";
BA_DEF_DEF_  "DiagState" "No";
BA_DEF_DEF_  "DiagRequest" "No";
BA_DEF_DEF_  "VFrameFormat" "";
BA_DEF_DEF_  "GenMsgSendType" "NoMsgSendType";
BA_DEF_DEF_  "UserSigValidity" "IG";
BA_DEF_DEF_  "RoutingFactor" 1;
BA_DEF_DEF_  "Description" "";
BA_DEF_DEF_  "Version" "";
BA_DEF_DEF_  "GenMsgCycleTime" 0;
BA_DEF_DEF_  "GenMsgStartDelayTime" 0;
BA_DEF_DEF_  "UsrSigPurpose" "FN";
BA_DEF_DEF_  "GenSigStartValue" 0;
BA_ "GenMsgSendType" BO_ 384 0;
BA_ "GenMsgCycleTime" BO_ 384 50;
BA_ "VFrameFormat" BO_ 384 14;
BA_ "GenMsgSendType" BO_ 385 0;
BA_ "GenMsgCycleTime" BO_ 385 50;
BA_ "VFrameFormat" BO_ 385 14;
BA_ "GenMsgSendType" BO_ 386 0;
BA_ "GenMsgCycleTime" BO_ 386 50;
BA_ "VFrameFormat" BO_ 386 14;
BA_ "GenMsgSendType" BO_ 387 0;
BA_ "GenMsgCycleTime" BO_ 387 50;
BA_ "VFrameFormat" BO_ 387 14;
BA_ "GenMsgSendType" BO_ 388 0;
BA_ "GenMsgCycleTime" BO_ 388 50;
BA_ "VFrameFormat" BO_ 388 14;
BA_ "GenMsgSendType" BO_ 389 0;
BA_ "GenMsgCycleTime" BO_ 389 50;
BA_ "VFrameFormat" BO_ 389 14;
BA_ "GenMsgSendType" BO_ 390 0;
BA_ "GenMsgCycleTime" BO_ 390 50;
BA_ "VFrameFormat" BO_ 390 14;
BA_ "GenMsgSendType" BO_ 391 0;
BA_ "GenMsgCycleTime" BO_ 391 50;
BA_ "VFrameFormat" BO_ 391 14;
BA_ "GenMsgSendType" BO_ 392 0;
BA_ "GenMsgCycleTime" BO_ 392 50;
BA_ "VFrameFormat" BO_ 392 14;
BA_ "GenMsgSendType" BO_ 393 0;
BA_ "GenMsgCycleTime" BO_ 393 50;
BA_ "VFrameFormat" BO_ 393 14;
BA_ "GenMsgSendType" BO_ 394 0;
BA_ "GenMsgCycleTime" BO_ 394 50;
BA_ "VFrameFormat" BO_ 394 14;
BA_ "GenMsgSendType" BO_ 395 0;
BA_ "GenMsgCycleTime" BO_ 395 50;
BA_ "VFrameFormat" BO_ 395 14;
BA_ "GenMsgSendType" BO_ 396 0;
BA_ "GenMsgCycleTime" BO_ 396 50;
BA_ "VFrameFormat" BO_ 396 14;
BA_ "GenMsgSendType" BO_ 397 0;
BA_ "GenMsgCycleTime" BO_ 397 50;
BA_ "VFrameFormat" BO_ 397 14;
BA_ "GenMsgSendType" BO_ 398 0;
BA_ "GenMsgCycleTime" BO_ 398 50;
BA_ "VFrameFormat" BO_ 398 14;
BA_ "GenMsgSendType" BO_ 399 0;
BA_ "GenMsgCycleTime" BO_ 399 50;
BA_ "VFrameFormat" BO_ 399 14;
BA_ "Description" SG_ 384 FLR_CT0_CrcVal "The CRC checking process calculates the CRC over the entire data block, including the CRC result.

- CRC Polynomial (0x1021) , Initial Value : 0xFFFF, XOR value : 0x0000

- The mathematical expression to 16 bit CRC polynomial is given here. G(x) = x16 + ";
BA_ "GenSigStartValue" SG_ 384 FLR_CT0_CrcVal 65535;
BA_ "UserSigValidity" SG_ 384 FLR_CT0_CrcVal 3;
BA_ "Description" SG_ 384 FLR_CT0_AlvCntVal "[Alive counter] For the first transmission request for a data element the counter shall be initialized with 0 and shall be incremented by 1

for every subsequent send request. When the counter reaches the maximum value(0xFF), then it shall restart with â";
BA_ "UserSigValidity" SG_ 384 FLR_CT0_AlvCntVal 3;
BA_ "Description" SG_ 384 FLR_CT0_ListIndex "List index of cluster track";
BA_ "UserSigValidity" SG_ 384 FLR_CT0_ListIndex 3;
BA_ "Description" SG_ 384 FLR_CT0_SequenceCounter "[TimeSync]Sequence counter for checking the validity of message flow sequence";
BA_ "UserSigValidity" SG_ 384 FLR_CT0_SequenceCounter 3;
BA_ "Description" SG_ 384 FLR_CT0_TimeStamp "[TimeSync]System time, synchronized through AUTOSAR TimeSync";
BA_ "UserSigValidity" SG_ 384 FLR_CT0_TimeStamp 3;
BA_ "Description" SG_ 384 FLR_CT0_Latency "[TimeSync]Sensor latency from object capture scene to object transmission";
BA_ "UserSigValidity" SG_ 384 FLR_CT0_Latency 3;
BA_ "Description" SG_ 384 FLR_CT0_ClosestPointX "Kalman filtered closest point

X position ";
BA_ "UserSigValidity" SG_ 384 FLR_CT0_ClosestPointX 3;
BA_ "Description" SG_ 384 FLR_CT0_ClosestPointXStdDev "Standard deviation of X";
BA_ "UserSigValidity" SG_ 384 FLR_CT0_ClosestPointXStdDev 3;
BA_ "Description" SG_ 384 FLR_CT0_ClosestPointY "Kalman filtered closest point

Y position ";
BA_ "UserSigValidity" SG_ 384 FLR_CT0_ClosestPointY 3;
BA_ "Description" SG_ 384 FLR_CT0_ClosestPointYStdDev "Standard deviation of Y";
BA_ "UserSigValidity" SG_ 384 FLR_CT0_ClosestPointYStdDev 3;
BA_ "Description" SG_ 384 FLR_CT0_Confidence "Object confidence used in quality manager to provide 'Objektgate' (i.e. object quality) tracked object confidence is calculated based on the normalized difference of closest detection to the track's calculated closest point, for range, angle and velocity";
BA_ "UserSigValidity" SG_ 384 FLR_CT0_Confidence 3;
BA_ "Description" SG_ 384 FLR_CT0_Elevation "Elevation of the object";
BA_ "UserSigValidity" SG_ 384 FLR_CT0_Elevation 3;
BA_ "Description" SG_ 384 FLR_CT0_ElevationConfidence "Confidence the elevation classification is correct";
BA_ "UserSigValidity" SG_ 384 FLR_CT0_ElevationConfidence 3;
BA_ "Description" SG_ 384 FLR_CT0_ExistanceProbability "Confidence tracked object existence. Currently set to the association rate [0..100] over the last 6 cycles";
BA_ "UserSigValidity" SG_ 384 FLR_CT0_ExistanceProbability 3;
BA_ "Description" SG_ 384 FLR_CT0_Lifetime "Number of cycles the target has been alive. Unknown 0

Tops out at about 6 minutes of continuous tracking.";
BA_ "UserSigValidity" SG_ 384 FLR_CT0_Lifetime 3;
BA_ "Description" SG_ 384 FLR_CT0_ModelBoxHeading "Heading of object

( Box model describing the object )";
BA_ "UserSigValidity" SG_ 384 FLR_CT0_ModelBoxHeading 3;
BA_ "Description" SG_ 384 FLR_CT0_ModelBoxLength "Length of the object

( Box model describing the object )";
BA_ "UserSigValidity" SG_ 384 FLR_CT0_ModelBoxLength 3;
BA_ "Description" SG_ 384 FLR_CT0_ModelBoxWidth "Width of the object

( Box model describing the object )";
BA_ "UserSigValidity" SG_ 384 FLR_CT0_ModelBoxWidth 3;
BA_ "Description" SG_ 384 FLR_CT0_ModelBoxX "X position, center of box

( Box model describing the object )";
BA_ "UserSigValidity" SG_ 384 FLR_CT0_ModelBoxX 3;
BA_ "Description" SG_ 384 FLR_CT0_ModelBoxY "Y position, center of box

( Box model describing the object )";
BA_ "UserSigValidity" SG_ 384 FLR_CT0_ModelBoxY 3;
BA_ "Description" SG_ 384 FLR_CT0_MotionClass "Tracked object motion classification";
BA_ "UserSigValidity" SG_ 384 FLR_CT0_MotionClass 3;
BA_ "Description" SG_ 384 FLR_CT0_ObjectId "A global ID, which is constant as long as the object is tracked. Note! A value of 0 indicates 'no object'";
BA_ "UserSigValidity" SG_ 384 FLR_CT0_ObjectId 3;
BA_ "Description" SG_ 384 FLR_CT0_ObservationHistory "Observation history of tracked object in as 32 bit-field for the last 32 cycles; for each bit: 1 = associated, 0 = not associated; LSB = most recent cycle, MSB = oldest cycle";
BA_ "UserSigValidity" SG_ 384 FLR_CT0_ObservationHistory 3;
BA_ "Description" SG_ 384 FLR_CT0_QualityBits "Bitmask for quality values described by ClusterTrackQualityBits";
BA_ "UserSigValidity" SG_ 384 FLR_CT0_QualityBits 3;
BA_ "Description" SG_ 384 FLR_CT0_StationaryCounter "Counts the cycles during which the object is ground stationary (i.e. absolute velocity over ground = 0)";
BA_ "UserSigValidity" SG_ 384 FLR_CT0_StationaryCounter 3;
BA_ "Description" SG_ 384 FLR_CT0_Type "Tracked object type classification";
BA_ "UserSigValidity" SG_ 384 FLR_CT0_Type 3;
BA_ "Description" SG_ 384 FLR_CT0_X_Acceleration "X acceleration 

( Movement estimation of object ) ";
BA_ "UserSigValidity" SG_ 384 FLR_CT0_X_Acceleration 3;
BA_ "Description" SG_ 384 FLR_CT0_X_Velocity "Absolute X velocity

( Movement estimation of object ) ";
BA_ "UserSigValidity" SG_ 384 FLR_CT0_X_Velocity 3;
BA_ "Description" SG_ 384 FLR_CT0_X_VelocityStdDev "Standard deviation of X velocity

( Movement estimation of object ) ";
BA_ "UserSigValidity" SG_ 384 FLR_CT0_X_VelocityStdDev 3;
BA_ "Description" SG_ 384 FLR_CT0_Y_Acceleration "Y acceleration 

( Movement estimation of object ) ";
BA_ "UserSigValidity" SG_ 384 FLR_CT0_Y_Acceleration 3;
BA_ "Description" SG_ 384 FLR_CT0_Y_Velocity "Absolute Y velocity

( Movement estimation of object ) ";
BA_ "UserSigValidity" SG_ 384 FLR_CT0_Y_Velocity 3;
BA_ "Description" SG_ 384 FLR_CT0_Y_VelocityStdDev "Standard deviation of Y velocity

( Movement estimation of object ) ";
BA_ "UserSigValidity" SG_ 384 FLR_CT0_Y_VelocityStdDev 3;
BA_ "Description" SG_ 385 FLR_CT1_CrcVal "The CRC checking process calculates the CRC over the entire data block, including the CRC result.

- CRC Polynomial (0x1021) , Initial Value : 0xFFFF, XOR value : 0x0000

- The mathematical expression to 16 bit CRC polynomial is given here. G(x) = x16 + ";
BA_ "GenSigStartValue" SG_ 385 FLR_CT1_CrcVal 65535;
BA_ "UserSigValidity" SG_ 385 FLR_CT1_CrcVal 3;
BA_ "Description" SG_ 385 FLR_CT1_AlvCntVal "[Alive counter] For the first transmission request for a data element the counter shall be initialized with 0 and shall be incremented by 1

for every subsequent send request. When the counter reaches the maximum value(0xFF), then it shall restart with â";
BA_ "UserSigValidity" SG_ 385 FLR_CT1_AlvCntVal 3;
BA_ "Description" SG_ 385 FLR_CT1_ListIndex "List index of cluster track";
BA_ "UserSigValidity" SG_ 385 FLR_CT1_ListIndex 3;
BA_ "Description" SG_ 385 FLR_CT1_SequenceCounter "[TimeSync]Sequence counter for checking the validity of message flow sequence";
BA_ "UserSigValidity" SG_ 385 FLR_CT1_SequenceCounter 3;
BA_ "Description" SG_ 385 FLR_CT1_TimeStamp "[TimeSync]System time, synchronized through AUTOSAR TimeSync";
BA_ "UserSigValidity" SG_ 385 FLR_CT1_TimeStamp 3;
BA_ "Description" SG_ 385 FLR_CT1_Latency "[TimeSync]Sensor latency from object capture scene to object transmission";
BA_ "UserSigValidity" SG_ 385 FLR_CT1_Latency 3;
BA_ "Description" SG_ 385 FLR_CT1_ClosestPointX "Kalman filtered closest point

X position ";
BA_ "UserSigValidity" SG_ 385 FLR_CT1_ClosestPointX 3;
BA_ "Description" SG_ 385 FLR_CT1_ClosestPointXStdDev "Standard deviation of X";
BA_ "UserSigValidity" SG_ 385 FLR_CT1_ClosestPointXStdDev 3;
BA_ "Description" SG_ 385 FLR_CT1_ClosestPointY "Kalman filtered closest point

Y position ";
BA_ "UserSigValidity" SG_ 385 FLR_CT1_ClosestPointY 3;
BA_ "Description" SG_ 385 FLR_CT1_ClosestPointYStdDev "Standard deviation of Y";
BA_ "UserSigValidity" SG_ 385 FLR_CT1_ClosestPointYStdDev 3;
BA_ "Description" SG_ 385 FLR_CT1_Confidence "Object confidence used in quality manager to provide 'Objektgate' (i.e. object quality) tracked object confidence is calculated based on the normalized difference of closest detection to the track's calculated closest point, for range, angle and velocity";
BA_ "UserSigValidity" SG_ 385 FLR_CT1_Confidence 3;
BA_ "Description" SG_ 385 FLR_CT1_Elevation "Elevation of the object";
BA_ "UserSigValidity" SG_ 385 FLR_CT1_Elevation 3;
BA_ "Description" SG_ 385 FLR_CT1_ElevationConfidence "Confidence the elevation classification is correct";
BA_ "UserSigValidity" SG_ 385 FLR_CT1_ElevationConfidence 3;
BA_ "Description" SG_ 385 FLR_CT1_ExistanceProbability "Confidence tracked object existence. Currently set to the association rate [0..100] over the last 6 cycles";
BA_ "UserSigValidity" SG_ 385 FLR_CT1_ExistanceProbability 3;
BA_ "Description" SG_ 385 FLR_CT1_Lifetime "Number of cycles the target has been alive. Unknown 0

Tops out at about 6 minutes of continuous tracking.";
BA_ "UserSigValidity" SG_ 385 FLR_CT1_Lifetime 3;
BA_ "Description" SG_ 385 FLR_CT1_ModelBoxHeading "Heading of object

( Box model describing the object )";
BA_ "UserSigValidity" SG_ 385 FLR_CT1_ModelBoxHeading 3;
BA_ "Description" SG_ 385 FLR_CT1_ModelBoxLength "Length of the object

( Box model describing the object )";
BA_ "UserSigValidity" SG_ 385 FLR_CT1_ModelBoxLength 3;
BA_ "Description" SG_ 385 FLR_CT1_ModelBoxWidth "Width of the object

( Box model describing the object )";
BA_ "UserSigValidity" SG_ 385 FLR_CT1_ModelBoxWidth 3;
BA_ "Description" SG_ 385 FLR_CT1_ModelBoxX "X position, center of box

( Box model describing the object )";
BA_ "UserSigValidity" SG_ 385 FLR_CT1_ModelBoxX 3;
BA_ "Description" SG_ 385 FLR_CT1_ModelBoxY "Y position, center of box

( Box model describing the object )";
BA_ "UserSigValidity" SG_ 385 FLR_CT1_ModelBoxY 3;
BA_ "Description" SG_ 385 FLR_CT1_MotionClass "Tracked object motion classification";
BA_ "UserSigValidity" SG_ 385 FLR_CT1_MotionClass 3;
BA_ "Description" SG_ 385 FLR_CT1_ObjectId "A global ID, which is constant as long as the object is tracked. Note! A value of 0 indicates 'no object'";
BA_ "UserSigValidity" SG_ 385 FLR_CT1_ObjectId 3;
BA_ "Description" SG_ 385 FLR_CT1_ObservationHistory "Observation history of tracked object in as 32 bit-field for the last 32 cycles; for each bit: 1 = associated, 0 = not associated; LSB = most recent cycle, MSB = oldest cycle";
BA_ "UserSigValidity" SG_ 385 FLR_CT1_ObservationHistory 3;
BA_ "Description" SG_ 385 FLR_CT1_QualityBits "Bitmask for quality values described by ClusterTrackQualityBits";
BA_ "UserSigValidity" SG_ 385 FLR_CT1_QualityBits 3;
BA_ "Description" SG_ 385 FLR_CT1_StationaryCounter "Counts the cycles during which the object is ground stationary (i.e. absolute velocity over ground = 0)";
BA_ "UserSigValidity" SG_ 385 FLR_CT1_StationaryCounter 3;
BA_ "Description" SG_ 385 FLR_CT1_Type "Tracked object type classification";
BA_ "UserSigValidity" SG_ 385 FLR_CT1_Type 3;
BA_ "Description" SG_ 385 FLR_CT1_X_Acceleration "X acceleration 

( Movement estimation of object ) ";
BA_ "UserSigValidity" SG_ 385 FLR_CT1_X_Acceleration 3;
BA_ "Description" SG_ 385 FLR_CT1_X_Velocity "Absolute X velocity

( Movement estimation of object ) ";
BA_ "UserSigValidity" SG_ 385 FLR_CT1_X_Velocity 3;
BA_ "Description" SG_ 385 FLR_CT1_X_VelocityStdDev "Standard deviation of X velocity

( Movement estimation of object ) ";
BA_ "UserSigValidity" SG_ 385 FLR_CT1_X_VelocityStdDev 3;
BA_ "Description" SG_ 385 FLR_CT1_Y_Acceleration "Y acceleration 

( Movement estimation of object ) ";
BA_ "UserSigValidity" SG_ 385 FLR_CT1_Y_Acceleration 3;
BA_ "Description" SG_ 385 FLR_CT1_Y_Velocity "Absolute Y velocity

( Movement estimation of object ) ";
BA_ "UserSigValidity" SG_ 385 FLR_CT1_Y_Velocity 3;
BA_ "Description" SG_ 385 FLR_CT1_Y_VelocityStdDev "Standard deviation of Y velocity

( Movement estimation of object ) ";
BA_ "UserSigValidity" SG_ 385 FLR_CT1_Y_VelocityStdDev 3;
BA_ "Description" SG_ 386 FLR_CT2_CrcVal "The CRC checking process calculates the CRC over the entire data block, including the CRC result.

- CRC Polynomial (0x1021) , Initial Value : 0xFFFF, XOR value : 0x0000

- The mathematical expression to 16 bit CRC polynomial is given here. G(x) = x16 + ";
BA_ "GenSigStartValue" SG_ 386 FLR_CT2_CrcVal 65535;
BA_ "UserSigValidity" SG_ 386 FLR_CT2_CrcVal 3;
BA_ "Description" SG_ 386 FLR_CT2_AlvCntVal "[Alive counter] For the first transmission request for a data element the counter shall be initialized with 0 and shall be incremented by 1

for every subsequent send request. When the counter reaches the maximum value(0xFF), then it shall restart with â";
BA_ "UserSigValidity" SG_ 386 FLR_CT2_AlvCntVal 3;
BA_ "Description" SG_ 386 FLR_CT2_ListIndex "List index of cluster track";
BA_ "UserSigValidity" SG_ 386 FLR_CT2_ListIndex 3;
BA_ "Description" SG_ 386 FLR_CT2_SequenceCounter "[TimeSync]Sequence counter for checking the validity of message flow sequence";
BA_ "UserSigValidity" SG_ 386 FLR_CT2_SequenceCounter 3;
BA_ "Description" SG_ 386 FLR_CT2_TimeStamp "[TimeSync]System time, synchronized through AUTOSAR TimeSync";
BA_ "UserSigValidity" SG_ 386 FLR_CT2_TimeStamp 3;
BA_ "Description" SG_ 386 FLR_CT2_Latency "[TimeSync]Sensor latency from object capture scene to object transmission";
BA_ "UserSigValidity" SG_ 386 FLR_CT2_Latency 3;
BA_ "Description" SG_ 386 FLR_CT2_ClosestPointX "Kalman filtered closest point

X position ";
BA_ "UserSigValidity" SG_ 386 FLR_CT2_ClosestPointX 3;
BA_ "Description" SG_ 386 FLR_CT2_ClosestPointXStdDev "Standard deviation of X";
BA_ "UserSigValidity" SG_ 386 FLR_CT2_ClosestPointXStdDev 3;
BA_ "Description" SG_ 386 FLR_CT2_ClosestPointY "Kalman filtered closest point

Y position ";
BA_ "UserSigValidity" SG_ 386 FLR_CT2_ClosestPointY 3;
BA_ "Description" SG_ 386 FLR_CT2_ClosestPointYStdDev "Standard deviation of Y";
BA_ "UserSigValidity" SG_ 386 FLR_CT2_ClosestPointYStdDev 3;
BA_ "Description" SG_ 386 FLR_CT2_Confidence "Object confidence used in quality manager to provide 'Objektgate' (i.e. object quality) tracked object confidence is calculated based on the normalized difference of closest detection to the track's calculated closest point, for range, angle and velocity";
BA_ "UserSigValidity" SG_ 386 FLR_CT2_Confidence 3;
BA_ "Description" SG_ 386 FLR_CT2_Elevation "Elevation of the object";
BA_ "UserSigValidity" SG_ 386 FLR_CT2_Elevation 3;
BA_ "Description" SG_ 386 FLR_CT2_ElevationConfidence "Confidence the elevation classification is correct";
BA_ "UserSigValidity" SG_ 386 FLR_CT2_ElevationConfidence 3;
BA_ "Description" SG_ 386 FLR_CT2_ExistanceProbability "Confidence tracked object existence. Currently set to the association rate [0..100] over the last 6 cycles";
BA_ "UserSigValidity" SG_ 386 FLR_CT2_ExistanceProbability 3;
BA_ "Description" SG_ 386 FLR_CT2_Lifetime "Number of cycles the target has been alive. Unknown 0

Tops out at about 6 minutes of continuous tracking.";
BA_ "UserSigValidity" SG_ 386 FLR_CT2_Lifetime 3;
BA_ "Description" SG_ 386 FLR_CT2_ModelBoxHeading "Heading of object

( Box model describing the object )";
BA_ "UserSigValidity" SG_ 386 FLR_CT2_ModelBoxHeading 3;
BA_ "Description" SG_ 386 FLR_CT2_ModelBoxLength "Length of the object

( Box model describing the object )";
BA_ "UserSigValidity" SG_ 386 FLR_CT2_ModelBoxLength 3;
BA_ "Description" SG_ 386 FLR_CT2_ModelBoxWidth "Width of the object

( Box model describing the object )";
BA_ "UserSigValidity" SG_ 386 FLR_CT2_ModelBoxWidth 3;
BA_ "Description" SG_ 386 FLR_CT2_ModelBoxX "X position, center of box

( Box model describing the object )";
BA_ "UserSigValidity" SG_ 386 FLR_CT2_ModelBoxX 3;
BA_ "Description" SG_ 386 FLR_CT2_ModelBoxY "Y position, center of box

( Box model describing the object )";
BA_ "UserSigValidity" SG_ 386 FLR_CT2_ModelBoxY 3;
BA_ "Description" SG_ 386 FLR_CT2_MotionClass "Tracked object motion classification";
BA_ "UserSigValidity" SG_ 386 FLR_CT2_MotionClass 3;
BA_ "Description" SG_ 386 FLR_CT2_ObjectId "A global ID, which is constant as long as the object is tracked. Note! A value of 0 indicates 'no object'";
BA_ "UserSigValidity" SG_ 386 FLR_CT2_ObjectId 3;
BA_ "Description" SG_ 386 FLR_CT2_ObservationHistory "Observation history of tracked object in as 32 bit-field for the last 32 cycles; for each bit: 1 = associated, 0 = not associated; LSB = most recent cycle, MSB = oldest cycle";
BA_ "UserSigValidity" SG_ 386 FLR_CT2_ObservationHistory 3;
BA_ "Description" SG_ 386 FLR_CT2_QualityBits "Bitmask for quality values described by ClusterTrackQualityBits";
BA_ "UserSigValidity" SG_ 386 FLR_CT2_QualityBits 3;
BA_ "Description" SG_ 386 FLR_CT2_StationaryCounter "Counts the cycles during which the object is ground stationary (i.e. absolute velocity over ground = 0)";
BA_ "UserSigValidity" SG_ 386 FLR_CT2_StationaryCounter 3;
BA_ "Description" SG_ 386 FLR_CT2_Type "Tracked object type classification";
BA_ "UserSigValidity" SG_ 386 FLR_CT2_Type 3;
BA_ "Description" SG_ 386 FLR_CT2_X_Acceleration "X acceleration 

( Movement estimation of object ) ";
BA_ "UserSigValidity" SG_ 386 FLR_CT2_X_Acceleration 3;
BA_ "Description" SG_ 386 FLR_CT2_X_Velocity "Absolute X velocity

( Movement estimation of object ) ";
BA_ "UserSigValidity" SG_ 386 FLR_CT2_X_Velocity 3;
BA_ "Description" SG_ 386 FLR_CT2_X_VelocityStdDev "Standard deviation of X velocity

( Movement estimation of object ) ";
BA_ "UserSigValidity" SG_ 386 FLR_CT2_X_VelocityStdDev 3;
BA_ "Description" SG_ 386 FLR_CT2_Y_Acceleration "Y acceleration 

( Movement estimation of object ) ";
BA_ "UserSigValidity" SG_ 386 FLR_CT2_Y_Acceleration 3;
BA_ "Description" SG_ 386 FLR_CT2_Y_Velocity "Absolute Y velocity

( Movement estimation of object ) ";
BA_ "UserSigValidity" SG_ 386 FLR_CT2_Y_Velocity 3;
BA_ "Description" SG_ 386 FLR_CT2_Y_VelocityStdDev "Standard deviation of Y velocity

( Movement estimation of object ) ";
BA_ "UserSigValidity" SG_ 386 FLR_CT2_Y_VelocityStdDev 3;
BA_ "Description" SG_ 387 FLR_CT3_CrcVal "The CRC checking process calculates the CRC over the entire data block, including the CRC result.

- CRC Polynomial (0x1021) , Initial Value : 0xFFFF, XOR value : 0x0000

- The mathematical expression to 16 bit CRC polynomial is given here. G(x) = x16 + ";
BA_ "GenSigStartValue" SG_ 387 FLR_CT3_CrcVal 65535;
BA_ "UserSigValidity" SG_ 387 FLR_CT3_CrcVal 3;
BA_ "Description" SG_ 387 FLR_CT3_AlvCntVal "[Alive counter] For the first transmission request for a data element the counter shall be initialized with 0 and shall be incremented by 1

for every subsequent send request. When the counter reaches the maximum value(0xFF), then it shall restart with â";
BA_ "UserSigValidity" SG_ 387 FLR_CT3_AlvCntVal 3;
BA_ "Description" SG_ 387 FLR_CT3_ListIndex "List index of cluster track";
BA_ "UserSigValidity" SG_ 387 FLR_CT3_ListIndex 3;
BA_ "Description" SG_ 387 FLR_CT3_SequenceCounter "[TimeSync]Sequence counter for checking the validity of message flow sequence";
BA_ "UserSigValidity" SG_ 387 FLR_CT3_SequenceCounter 3;
BA_ "Description" SG_ 387 FLR_CT3_TimeStamp "[TimeSync]System time, synchronized through AUTOSAR TimeSync";
BA_ "UserSigValidity" SG_ 387 FLR_CT3_TimeStamp 3;
BA_ "Description" SG_ 387 FLR_CT3_Latency "[TimeSync]Sensor latency from object capture scene to object transmission";
BA_ "UserSigValidity" SG_ 387 FLR_CT3_Latency 3;
BA_ "Description" SG_ 387 FLR_CT3_ClosestPointX "Kalman filtered closest point

X position ";
BA_ "UserSigValidity" SG_ 387 FLR_CT3_ClosestPointX 3;
BA_ "Description" SG_ 387 FLR_CT3_ClosestPointXStdDev "Standard deviation of X";
BA_ "UserSigValidity" SG_ 387 FLR_CT3_ClosestPointXStdDev 3;
BA_ "Description" SG_ 387 FLR_CT3_ClosestPointY "Kalman filtered closest point

Y position ";
BA_ "UserSigValidity" SG_ 387 FLR_CT3_ClosestPointY 3;
BA_ "Description" SG_ 387 FLR_CT3_ClosestPointYStdDev "Standard deviation of Y";
BA_ "UserSigValidity" SG_ 387 FLR_CT3_ClosestPointYStdDev 3;
BA_ "Description" SG_ 387 FLR_CT3_Confidence "Object confidence used in quality manager to provide 'Objektgate' (i.e. object quality) tracked object confidence is calculated based on the normalized difference of closest detection to the track's calculated closest point, for range, angle and velocity";
BA_ "UserSigValidity" SG_ 387 FLR_CT3_Confidence 3;
BA_ "Description" SG_ 387 FLR_CT3_Elevation "Elevation of the object";
BA_ "UserSigValidity" SG_ 387 FLR_CT3_Elevation 3;
BA_ "Description" SG_ 387 FLR_CT3_ElevationConfidence "Confidence the elevation classification is correct";
BA_ "UserSigValidity" SG_ 387 FLR_CT3_ElevationConfidence 3;
BA_ "Description" SG_ 387 FLR_CT3_ExistanceProbability "Confidence tracked object existence. Currently set to the association rate [0..100] over the last 6 cycles";
BA_ "UserSigValidity" SG_ 387 FLR_CT3_ExistanceProbability 3;
BA_ "Description" SG_ 387 FLR_CT3_Lifetime "Number of cycles the target has been alive. Unknown 0

Tops out at about 6 minutes of continuous tracking.";
BA_ "UserSigValidity" SG_ 387 FLR_CT3_Lifetime 3;
BA_ "Description" SG_ 387 FLR_CT3_ModelBoxHeading "Heading of object

( Box model describing the object )";
BA_ "UserSigValidity" SG_ 387 FLR_CT3_ModelBoxHeading 3;
BA_ "Description" SG_ 387 FLR_CT3_ModelBoxLength "Length of the object

( Box model describing the object )";
BA_ "UserSigValidity" SG_ 387 FLR_CT3_ModelBoxLength 3;
BA_ "Description" SG_ 387 FLR_CT3_ModelBoxWidth "Width of the object

( Box model describing the object )";
BA_ "UserSigValidity" SG_ 387 FLR_CT3_ModelBoxWidth 3;
BA_ "Description" SG_ 387 FLR_CT3_ModelBoxX "X position, center of box

( Box model describing the object )";
BA_ "UserSigValidity" SG_ 387 FLR_CT3_ModelBoxX 3;
BA_ "Description" SG_ 387 FLR_CT3_ModelBoxY "Y position, center of box

( Box model describing the object )";
BA_ "UserSigValidity" SG_ 387 FLR_CT3_ModelBoxY 3;
BA_ "Description" SG_ 387 FLR_CT3_MotionClass "Tracked object motion classification";
BA_ "UserSigValidity" SG_ 387 FLR_CT3_MotionClass 3;
BA_ "Description" SG_ 387 FLR_CT3_ObjectId "A global ID, which is constant as long as the object is tracked. Note! A value of 0 indicates 'no object'";
BA_ "UserSigValidity" SG_ 387 FLR_CT3_ObjectId 3;
BA_ "Description" SG_ 387 FLR_CT3_ObservationHistory "Observation history of tracked object in as 32 bit-field for the last 32 cycles; for each bit: 1 = associated, 0 = not associated; LSB = most recent cycle, MSB = oldest cycle";
BA_ "UserSigValidity" SG_ 387 FLR_CT3_ObservationHistory 3;
BA_ "Description" SG_ 387 FLR_CT3_QualityBits "Bitmask for quality values described by ClusterTrackQualityBits";
BA_ "UserSigValidity" SG_ 387 FLR_CT3_QualityBits 3;
BA_ "Description" SG_ 387 FLR_CT3_StationaryCounter "Counts the cycles during which the object is ground stationary (i.e. absolute velocity over ground = 0)";
BA_ "UserSigValidity" SG_ 387 FLR_CT3_StationaryCounter 3;
BA_ "Description" SG_ 387 FLR_CT3_Type "Tracked object type classification";
BA_ "UserSigValidity" SG_ 387 FLR_CT3_Type 3;
BA_ "Description" SG_ 387 FLR_CT3_X_Acceleration "X acceleration 

( Movement estimation of object ) ";
BA_ "UserSigValidity" SG_ 387 FLR_CT3_X_Acceleration 3;
BA_ "Description" SG_ 387 FLR_CT3_X_Velocity "Absolute X velocity

( Movement estimation of object ) ";
BA_ "UserSigValidity" SG_ 387 FLR_CT3_X_Velocity 3;
BA_ "Description" SG_ 387 FLR_CT3_X_VelocityStdDev "Standard deviation of X velocity

( Movement estimation of object ) ";
BA_ "UserSigValidity" SG_ 387 FLR_CT3_X_VelocityStdDev 3;
BA_ "Description" SG_ 387 FLR_CT3_Y_Acceleration "Y acceleration 

( Movement estimation of object ) ";
BA_ "UserSigValidity" SG_ 387 FLR_CT3_Y_Acceleration 3;
BA_ "Description" SG_ 387 FLR_CT3_Y_Velocity "Absolute Y velocity

( Movement estimation of object ) ";
BA_ "UserSigValidity" SG_ 387 FLR_CT3_Y_Velocity 3;
BA_ "Description" SG_ 387 FLR_CT3_Y_VelocityStdDev "Standard deviation of Y velocity

( Movement estimation of object ) ";
BA_ "UserSigValidity" SG_ 387 FLR_CT3_Y_VelocityStdDev 3;
BA_ "Description" SG_ 388 FLR_CT4_CrcVal "The CRC checking process calculates the CRC over the entire data block, including the CRC result.

- CRC Polynomial (0x1021) , Initial Value : 0xFFFF, XOR value : 0x0000

- The mathematical expression to 16 bit CRC polynomial is given here. G(x) = x16 + ";
BA_ "GenSigStartValue" SG_ 388 FLR_CT4_CrcVal 65535;
BA_ "UserSigValidity" SG_ 388 FLR_CT4_CrcVal 3;
BA_ "Description" SG_ 388 FLR_CT4_AlvCntVal "[Alive counter] For the first transmission request for a data element the counter shall be initialized with 0 and shall be incremented by 1

for every subsequent send request. When the counter reaches the maximum value(0xFF), then it shall restart with â";
BA_ "UserSigValidity" SG_ 388 FLR_CT4_AlvCntVal 3;
BA_ "Description" SG_ 388 FLR_CT4_ListIndex "List index of cluster track";
BA_ "UserSigValidity" SG_ 388 FLR_CT4_ListIndex 3;
BA_ "Description" SG_ 388 FLR_CT4_SequenceCounter "[TimeSync]Sequence counter for checking the validity of message flow sequence";
BA_ "UserSigValidity" SG_ 388 FLR_CT4_SequenceCounter 3;
BA_ "Description" SG_ 388 FLR_CT4_TimeStamp "[TimeSync]System time, synchronized through AUTOSAR TimeSync";
BA_ "UserSigValidity" SG_ 388 FLR_CT4_TimeStamp 3;
BA_ "Description" SG_ 388 FLR_CT4_Latency "[TimeSync]Sensor latency from object capture scene to object transmission";
BA_ "UserSigValidity" SG_ 388 FLR_CT4_Latency 3;
BA_ "Description" SG_ 388 FLR_CT4_ClosestPointX "Kalman filtered closest point

X position ";
BA_ "UserSigValidity" SG_ 388 FLR_CT4_ClosestPointX 3;
BA_ "Description" SG_ 388 FLR_CT4_ClosestPointXStdDev "Standard deviation of X";
BA_ "UserSigValidity" SG_ 388 FLR_CT4_ClosestPointXStdDev 3;
BA_ "Description" SG_ 388 FLR_CT4_ClosestPointY "Kalman filtered closest point

Y position ";
BA_ "UserSigValidity" SG_ 388 FLR_CT4_ClosestPointY 3;
BA_ "Description" SG_ 388 FLR_CT4_ClosestPointYStdDev "Standard deviation of Y";
BA_ "UserSigValidity" SG_ 388 FLR_CT4_ClosestPointYStdDev 3;
BA_ "Description" SG_ 388 FLR_CT4_Confidence "Object confidence used in quality manager to provide 'Objektgate' (i.e. object quality) tracked object confidence is calculated based on the normalized difference of closest detection to the track's calculated closest point, for range, angle and velocity";
BA_ "UserSigValidity" SG_ 388 FLR_CT4_Confidence 3;
BA_ "Description" SG_ 388 FLR_CT4_Elevation "Elevation of the object";
BA_ "UserSigValidity" SG_ 388 FLR_CT4_Elevation 3;
BA_ "Description" SG_ 388 FLR_CT4_ElevationConfidence "Confidence the elevation classification is correct";
BA_ "UserSigValidity" SG_ 388 FLR_CT4_ElevationConfidence 3;
BA_ "Description" SG_ 388 FLR_CT4_ExistanceProbability "Confidence tracked object existence. Currently set to the association rate [0..100] over the last 6 cycles";
BA_ "UserSigValidity" SG_ 388 FLR_CT4_ExistanceProbability 3;
BA_ "Description" SG_ 388 FLR_CT4_Lifetime "Number of cycles the target has been alive. Unknown 0

Tops out at about 6 minutes of continuous tracking.";
BA_ "UserSigValidity" SG_ 388 FLR_CT4_Lifetime 3;
BA_ "Description" SG_ 388 FLR_CT4_ModelBoxHeading "Heading of object

( Box model describing the object )";
BA_ "UserSigValidity" SG_ 388 FLR_CT4_ModelBoxHeading 3;
BA_ "Description" SG_ 388 FLR_CT4_ModelBoxLength "Length of the object

( Box model describing the object )";
BA_ "UserSigValidity" SG_ 388 FLR_CT4_ModelBoxLength 3;
BA_ "Description" SG_ 388 FLR_CT4_ModelBoxWidth "Width of the object

( Box model describing the object )";
BA_ "UserSigValidity" SG_ 388 FLR_CT4_ModelBoxWidth 3;
BA_ "Description" SG_ 388 FLR_CT4_ModelBoxX "X position, center of box

( Box model describing the object )";
BA_ "UserSigValidity" SG_ 388 FLR_CT4_ModelBoxX 3;
BA_ "Description" SG_ 388 FLR_CT4_ModelBoxY "Y position, center of box

( Box model describing the object )";
BA_ "UserSigValidity" SG_ 388 FLR_CT4_ModelBoxY 3;
BA_ "Description" SG_ 388 FLR_CT4_MotionClass "Tracked object motion classification";
BA_ "UserSigValidity" SG_ 388 FLR_CT4_MotionClass 3;
BA_ "Description" SG_ 388 FLR_CT4_ObjectId "A global ID, which is constant as long as the object is tracked. Note! A value of 0 indicates 'no object'";
BA_ "UserSigValidity" SG_ 388 FLR_CT4_ObjectId 3;
BA_ "Description" SG_ 388 FLR_CT4_ObservationHistory "Observation history of tracked object in as 32 bit-field for the last 32 cycles; for each bit: 1 = associated, 0 = not associated; LSB = most recent cycle, MSB = oldest cycle";
BA_ "UserSigValidity" SG_ 388 FLR_CT4_ObservationHistory 3;
BA_ "Description" SG_ 388 FLR_CT4_QualityBits "Bitmask for quality values described by ClusterTrackQualityBits";
BA_ "UserSigValidity" SG_ 388 FLR_CT4_QualityBits 3;
BA_ "Description" SG_ 388 FLR_CT4_StationaryCounter "Counts the cycles during which the object is ground stationary (i.e. absolute velocity over ground = 0)";
BA_ "UserSigValidity" SG_ 388 FLR_CT4_StationaryCounter 3;
BA_ "Description" SG_ 388 FLR_CT4_Type "Tracked object type classification";
BA_ "UserSigValidity" SG_ 388 FLR_CT4_Type 3;
BA_ "Description" SG_ 388 FLR_CT4_X_Acceleration "X acceleration 

( Movement estimation of object ) ";
BA_ "UserSigValidity" SG_ 388 FLR_CT4_X_Acceleration 3;
BA_ "Description" SG_ 388 FLR_CT4_X_Velocity "Absolute X velocity

( Movement estimation of object ) ";
BA_ "UserSigValidity" SG_ 388 FLR_CT4_X_Velocity 3;
BA_ "Description" SG_ 388 FLR_CT4_X_VelocityStdDev "Standard deviation of X velocity

( Movement estimation of object ) ";
BA_ "UserSigValidity" SG_ 388 FLR_CT4_X_VelocityStdDev 3;
BA_ "Description" SG_ 388 FLR_CT4_Y_Acceleration "Y acceleration 

( Movement estimation of object ) ";
BA_ "UserSigValidity" SG_ 388 FLR_CT4_Y_Acceleration 3;
BA_ "Description" SG_ 388 FLR_CT4_Y_Velocity "Absolute Y velocity

( Movement estimation of object ) ";
BA_ "UserSigValidity" SG_ 388 FLR_CT4_Y_Velocity 3;
BA_ "Description" SG_ 388 FLR_CT4_Y_VelocityStdDev "Standard deviation of Y velocity

( Movement estimation of object ) ";
BA_ "UserSigValidity" SG_ 388 FLR_CT4_Y_VelocityStdDev 3;
BA_ "Description" SG_ 389 FLR_CT5_CrcVal "The CRC checking process calculates the CRC over the entire data block, including the CRC result.

- CRC Polynomial (0x1021) , Initial Value : 0xFFFF, XOR value : 0x0000

- The mathematical expression to 16 bit CRC polynomial is given here. G(x) = x16 + ";
BA_ "GenSigStartValue" SG_ 389 FLR_CT5_CrcVal 65535;
BA_ "UserSigValidity" SG_ 389 FLR_CT5_CrcVal 3;
BA_ "Description" SG_ 389 FLR_CT5_AlvCntVal "[Alive counter] For the first transmission request for a data element the counter shall be initialized with 0 and shall be incremented by 1

for every subsequent send request. When the counter reaches the maximum value(0xFF), then it shall restart with â";
BA_ "UserSigValidity" SG_ 389 FLR_CT5_AlvCntVal 3;
BA_ "Description" SG_ 389 FLR_CT5_ListIndex "List index of cluster track";
BA_ "UserSigValidity" SG_ 389 FLR_CT5_ListIndex 3;
BA_ "Description" SG_ 389 FLR_CT5_SequenceCounter "[TimeSync]Sequence counter for checking the validity of message flow sequence";
BA_ "UserSigValidity" SG_ 389 FLR_CT5_SequenceCounter 3;
BA_ "Description" SG_ 389 FLR_CT5_TimeStamp "[TimeSync]System time, synchronized through AUTOSAR TimeSync";
BA_ "UserSigValidity" SG_ 389 FLR_CT5_TimeStamp 3;
BA_ "Description" SG_ 389 FLR_CT5_Latency "[TimeSync]Sensor latency from object capture scene to object transmission";
BA_ "UserSigValidity" SG_ 389 FLR_CT5_Latency 3;
BA_ "Description" SG_ 389 FLR_CT5_ClosestPointX "Kalman filtered closest point

X position ";
BA_ "UserSigValidity" SG_ 389 FLR_CT5_ClosestPointX 3;
BA_ "Description" SG_ 389 FLR_CT5_ClosestPointXStdDev "Standard deviation of X";
BA_ "UserSigValidity" SG_ 389 FLR_CT5_ClosestPointXStdDev 3;
BA_ "Description" SG_ 389 FLR_CT5_ClosestPointY "Kalman filtered closest point

Y position ";
BA_ "UserSigValidity" SG_ 389 FLR_CT5_ClosestPointY 3;
BA_ "Description" SG_ 389 FLR_CT5_ClosestPointYStdDev "Standard deviation of Y";
BA_ "UserSigValidity" SG_ 389 FLR_CT5_ClosestPointYStdDev 3;
BA_ "Description" SG_ 389 FLR_CT5_Confidence "Object confidence used in quality manager to provide 'Objektgate' (i.e. object quality) tracked object confidence is calculated based on the normalized difference of closest detection to the track's calculated closest point, for range, angle and velocity";
BA_ "UserSigValidity" SG_ 389 FLR_CT5_Confidence 3;
BA_ "Description" SG_ 389 FLR_CT5_Elevation "Elevation of the object";
BA_ "UserSigValidity" SG_ 389 FLR_CT5_Elevation 3;
BA_ "Description" SG_ 389 FLR_CT5_ElevationConfidence "Confidence the elevation classification is correct";
BA_ "UserSigValidity" SG_ 389 FLR_CT5_ElevationConfidence 3;
BA_ "Description" SG_ 389 FLR_CT5_ExistanceProbability "Confidence tracked object existence. Currently set to the association rate [0..100] over the last 6 cycles";
BA_ "UserSigValidity" SG_ 389 FLR_CT5_ExistanceProbability 3;
BA_ "Description" SG_ 389 FLR_CT5_Lifetime "Number of cycles the target has been alive. Unknown 0

Tops out at about 6 minutes of continuous tracking.";
BA_ "UserSigValidity" SG_ 389 FLR_CT5_Lifetime 3;
BA_ "Description" SG_ 389 FLR_CT5_ModelBoxHeading "Heading of object

( Box model describing the object )";
BA_ "UserSigValidity" SG_ 389 FLR_CT5_ModelBoxHeading 3;
BA_ "Description" SG_ 389 FLR_CT5_ModelBoxLength "Length of the object

( Box model describing the object )";
BA_ "UserSigValidity" SG_ 389 FLR_CT5_ModelBoxLength 3;
BA_ "Description" SG_ 389 FLR_CT5_ModelBoxWidth "Width of the object

( Box model describing the object )";
BA_ "UserSigValidity" SG_ 389 FLR_CT5_ModelBoxWidth 3;
BA_ "Description" SG_ 389 FLR_CT5_ModelBoxX "X position, center of box

( Box model describing the object )";
BA_ "UserSigValidity" SG_ 389 FLR_CT5_ModelBoxX 3;
BA_ "Description" SG_ 389 FLR_CT5_ModelBoxY "Y position, center of box

( Box model describing the object )";
BA_ "UserSigValidity" SG_ 389 FLR_CT5_ModelBoxY 3;
BA_ "Description" SG_ 389 FLR_CT5_MotionClass "Tracked object motion classification";
BA_ "UserSigValidity" SG_ 389 FLR_CT5_MotionClass 3;
BA_ "Description" SG_ 389 FLR_CT5_ObjectId "A global ID, which is constant as long as the object is tracked. Note! A value of 0 indicates 'no object'";
BA_ "UserSigValidity" SG_ 389 FLR_CT5_ObjectId 3;
BA_ "Description" SG_ 389 FLR_CT5_ObservationHistory "Observation history of tracked object in as 32 bit-field for the last 32 cycles; for each bit: 1 = associated, 0 = not associated; LSB = most recent cycle, MSB = oldest cycle";
BA_ "UserSigValidity" SG_ 389 FLR_CT5_ObservationHistory 3;
BA_ "Description" SG_ 389 FLR_CT5_QualityBits "Bitmask for quality values described by ClusterTrackQualityBits";
BA_ "UserSigValidity" SG_ 389 FLR_CT5_QualityBits 3;
BA_ "Description" SG_ 389 FLR_CT5_StationaryCounter "Counts the cycles during which the object is ground stationary (i.e. absolute velocity over ground = 0)";
BA_ "UserSigValidity" SG_ 389 FLR_CT5_StationaryCounter 3;
BA_ "Description" SG_ 389 FLR_CT5_Type "Tracked object type classification";
BA_ "UserSigValidity" SG_ 389 FLR_CT5_Type 3;
BA_ "Description" SG_ 389 FLR_CT5_X_Acceleration "X acceleration 

( Movement estimation of object ) ";
BA_ "UserSigValidity" SG_ 389 FLR_CT5_X_Acceleration 3;
BA_ "Description" SG_ 389 FLR_CT5_X_Velocity "Absolute X velocity

( Movement estimation of object ) ";
BA_ "UserSigValidity" SG_ 389 FLR_CT5_X_Velocity 3;
BA_ "Description" SG_ 389 FLR_CT5_X_VelocityStdDev "Standard deviation of X velocity

( Movement estimation of object ) ";
BA_ "UserSigValidity" SG_ 389 FLR_CT5_X_VelocityStdDev 3;
BA_ "Description" SG_ 389 FLR_CT5_Y_Acceleration "Y acceleration 

( Movement estimation of object ) ";
BA_ "UserSigValidity" SG_ 389 FLR_CT5_Y_Acceleration 3;
BA_ "Description" SG_ 389 FLR_CT5_Y_Velocity "Absolute Y velocity

( Movement estimation of object ) ";
BA_ "UserSigValidity" SG_ 389 FLR_CT5_Y_Velocity 3;
BA_ "Description" SG_ 389 FLR_CT5_Y_VelocityStdDev "Standard deviation of Y velocity

( Movement estimation of object ) ";
BA_ "UserSigValidity" SG_ 389 FLR_CT5_Y_VelocityStdDev 3;
BA_ "Description" SG_ 390 FLR_CT6_CrcVal "The CRC checking process calculates the CRC over the entire data block, including the CRC result.

- CRC Polynomial (0x1021) , Initial Value : 0xFFFF, XOR value : 0x0000

- The mathematical expression to 16 bit CRC polynomial is given here. G(x) = x16 + ";
BA_ "GenSigStartValue" SG_ 390 FLR_CT6_CrcVal 65535;
BA_ "UserSigValidity" SG_ 390 FLR_CT6_CrcVal 3;
BA_ "Description" SG_ 390 FLR_CT6_AlvCntVal "[Alive counter] For the first transmission request for a data element the counter shall be initialized with 0 and shall be incremented by 1

for every subsequent send request. When the counter reaches the maximum value(0xFF), then it shall restart with â";
BA_ "UserSigValidity" SG_ 390 FLR_CT6_AlvCntVal 3;
BA_ "Description" SG_ 390 FLR_CT6_ListIndex "List index of cluster track";
BA_ "UserSigValidity" SG_ 390 FLR_CT6_ListIndex 3;
BA_ "Description" SG_ 390 FLR_CT6_SequenceCounter "[TimeSync]Sequence counter for checking the validity of message flow sequence";
BA_ "UserSigValidity" SG_ 390 FLR_CT6_SequenceCounter 3;
BA_ "Description" SG_ 390 FLR_CT6_TimeStamp "[TimeSync]System time, synchronized through AUTOSAR TimeSync";
BA_ "UserSigValidity" SG_ 390 FLR_CT6_TimeStamp 3;
BA_ "Description" SG_ 390 FLR_CT6_Latency "[TimeSync]Sensor latency from object capture scene to object transmission";
BA_ "UserSigValidity" SG_ 390 FLR_CT6_Latency 3;
BA_ "Description" SG_ 390 FLR_CT6_ClosestPointX "Kalman filtered closest point

X position ";
BA_ "UserSigValidity" SG_ 390 FLR_CT6_ClosestPointX 3;
BA_ "Description" SG_ 390 FLR_CT6_ClosestPointXStdDev "Standard deviation of X";
BA_ "UserSigValidity" SG_ 390 FLR_CT6_ClosestPointXStdDev 3;
BA_ "Description" SG_ 390 FLR_CT6_ClosestPointY "Kalman filtered closest point

Y position ";
BA_ "UserSigValidity" SG_ 390 FLR_CT6_ClosestPointY 3;
BA_ "Description" SG_ 390 FLR_CT6_ClosestPointYStdDev "Standard deviation of Y";
BA_ "UserSigValidity" SG_ 390 FLR_CT6_ClosestPointYStdDev 3;
BA_ "Description" SG_ 390 FLR_CT6_Confidence "Object confidence used in quality manager to provide 'Objektgate' (i.e. object quality) tracked object confidence is calculated based on the normalized difference of closest detection to the track's calculated closest point, for range, angle and velocity";
BA_ "UserSigValidity" SG_ 390 FLR_CT6_Confidence 3;
BA_ "Description" SG_ 390 FLR_CT6_Elevation "Elevation of the object";
BA_ "UserSigValidity" SG_ 390 FLR_CT6_Elevation 3;
BA_ "Description" SG_ 390 FLR_CT6_ElevationConfidence "Confidence the elevation classification is correct";
BA_ "UserSigValidity" SG_ 390 FLR_CT6_ElevationConfidence 3;
BA_ "Description" SG_ 390 FLR_CT6_ExistanceProbability "Confidence tracked object existence. Currently set to the association rate [0..100] over the last 6 cycles";
BA_ "UserSigValidity" SG_ 390 FLR_CT6_ExistanceProbability 3;
BA_ "Description" SG_ 390 FLR_CT6_Lifetime "Number of cycles the target has been alive. Unknown 0

Tops out at about 6 minutes of continuous tracking.";
BA_ "UserSigValidity" SG_ 390 FLR_CT6_Lifetime 3;
BA_ "Description" SG_ 390 FLR_CT6_ModelBoxHeading "Heading of object

( Box model describing the object )";
BA_ "UserSigValidity" SG_ 390 FLR_CT6_ModelBoxHeading 3;
BA_ "Description" SG_ 390 FLR_CT6_ModelBoxLength "Length of the object

( Box model describing the object )";
BA_ "UserSigValidity" SG_ 390 FLR_CT6_ModelBoxLength 3;
BA_ "Description" SG_ 390 FLR_CT6_ModelBoxWidth "Width of the object

( Box model describing the object )";
BA_ "UserSigValidity" SG_ 390 FLR_CT6_ModelBoxWidth 3;
BA_ "Description" SG_ 390 FLR_CT6_ModelBoxX "X position, center of box

( Box model describing the object )";
BA_ "UserSigValidity" SG_ 390 FLR_CT6_ModelBoxX 3;
BA_ "Description" SG_ 390 FLR_CT6_ModelBoxY "Y position, center of box

( Box model describing the object )";
BA_ "UserSigValidity" SG_ 390 FLR_CT6_ModelBoxY 3;
BA_ "Description" SG_ 390 FLR_CT6_MotionClass "Tracked object motion classification";
BA_ "UserSigValidity" SG_ 390 FLR_CT6_MotionClass 3;
BA_ "Description" SG_ 390 FLR_CT6_ObjectId "A global ID, which is constant as long as the object is tracked. Note! A value of 0 indicates 'no object'";
BA_ "UserSigValidity" SG_ 390 FLR_CT6_ObjectId 3;
BA_ "Description" SG_ 390 FLR_CT6_ObservationHistory "Observation history of tracked object in as 32 bit-field for the last 32 cycles; for each bit: 1 = associated, 0 = not associated; LSB = most recent cycle, MSB = oldest cycle";
BA_ "UserSigValidity" SG_ 390 FLR_CT6_ObservationHistory 3;
BA_ "Description" SG_ 390 FLR_CT6_QualityBits "Bitmask for quality values described by ClusterTrackQualityBits";
BA_ "UserSigValidity" SG_ 390 FLR_CT6_QualityBits 3;
BA_ "Description" SG_ 390 FLR_CT6_StationaryCounter "Counts the cycles during which the object is ground stationary (i.e. absolute velocity over ground = 0)";
BA_ "UserSigValidity" SG_ 390 FLR_CT6_StationaryCounter 3;
BA_ "Description" SG_ 390 FLR_CT6_Type "Tracked object type classification";
BA_ "UserSigValidity" SG_ 390 FLR_CT6_Type 3;
BA_ "Description" SG_ 390 FLR_CT6_X_Acceleration "X acceleration 

( Movement estimation of object ) ";
BA_ "UserSigValidity" SG_ 390 FLR_CT6_X_Acceleration 3;
BA_ "Description" SG_ 390 FLR_CT6_X_Velocity "Absolute X velocity

( Movement estimation of object ) ";
BA_ "UserSigValidity" SG_ 390 FLR_CT6_X_Velocity 3;
BA_ "Description" SG_ 390 FLR_CT6_X_VelocityStdDev "Standard deviation of X velocity

( Movement estimation of object ) ";
BA_ "UserSigValidity" SG_ 390 FLR_CT6_X_VelocityStdDev 3;
BA_ "Description" SG_ 390 FLR_CT6_Y_Acceleration "Y acceleration 

( Movement estimation of object ) ";
BA_ "UserSigValidity" SG_ 390 FLR_CT6_Y_Acceleration 3;
BA_ "Description" SG_ 390 FLR_CT6_Y_Velocity "Absolute Y velocity

( Movement estimation of object ) ";
BA_ "UserSigValidity" SG_ 390 FLR_CT6_Y_Velocity 3;
BA_ "Description" SG_ 390 FLR_CT6_Y_VelocityStdDev "Standard deviation of Y velocity

( Movement estimation of object ) ";
BA_ "UserSigValidity" SG_ 390 FLR_CT6_Y_VelocityStdDev 3;
BA_ "Description" SG_ 391 FLR_CT7_CrcVal "The CRC checking process calculates the CRC over the entire data block, including the CRC result.

- CRC Polynomial (0x1021) , Initial Value : 0xFFFF, XOR value : 0x0000

- The mathematical expression to 16 bit CRC polynomial is given here. G(x) = x16 + ";
BA_ "GenSigStartValue" SG_ 391 FLR_CT7_CrcVal 65535;
BA_ "UserSigValidity" SG_ 391 FLR_CT7_CrcVal 3;
BA_ "Description" SG_ 391 FLR_CT7_AlvCntVal "[Alive counter] For the first transmission request for a data element the counter shall be initialized with 0 and shall be incremented by 1

for every subsequent send request. When the counter reaches the maximum value(0xFF), then it shall restart with â";
BA_ "UserSigValidity" SG_ 391 FLR_CT7_AlvCntVal 3;
BA_ "Description" SG_ 391 FLR_CT7_ListIndex "List index of cluster track";
BA_ "UserSigValidity" SG_ 391 FLR_CT7_ListIndex 3;
BA_ "Description" SG_ 391 FLR_CT7_SequenceCounter "[TimeSync]Sequence counter for checking the validity of message flow sequence";
BA_ "UserSigValidity" SG_ 391 FLR_CT7_SequenceCounter 3;
BA_ "Description" SG_ 391 FLR_CT7_TimeStamp "[TimeSync]System time, synchronized through AUTOSAR TimeSync";
BA_ "UserSigValidity" SG_ 391 FLR_CT7_TimeStamp 3;
BA_ "Description" SG_ 391 FLR_CT7_Latency "[TimeSync]Sensor latency from object capture scene to object transmission";
BA_ "UserSigValidity" SG_ 391 FLR_CT7_Latency 3;
BA_ "Description" SG_ 391 FLR_CT7_ClosestPointX "Kalman filtered closest point

X position ";
BA_ "UserSigValidity" SG_ 391 FLR_CT7_ClosestPointX 3;
BA_ "Description" SG_ 391 FLR_CT7_ClosestPointXStdDev "Standard deviation of X";
BA_ "UserSigValidity" SG_ 391 FLR_CT7_ClosestPointXStdDev 3;
BA_ "Description" SG_ 391 FLR_CT7_ClosestPointY "Kalman filtered closest point

Y position ";
BA_ "UserSigValidity" SG_ 391 FLR_CT7_ClosestPointY 3;
BA_ "Description" SG_ 391 FLR_CT7_ClosestPointYStdDev "Standard deviation of Y";
BA_ "UserSigValidity" SG_ 391 FLR_CT7_ClosestPointYStdDev 3;
BA_ "Description" SG_ 391 FLR_CT7_Confidence "Object confidence used in quality manager to provide 'Objektgate' (i.e. object quality) tracked object confidence is calculated based on the normalized difference of closest detection to the track's calculated closest point, for range, angle and velocity";
BA_ "UserSigValidity" SG_ 391 FLR_CT7_Confidence 3;
BA_ "Description" SG_ 391 FLR_CT7_Elevation "Elevation of the object";
BA_ "UserSigValidity" SG_ 391 FLR_CT7_Elevation 3;
BA_ "Description" SG_ 391 FLR_CT7_ElevationConfidence "Confidence the elevation classification is correct";
BA_ "UserSigValidity" SG_ 391 FLR_CT7_ElevationConfidence 3;
BA_ "Description" SG_ 391 FLR_CT7_ExistanceProbability "Confidence tracked object existence. Currently set to the association rate [0..100] over the last 6 cycles";
BA_ "UserSigValidity" SG_ 391 FLR_CT7_ExistanceProbability 3;
BA_ "Description" SG_ 391 FLR_CT7_Lifetime "Number of cycles the target has been alive. Unknown 0

Tops out at about 6 minutes of continuous tracking.";
BA_ "UserSigValidity" SG_ 391 FLR_CT7_Lifetime 3;
BA_ "Description" SG_ 391 FLR_CT7_ModelBoxHeading "Heading of object

( Box model describing the object )";
BA_ "UserSigValidity" SG_ 391 FLR_CT7_ModelBoxHeading 3;
BA_ "Description" SG_ 391 FLR_CT7_ModelBoxLength "Length of the object

( Box model describing the object )";
BA_ "UserSigValidity" SG_ 391 FLR_CT7_ModelBoxLength 3;
BA_ "Description" SG_ 391 FLR_CT7_ModelBoxWidth "Width of the object

( Box model describing the object )";
BA_ "UserSigValidity" SG_ 391 FLR_CT7_ModelBoxWidth 3;
BA_ "Description" SG_ 391 FLR_CT7_ModelBoxX "X position, center of box

( Box model describing the object )";
BA_ "UserSigValidity" SG_ 391 FLR_CT7_ModelBoxX 3;
BA_ "Description" SG_ 391 FLR_CT7_ModelBoxY "Y position, center of box

( Box model describing the object )";
BA_ "UserSigValidity" SG_ 391 FLR_CT7_ModelBoxY 3;
BA_ "Description" SG_ 391 FLR_CT7_MotionClass "Tracked object motion classification";
BA_ "UserSigValidity" SG_ 391 FLR_CT7_MotionClass 3;
BA_ "Description" SG_ 391 FLR_CT7_ObjectId "A global ID, which is constant as long as the object is tracked. Note! A value of 0 indicates 'no object'";
BA_ "UserSigValidity" SG_ 391 FLR_CT7_ObjectId 3;
BA_ "Description" SG_ 391 FLR_CT7_ObservationHistory "Observation history of tracked object in as 32 bit-field for the last 32 cycles; for each bit: 1 = associated, 0 = not associated; LSB = most recent cycle, MSB = oldest cycle";
BA_ "UserSigValidity" SG_ 391 FLR_CT7_ObservationHistory 3;
BA_ "Description" SG_ 391 FLR_CT7_QualityBits "Bitmask for quality values described by ClusterTrackQualityBits";
BA_ "UserSigValidity" SG_ 391 FLR_CT7_QualityBits 3;
BA_ "Description" SG_ 391 FLR_CT7_StationaryCounter "Counts the cycles during which the object is ground stationary (i.e. absolute velocity over ground = 0)";
BA_ "UserSigValidity" SG_ 391 FLR_CT7_StationaryCounter 3;
BA_ "Description" SG_ 391 FLR_CT7_Type "Tracked object type classification";
BA_ "UserSigValidity" SG_ 391 FLR_CT7_Type 3;
BA_ "Description" SG_ 391 FLR_CT7_X_Acceleration "X acceleration 

( Movement estimation of object ) ";
BA_ "UserSigValidity" SG_ 391 FLR_CT7_X_Acceleration 3;
BA_ "Description" SG_ 391 FLR_CT7_X_Velocity "Absolute X velocity

( Movement estimation of object ) ";
BA_ "UserSigValidity" SG_ 391 FLR_CT7_X_Velocity 3;
BA_ "Description" SG_ 391 FLR_CT7_X_VelocityStdDev "Standard deviation of X velocity

( Movement estimation of object ) ";
BA_ "UserSigValidity" SG_ 391 FLR_CT7_X_VelocityStdDev 3;
BA_ "Description" SG_ 391 FLR_CT7_Y_Acceleration "Y acceleration 

( Movement estimation of object ) ";
BA_ "UserSigValidity" SG_ 391 FLR_CT7_Y_Acceleration 3;
BA_ "Description" SG_ 391 FLR_CT7_Y_Velocity "Absolute Y velocity

( Movement estimation of object ) ";
BA_ "UserSigValidity" SG_ 391 FLR_CT7_Y_Velocity 3;
BA_ "Description" SG_ 391 FLR_CT7_Y_VelocityStdDev "Standard deviation of Y velocity

( Movement estimation of object ) ";
BA_ "UserSigValidity" SG_ 391 FLR_CT7_Y_VelocityStdDev 3;
BA_ "Description" SG_ 392 FLR_CT8_CrcVal "The CRC checking process calculates the CRC over the entire data block, including the CRC result.

- CRC Polynomial (0x1021) , Initial Value : 0xFFFF, XOR value : 0x0000

- The mathematical expression to 16 bit CRC polynomial is given here. G(x) = x16 + ";
BA_ "GenSigStartValue" SG_ 392 FLR_CT8_CrcVal 65535;
BA_ "UserSigValidity" SG_ 392 FLR_CT8_CrcVal 3;
BA_ "Description" SG_ 392 FLR_CT8_AlvCntVal "[Alive counter] For the first transmission request for a data element the counter shall be initialized with 0 and shall be incremented by 1

for every subsequent send request. When the counter reaches the maximum value(0xFF), then it shall restart with â";
BA_ "UserSigValidity" SG_ 392 FLR_CT8_AlvCntVal 3;
BA_ "Description" SG_ 392 FLR_CT8_ListIndex "List index of cluster track";
BA_ "UserSigValidity" SG_ 392 FLR_CT8_ListIndex 3;
BA_ "Description" SG_ 392 FLR_CT8_SequenceCounter "[TimeSync]Sequence counter for checking the validity of message flow sequence";
BA_ "UserSigValidity" SG_ 392 FLR_CT8_SequenceCounter 3;
BA_ "Description" SG_ 392 FLR_CT8_TimeStamp "[TimeSync]System time, synchronized through AUTOSAR TimeSync";
BA_ "UserSigValidity" SG_ 392 FLR_CT8_TimeStamp 3;
BA_ "Description" SG_ 392 FLR_CT8_Latency "[TimeSync]Sensor latency from object capture scene to object transmission";
BA_ "UserSigValidity" SG_ 392 FLR_CT8_Latency 3;
BA_ "Description" SG_ 392 FLR_CT8_ClosestPointX "Kalman filtered closest point

X position ";
BA_ "UserSigValidity" SG_ 392 FLR_CT8_ClosestPointX 3;
BA_ "Description" SG_ 392 FLR_CT8_ClosestPointXStdDev "Standard deviation of X";
BA_ "UserSigValidity" SG_ 392 FLR_CT8_ClosestPointXStdDev 3;
BA_ "Description" SG_ 392 FLR_CT8_ClosestPointY "Kalman filtered closest point

Y position ";
BA_ "UserSigValidity" SG_ 392 FLR_CT8_ClosestPointY 3;
BA_ "Description" SG_ 392 FLR_CT8_ClosestPointYStdDev "Standard deviation of Y";
BA_ "UserSigValidity" SG_ 392 FLR_CT8_ClosestPointYStdDev 3;
BA_ "Description" SG_ 392 FLR_CT8_Confidence "Object confidence used in quality manager to provide 'Objektgate' (i.e. object quality) tracked object confidence is calculated based on the normalized difference of closest detection to the track's calculated closest point, for range, angle and velocity";
BA_ "UserSigValidity" SG_ 392 FLR_CT8_Confidence 3;
BA_ "Description" SG_ 392 FLR_CT8_Elevation "Elevation of the object";
BA_ "UserSigValidity" SG_ 392 FLR_CT8_Elevation 3;
BA_ "Description" SG_ 392 FLR_CT8_ElevationConfidence "Confidence the elevation classification is correct";
BA_ "UserSigValidity" SG_ 392 FLR_CT8_ElevationConfidence 3;
BA_ "Description" SG_ 392 FLR_CT8_ExistanceProbability "Confidence tracked object existence. Currently set to the association rate [0..100] over the last 6 cycles";
BA_ "UserSigValidity" SG_ 392 FLR_CT8_ExistanceProbability 3;
BA_ "Description" SG_ 392 FLR_CT8_Lifetime "Number of cycles the target has been alive. Unknown 0

Tops out at about 6 minutes of continuous tracking.";
BA_ "UserSigValidity" SG_ 392 FLR_CT8_Lifetime 3;
BA_ "Description" SG_ 392 FLR_CT8_ModelBoxHeading "Heading of object

( Box model describing the object )";
BA_ "UserSigValidity" SG_ 392 FLR_CT8_ModelBoxHeading 3;
BA_ "Description" SG_ 392 FLR_CT8_ModelBoxLength "Length of the object

( Box model describing the object )";
BA_ "UserSigValidity" SG_ 392 FLR_CT8_ModelBoxLength 3;
BA_ "Description" SG_ 392 FLR_CT8_ModelBoxWidth "Width of the object

( Box model describing the object )";
BA_ "UserSigValidity" SG_ 392 FLR_CT8_ModelBoxWidth 3;
BA_ "Description" SG_ 392 FLR_CT8_ModelBoxX "X position, center of box

( Box model describing the object )";
BA_ "UserSigValidity" SG_ 392 FLR_CT8_ModelBoxX 3;
BA_ "Description" SG_ 392 FLR_CT8_ModelBoxY "Y position, center of box

( Box model describing the object )";
BA_ "UserSigValidity" SG_ 392 FLR_CT8_ModelBoxY 3;
BA_ "Description" SG_ 392 FLR_CT8_MotionClass "Tracked object motion classification";
BA_ "UserSigValidity" SG_ 392 FLR_CT8_MotionClass 3;
BA_ "Description" SG_ 392 FLR_CT8_ObjectId "A global ID, which is constant as long as the object is tracked. Note! A value of 0 indicates 'no object'";
BA_ "UserSigValidity" SG_ 392 FLR_CT8_ObjectId 3;
BA_ "Description" SG_ 392 FLR_CT8_ObservationHistory "Observation history of tracked object in as 32 bit-field for the last 32 cycles; for each bit: 1 = associated, 0 = not associated; LSB = most recent cycle, MSB = oldest cycle";
BA_ "UserSigValidity" SG_ 392 FLR_CT8_ObservationHistory 3;
BA_ "Description" SG_ 392 FLR_CT8_QualityBits "Bitmask for quality values described by ClusterTrackQualityBits";
BA_ "UserSigValidity" SG_ 392 FLR_CT8_QualityBits 3;
BA_ "Description" SG_ 392 FLR_CT8_StationaryCounter "Counts the cycles during which the object is ground stationary (i.e. absolute velocity over ground = 0)";
BA_ "UserSigValidity" SG_ 392 FLR_CT8_StationaryCounter 3;
BA_ "Description" SG_ 392 FLR_CT8_Type "Tracked object type classification";
BA_ "UserSigValidity" SG_ 392 FLR_CT8_Type 3;
BA_ "Description" SG_ 392 FLR_CT8_X_Acceleration "X acceleration 

( Movement estimation of object ) ";
BA_ "UserSigValidity" SG_ 392 FLR_CT8_X_Acceleration 3;
BA_ "Description" SG_ 392 FLR_CT8_X_Velocity "Absolute X velocity

( Movement estimation of object ) ";
BA_ "UserSigValidity" SG_ 392 FLR_CT8_X_Velocity 3;
BA_ "Description" SG_ 392 FLR_CT8_X_VelocityStdDev "Standard deviation of X velocity

( Movement estimation of object ) ";
BA_ "UserSigValidity" SG_ 392 FLR_CT8_X_VelocityStdDev 3;
BA_ "Description" SG_ 392 FLR_CT8_Y_Acceleration "Y acceleration 

( Movement estimation of object ) ";
BA_ "UserSigValidity" SG_ 392 FLR_CT8_Y_Acceleration 3;
BA_ "Description" SG_ 392 FLR_CT8_Y_Velocity "Absolute Y velocity

( Movement estimation of object ) ";
BA_ "UserSigValidity" SG_ 392 FLR_CT8_Y_Velocity 3;
BA_ "Description" SG_ 392 FLR_CT8_Y_VelocityStdDev "Standard deviation of Y velocity

( Movement estimation of object ) ";
BA_ "UserSigValidity" SG_ 392 FLR_CT8_Y_VelocityStdDev 3;
BA_ "Description" SG_ 393 FLR_CT9_CrcVal "The CRC checking process calculates the CRC over the entire data block, including the CRC result.

- CRC Polynomial (0x1021) , Initial Value : 0xFFFF, XOR value : 0x0000

- The mathematical expression to 16 bit CRC polynomial is given here. G(x) = x16 + ";
BA_ "GenSigStartValue" SG_ 393 FLR_CT9_CrcVal 65535;
BA_ "UserSigValidity" SG_ 393 FLR_CT9_CrcVal 3;
BA_ "Description" SG_ 393 FLR_CT9_AlvCntVal "[Alive counter] For the first transmission request for a data element the counter shall be initialized with 0 and shall be incremented by 1

for every subsequent send request. When the counter reaches the maximum value(0xFF), then it shall restart with â";
BA_ "UserSigValidity" SG_ 393 FLR_CT9_AlvCntVal 3;
BA_ "Description" SG_ 393 FLR_CT9_ListIndex "List index of cluster track";
BA_ "UserSigValidity" SG_ 393 FLR_CT9_ListIndex 3;
BA_ "Description" SG_ 393 FLR_CT9_SequenceCounter "[TimeSync]Sequence counter for checking the validity of message flow sequence";
BA_ "UserSigValidity" SG_ 393 FLR_CT9_SequenceCounter 3;
BA_ "Description" SG_ 393 FLR_CT9_TimeStamp "[TimeSync]System time, synchronized through AUTOSAR TimeSync";
BA_ "UserSigValidity" SG_ 393 FLR_CT9_TimeStamp 3;
BA_ "Description" SG_ 393 FLR_CT9_Latency "[TimeSync]Sensor latency from object capture scene to object transmission";
BA_ "UserSigValidity" SG_ 393 FLR_CT9_Latency 3;
BA_ "Description" SG_ 393 FLR_CT9_ClosestPointX "Kalman filtered closest point

X position ";
BA_ "UserSigValidity" SG_ 393 FLR_CT9_ClosestPointX 3;
BA_ "Description" SG_ 393 FLR_CT9_ClosestPointXStdDev "Standard deviation of X";
BA_ "UserSigValidity" SG_ 393 FLR_CT9_ClosestPointXStdDev 3;
BA_ "Description" SG_ 393 FLR_CT9_ClosestPointY "Kalman filtered closest point

Y position ";
BA_ "UserSigValidity" SG_ 393 FLR_CT9_ClosestPointY 3;
BA_ "Description" SG_ 393 FLR_CT9_ClosestPointYStdDev "Standard deviation of Y";
BA_ "UserSigValidity" SG_ 393 FLR_CT9_ClosestPointYStdDev 3;
BA_ "Description" SG_ 393 FLR_CT9_Confidence "Object confidence used in quality manager to provide 'Objektgate' (i.e. object quality) tracked object confidence is calculated based on the normalized difference of closest detection to the track's calculated closest point, for range, angle and velocity";
BA_ "UserSigValidity" SG_ 393 FLR_CT9_Confidence 3;
BA_ "Description" SG_ 393 FLR_CT9_Elevation "Elevation of the object";
BA_ "UserSigValidity" SG_ 393 FLR_CT9_Elevation 3;
BA_ "Description" SG_ 393 FLR_CT9_ElevationConfidence "Confidence the elevation classification is correct";
BA_ "UserSigValidity" SG_ 393 FLR_CT9_ElevationConfidence 3;
BA_ "Description" SG_ 393 FLR_CT9_ExistanceProbability "Confidence tracked object existence. Currently set to the association rate [0..100] over the last 6 cycles";
BA_ "UserSigValidity" SG_ 393 FLR_CT9_ExistanceProbability 3;
BA_ "Description" SG_ 393 FLR_CT9_Lifetime "Number of cycles the target has been alive. Unknown 0

Tops out at about 6 minutes of continuous tracking.";
BA_ "UserSigValidity" SG_ 393 FLR_CT9_Lifetime 3;
BA_ "Description" SG_ 393 FLR_CT9_ModelBoxHeading "Heading of object

( Box model describing the object )";
BA_ "UserSigValidity" SG_ 393 FLR_CT9_ModelBoxHeading 3;
BA_ "Description" SG_ 393 FLR_CT9_ModelBoxLength "Length of the object

( Box model describing the object )";
BA_ "UserSigValidity" SG_ 393 FLR_CT9_ModelBoxLength 3;
BA_ "Description" SG_ 393 FLR_CT9_ModelBoxWidth "Width of the object

( Box model describing the object )";
BA_ "UserSigValidity" SG_ 393 FLR_CT9_ModelBoxWidth 3;
BA_ "Description" SG_ 393 FLR_CT9_ModelBoxX "X position, center of box

( Box model describing the object )";
BA_ "UserSigValidity" SG_ 393 FLR_CT9_ModelBoxX 3;
BA_ "Description" SG_ 393 FLR_CT9_ModelBoxY "Y position, center of box

( Box model describing the object )";
BA_ "UserSigValidity" SG_ 393 FLR_CT9_ModelBoxY 3;
BA_ "Description" SG_ 393 FLR_CT9_MotionClass "Tracked object motion classification";
BA_ "UserSigValidity" SG_ 393 FLR_CT9_MotionClass 3;
BA_ "Description" SG_ 393 FLR_CT9_ObjectId "A global ID, which is constant as long as the object is tracked. Note! A value of 0 indicates 'no object'";
BA_ "UserSigValidity" SG_ 393 FLR_CT9_ObjectId 3;
BA_ "Description" SG_ 393 FLR_CT9_ObservationHistory "Observation history of tracked object in as 32 bit-field for the last 32 cycles; for each bit: 1 = associated, 0 = not associated; LSB = most recent cycle, MSB = oldest cycle";
BA_ "UserSigValidity" SG_ 393 FLR_CT9_ObservationHistory 3;
BA_ "Description" SG_ 393 FLR_CT9_QualityBits "Bitmask for quality values described by ClusterTrackQualityBits";
BA_ "UserSigValidity" SG_ 393 FLR_CT9_QualityBits 3;
BA_ "Description" SG_ 393 FLR_CT9_StationaryCounter "Counts the cycles during which the object is ground stationary (i.e. absolute velocity over ground = 0)";
BA_ "UserSigValidity" SG_ 393 FLR_CT9_StationaryCounter 3;
BA_ "Description" SG_ 393 FLR_CT9_Type "Tracked object type classification";
BA_ "UserSigValidity" SG_ 393 FLR_CT9_Type 3;
BA_ "Description" SG_ 393 FLR_CT9_X_Acceleration "X acceleration 

( Movement estimation of object ) ";
BA_ "UserSigValidity" SG_ 393 FLR_CT9_X_Acceleration 3;
BA_ "Description" SG_ 393 FLR_CT9_X_Velocity "Absolute X velocity

( Movement estimation of object ) ";
BA_ "UserSigValidity" SG_ 393 FLR_CT9_X_Velocity 3;
BA_ "Description" SG_ 393 FLR_CT9_X_VelocityStdDev "Standard deviation of X velocity

( Movement estimation of object ) ";
BA_ "UserSigValidity" SG_ 393 FLR_CT9_X_VelocityStdDev 3;
BA_ "Description" SG_ 393 FLR_CT9_Y_Acceleration "Y acceleration 

( Movement estimation of object ) ";
BA_ "UserSigValidity" SG_ 393 FLR_CT9_Y_Acceleration 3;
BA_ "Description" SG_ 393 FLR_CT9_Y_Velocity "Absolute Y velocity

( Movement estimation of object ) ";
BA_ "UserSigValidity" SG_ 393 FLR_CT9_Y_Velocity 3;
BA_ "Description" SG_ 393 FLR_CT9_Y_VelocityStdDev "Standard deviation of Y velocity

( Movement estimation of object ) ";
BA_ "UserSigValidity" SG_ 393 FLR_CT9_Y_VelocityStdDev 3;
BA_ "Description" SG_ 394 FLR_CT10_CrcVal "The CRC checking process calculates the CRC over the entire data block, including the CRC result.

- CRC Polynomial (0x1021) , Initial Value : 0xFFFF, XOR value : 0x0000

- The mathematical expression to 16 bit CRC polynomial is given here. G(x) = x16 + ";
BA_ "GenSigStartValue" SG_ 394 FLR_CT10_CrcVal 65535;
BA_ "UserSigValidity" SG_ 394 FLR_CT10_CrcVal 3;
BA_ "Description" SG_ 394 FLR_CT10_AlvCntVal "[Alive counter] For the first transmission request for a data element the counter shall be initialized with 0 and shall be incremented by 1

for every subsequent send request. When the counter reaches the maximum value(0xFF), then it shall restart with â";
BA_ "UserSigValidity" SG_ 394 FLR_CT10_AlvCntVal 3;
BA_ "Description" SG_ 394 FLR_CT10_ListIndex "List index of cluster track";
BA_ "UserSigValidity" SG_ 394 FLR_CT10_ListIndex 3;
BA_ "Description" SG_ 394 FLR_CT10_SequenceCounter "[TimeSync]Sequence counter for checking the validity of message flow sequence";
BA_ "UserSigValidity" SG_ 394 FLR_CT10_SequenceCounter 3;
BA_ "Description" SG_ 394 FLR_CT10_TimeStamp "[TimeSync]System time, synchronized through AUTOSAR TimeSync";
BA_ "UserSigValidity" SG_ 394 FLR_CT10_TimeStamp 3;
BA_ "Description" SG_ 394 FLR_CT10_Latency "[TimeSync]Sensor latency from object capture scene to object transmission";
BA_ "UserSigValidity" SG_ 394 FLR_CT10_Latency 3;
BA_ "Description" SG_ 394 FLR_CT10_ClosestPointX "Kalman filtered closest point

X position ";
BA_ "UserSigValidity" SG_ 394 FLR_CT10_ClosestPointX 3;
BA_ "Description" SG_ 394 FLR_CT10_ClosestPointXStdDev "Standard deviation of X";
BA_ "UserSigValidity" SG_ 394 FLR_CT10_ClosestPointXStdDev 3;
BA_ "Description" SG_ 394 FLR_CT10_ClosestPointY "Kalman filtered closest point

Y position ";
BA_ "UserSigValidity" SG_ 394 FLR_CT10_ClosestPointY 3;
BA_ "Description" SG_ 394 FLR_CT10_ClosestPointYStdDev "Standard deviation of Y";
BA_ "UserSigValidity" SG_ 394 FLR_CT10_ClosestPointYStdDev 3;
BA_ "Description" SG_ 394 FLR_CT10_Confidence "Object confidence used in quality manager to provide 'Objektgate' (i.e. object quality) tracked object confidence is calculated based on the normalized difference of closest detection to the track's calculated closest point, for range, angle and velocity";
BA_ "UserSigValidity" SG_ 394 FLR_CT10_Confidence 3;
BA_ "Description" SG_ 394 FLR_CT10_Elevation "Elevation of the object";
BA_ "UserSigValidity" SG_ 394 FLR_CT10_Elevation 3;
BA_ "Description" SG_ 394 FLR_CT10_ElevationConfidence "Confidence the elevation classification is correct";
BA_ "UserSigValidity" SG_ 394 FLR_CT10_ElevationConfidence 3;
BA_ "Description" SG_ 394 FLR_CT10_ExistanceProbability "Confidence tracked object existence. Currently set to the association rate [0..100] over the last 6 cycles";
BA_ "UserSigValidity" SG_ 394 FLR_CT10_ExistanceProbability 3;
BA_ "Description" SG_ 394 FLR_CT10_Lifetime "Number of cycles the target has been alive. Unknown 0

Tops out at about 6 minutes of continuous tracking.";
BA_ "UserSigValidity" SG_ 394 FLR_CT10_Lifetime 3;
BA_ "Description" SG_ 394 FLR_CT10_ModelBoxHeading "Heading of object

( Box model describing the object )";
BA_ "UserSigValidity" SG_ 394 FLR_CT10_ModelBoxHeading 3;
BA_ "Description" SG_ 394 FLR_CT10_ModelBoxLength "Length of the object

( Box model describing the object )";
BA_ "UserSigValidity" SG_ 394 FLR_CT10_ModelBoxLength 3;
BA_ "Description" SG_ 394 FLR_CT10_ModelBoxWidth "Width of the object

( Box model describing the object )";
BA_ "UserSigValidity" SG_ 394 FLR_CT10_ModelBoxWidth 3;
BA_ "Description" SG_ 394 FLR_CT10_ModelBoxX "X position, center of box

( Box model describing the object )";
BA_ "UserSigValidity" SG_ 394 FLR_CT10_ModelBoxX 3;
BA_ "Description" SG_ 394 FLR_CT10_ModelBoxY "Y position, center of box

( Box model describing the object )";
BA_ "UserSigValidity" SG_ 394 FLR_CT10_ModelBoxY 3;
BA_ "Description" SG_ 394 FLR_CT10_MotionClass "Tracked object motion classification";
BA_ "UserSigValidity" SG_ 394 FLR_CT10_MotionClass 3;
BA_ "Description" SG_ 394 FLR_CT10_ObjectId "A global ID, which is constant as long as the object is tracked. Note! A value of 0 indicates 'no object'";
BA_ "UserSigValidity" SG_ 394 FLR_CT10_ObjectId 3;
BA_ "Description" SG_ 394 FLR_CT10_ObservationHistory "Observation history of tracked object in as 32 bit-field for the last 32 cycles; for each bit: 1 = associated, 0 = not associated; LSB = most recent cycle, MSB = oldest cycle";
BA_ "UserSigValidity" SG_ 394 FLR_CT10_ObservationHistory 3;
BA_ "Description" SG_ 394 FLR_CT10_QualityBits "Bitmask for quality values described by ClusterTrackQualityBits";
BA_ "UserSigValidity" SG_ 394 FLR_CT10_QualityBits 3;
BA_ "Description" SG_ 394 FLR_CT10_StationaryCounter "Counts the cycles during which the object is ground stationary (i.e. absolute velocity over ground = 0)";
BA_ "UserSigValidity" SG_ 394 FLR_CT10_StationaryCounter 3;
BA_ "Description" SG_ 394 FLR_CT10_Type "Tracked object type classification";
BA_ "UserSigValidity" SG_ 394 FLR_CT10_Type 3;
BA_ "Description" SG_ 394 FLR_CT10_X_Acceleration "X acceleration 

( Movement estimation of object ) ";
BA_ "UserSigValidity" SG_ 394 FLR_CT10_X_Acceleration 3;
BA_ "Description" SG_ 394 FLR_CT10_X_Velocity "Absolute X velocity

( Movement estimation of object ) ";
BA_ "UserSigValidity" SG_ 394 FLR_CT10_X_Velocity 3;
BA_ "Description" SG_ 394 FLR_CT10_X_VelocityStdDev "Standard deviation of X velocity

( Movement estimation of object ) ";
BA_ "UserSigValidity" SG_ 394 FLR_CT10_X_VelocityStdDev 3;
BA_ "Description" SG_ 394 FLR_CT10_Y_Acceleration "Y acceleration 

( Movement estimation of object ) ";
BA_ "UserSigValidity" SG_ 394 FLR_CT10_Y_Acceleration 3;
BA_ "Description" SG_ 394 FLR_CT10_Y_Velocity "Absolute Y velocity

( Movement estimation of object ) ";
BA_ "UserSigValidity" SG_ 394 FLR_CT10_Y_Velocity 3;
BA_ "Description" SG_ 394 FLR_CT10_Y_VelocityStdDev "Standard deviation of Y velocity

( Movement estimation of object ) ";
BA_ "UserSigValidity" SG_ 394 FLR_CT10_Y_VelocityStdDev 3;
BA_ "Description" SG_ 395 FLR_CT11_CrcVal "The CRC checking process calculates the CRC over the entire data block, including the CRC result.

- CRC Polynomial (0x1021) , Initial Value : 0xFFFF, XOR value : 0x0000

- The mathematical expression to 16 bit CRC polynomial is given here. G(x) = x16 + ";
BA_ "GenSigStartValue" SG_ 395 FLR_CT11_CrcVal 65535;
BA_ "UserSigValidity" SG_ 395 FLR_CT11_CrcVal 3;
BA_ "Description" SG_ 395 FLR_CT11_AlvCntVal "[Alive counter] For the first transmission request for a data element the counter shall be initialized with 0 and shall be incremented by 1

for every subsequent send request. When the counter reaches the maximum value(0xFF), then it shall restart with â";
BA_ "UserSigValidity" SG_ 395 FLR_CT11_AlvCntVal 3;
BA_ "Description" SG_ 395 FLR_CT11_ListIndex "List index of cluster track";
BA_ "UserSigValidity" SG_ 395 FLR_CT11_ListIndex 3;
BA_ "Description" SG_ 395 FLR_CT11_SequenceCounter "[TimeSync]Sequence counter for checking the validity of message flow sequence";
BA_ "UserSigValidity" SG_ 395 FLR_CT11_SequenceCounter 3;
BA_ "Description" SG_ 395 FLR_CT11_TimeStamp "[TimeSync]System time, synchronized through AUTOSAR TimeSync";
BA_ "UserSigValidity" SG_ 395 FLR_CT11_TimeStamp 3;
BA_ "Description" SG_ 395 FLR_CT11_Latency "[TimeSync]Sensor latency from object capture scene to object transmission";
BA_ "UserSigValidity" SG_ 395 FLR_CT11_Latency 3;
BA_ "Description" SG_ 395 FLR_CT11_ClosestPointX "Kalman filtered closest point

X position ";
BA_ "UserSigValidity" SG_ 395 FLR_CT11_ClosestPointX 3;
BA_ "Description" SG_ 395 FLR_CT11_ClosestPointXStdDev "Standard deviation of X";
BA_ "UserSigValidity" SG_ 395 FLR_CT11_ClosestPointXStdDev 3;
BA_ "Description" SG_ 395 FLR_CT11_ClosestPointY "Kalman filtered closest point

Y position ";
BA_ "UserSigValidity" SG_ 395 FLR_CT11_ClosestPointY 3;
BA_ "Description" SG_ 395 FLR_CT11_ClosestPointYStdDev "Standard deviation of Y";
BA_ "UserSigValidity" SG_ 395 FLR_CT11_ClosestPointYStdDev 3;
BA_ "Description" SG_ 395 FLR_CT11_Confidence "Object confidence used in quality manager to provide 'Objektgate' (i.e. object quality) tracked object confidence is calculated based on the normalized difference of closest detection to the track's calculated closest point, for range, angle and velocity";
BA_ "UserSigValidity" SG_ 395 FLR_CT11_Confidence 3;
BA_ "Description" SG_ 395 FLR_CT11_Elevation "Elevation of the object";
BA_ "UserSigValidity" SG_ 395 FLR_CT11_Elevation 3;
BA_ "Description" SG_ 395 FLR_CT11_ElevationConfidence "Confidence the elevation classification is correct";
BA_ "UserSigValidity" SG_ 395 FLR_CT11_ElevationConfidence 3;
BA_ "Description" SG_ 395 FLR_CT11_ExistanceProbability "Confidence tracked object existence. Currently set to the association rate [0..100] over the last 6 cycles";
BA_ "UserSigValidity" SG_ 395 FLR_CT11_ExistanceProbability 3;
BA_ "Description" SG_ 395 FLR_CT11_Lifetime "Number of cycles the target has been alive. Unknown 0

Tops out at about 6 minutes of continuous tracking.";
BA_ "UserSigValidity" SG_ 395 FLR_CT11_Lifetime 3;
BA_ "Description" SG_ 395 FLR_CT11_ModelBoxHeading "Heading of object

( Box model describing the object )";
BA_ "UserSigValidity" SG_ 395 FLR_CT11_ModelBoxHeading 3;
BA_ "Description" SG_ 395 FLR_CT11_ModelBoxLength "Length of the object

( Box model describing the object )";
BA_ "UserSigValidity" SG_ 395 FLR_CT11_ModelBoxLength 3;
BA_ "Description" SG_ 395 FLR_CT11_ModelBoxWidth "Width of the object

( Box model describing the object )";
BA_ "UserSigValidity" SG_ 395 FLR_CT11_ModelBoxWidth 3;
BA_ "Description" SG_ 395 FLR_CT11_ModelBoxX "X position, center of box

( Box model describing the object )";
BA_ "UserSigValidity" SG_ 395 FLR_CT11_ModelBoxX 3;
BA_ "Description" SG_ 395 FLR_CT11_ModelBoxY "Y position, center of box

( Box model describing the object )";
BA_ "UserSigValidity" SG_ 395 FLR_CT11_ModelBoxY 3;
BA_ "Description" SG_ 395 FLR_CT11_MotionClass "Tracked object motion classification";
BA_ "UserSigValidity" SG_ 395 FLR_CT11_MotionClass 3;
BA_ "Description" SG_ 395 FLR_CT11_ObjectId "A global ID, which is constant as long as the object is tracked. Note! A value of 0 indicates 'no object'";
BA_ "UserSigValidity" SG_ 395 FLR_CT11_ObjectId 3;
BA_ "Description" SG_ 395 FLR_CT11_ObservationHistory "Observation history of tracked object in as 32 bit-field for the last 32 cycles; for each bit: 1 = associated, 0 = not associated; LSB = most recent cycle, MSB = oldest cycle";
BA_ "UserSigValidity" SG_ 395 FLR_CT11_ObservationHistory 3;
BA_ "Description" SG_ 395 FLR_CT11_QualityBits "Bitmask for quality values described by ClusterTrackQualityBits";
BA_ "UserSigValidity" SG_ 395 FLR_CT11_QualityBits 3;
BA_ "Description" SG_ 395 FLR_CT11_StationaryCounter "Counts the cycles during which the object is ground stationary (i.e. absolute velocity over ground = 0)";
BA_ "UserSigValidity" SG_ 395 FLR_CT11_StationaryCounter 3;
BA_ "Description" SG_ 395 FLR_CT11_Type "Tracked object type classification";
BA_ "UserSigValidity" SG_ 395 FLR_CT11_Type 3;
BA_ "Description" SG_ 395 FLR_CT11_X_Acceleration "X acceleration 

( Movement estimation of object ) ";
BA_ "UserSigValidity" SG_ 395 FLR_CT11_X_Acceleration 3;
BA_ "Description" SG_ 395 FLR_CT11_X_Velocity "Absolute X velocity

( Movement estimation of object ) ";
BA_ "UserSigValidity" SG_ 395 FLR_CT11_X_Velocity 3;
BA_ "Description" SG_ 395 FLR_CT11_X_VelocityStdDev "Standard deviation of X velocity

( Movement estimation of object ) ";
BA_ "UserSigValidity" SG_ 395 FLR_CT11_X_VelocityStdDev 3;
BA_ "Description" SG_ 395 FLR_CT11_Y_Acceleration "Y acceleration 

( Movement estimation of object ) ";
BA_ "UserSigValidity" SG_ 395 FLR_CT11_Y_Acceleration 3;
BA_ "Description" SG_ 395 FLR_CT11_Y_Velocity "Absolute Y velocity

( Movement estimation of object ) ";
BA_ "UserSigValidity" SG_ 395 FLR_CT11_Y_Velocity 3;
BA_ "Description" SG_ 395 FLR_CT11_Y_VelocityStdDev "Standard deviation of Y velocity

( Movement estimation of object ) ";
BA_ "UserSigValidity" SG_ 395 FLR_CT11_Y_VelocityStdDev 3;
BA_ "Description" SG_ 396 FLR_CT12_CrcVal "The CRC checking process calculates the CRC over the entire data block, including the CRC result.

- CRC Polynomial (0x1021) , Initial Value : 0xFFFF, XOR value : 0x0000

- The mathematical expression to 16 bit CRC polynomial is given here. G(x) = x16 + ";
BA_ "GenSigStartValue" SG_ 396 FLR_CT12_CrcVal 65535;
BA_ "UserSigValidity" SG_ 396 FLR_CT12_CrcVal 3;
BA_ "Description" SG_ 396 FLR_CT12_AlvCntVal "[Alive counter] For the first transmission request for a data element the counter shall be initialized with 0 and shall be incremented by 1

for every subsequent send request. When the counter reaches the maximum value(0xFF), then it shall restart with â";
BA_ "UserSigValidity" SG_ 396 FLR_CT12_AlvCntVal 3;
BA_ "Description" SG_ 396 FLR_CT12_ListIndex "List index of cluster track";
BA_ "UserSigValidity" SG_ 396 FLR_CT12_ListIndex 3;
BA_ "Description" SG_ 396 FLR_CT12_SequenceCounter "[TimeSync]Sequence counter for checking the validity of message flow sequence";
BA_ "UserSigValidity" SG_ 396 FLR_CT12_SequenceCounter 3;
BA_ "Description" SG_ 396 FLR_CT12_TimeStamp "[TimeSync]System time, synchronized through AUTOSAR TimeSync";
BA_ "UserSigValidity" SG_ 396 FLR_CT12_TimeStamp 3;
BA_ "Description" SG_ 396 FLR_CT12_Latency "[TimeSync]Sensor latency from object capture scene to object transmission";
BA_ "UserSigValidity" SG_ 396 FLR_CT12_Latency 3;
BA_ "Description" SG_ 396 FLR_CT12_ClosestPointX "Kalman filtered closest point

X position ";
BA_ "UserSigValidity" SG_ 396 FLR_CT12_ClosestPointX 3;
BA_ "Description" SG_ 396 FLR_CT12_ClosestPointXStdDev "Standard deviation of X";
BA_ "UserSigValidity" SG_ 396 FLR_CT12_ClosestPointXStdDev 3;
BA_ "Description" SG_ 396 FLR_CT12_ClosestPointY "Kalman filtered closest point

Y position ";
BA_ "UserSigValidity" SG_ 396 FLR_CT12_ClosestPointY 3;
BA_ "Description" SG_ 396 FLR_CT12_ClosestPointYStdDev "Standard deviation of Y";
BA_ "UserSigValidity" SG_ 396 FLR_CT12_ClosestPointYStdDev 3;
BA_ "Description" SG_ 396 FLR_CT12_Confidence "Object confidence used in quality manager to provide 'Objektgate' (i.e. object quality) tracked object confidence is calculated based on the normalized difference of closest detection to the track's calculated closest point, for range, angle and velocity";
BA_ "UserSigValidity" SG_ 396 FLR_CT12_Confidence 3;
BA_ "Description" SG_ 396 FLR_CT12_Elevation "Elevation of the object";
BA_ "UserSigValidity" SG_ 396 FLR_CT12_Elevation 3;
BA_ "Description" SG_ 396 FLR_CT12_ElevationConfidence "Confidence the elevation classification is correct";
BA_ "UserSigValidity" SG_ 396 FLR_CT12_ElevationConfidence 3;
BA_ "Description" SG_ 396 FLR_CT12_ExistanceProbability "Confidence tracked object existence. Currently set to the association rate [0..100] over the last 6 cycles";
BA_ "UserSigValidity" SG_ 396 FLR_CT12_ExistanceProbability 3;
BA_ "Description" SG_ 396 FLR_CT12_Lifetime "Number of cycles the target has been alive. Unknown 0

Tops out at about 6 minutes of continuous tracking.";
BA_ "UserSigValidity" SG_ 396 FLR_CT12_Lifetime 3;
BA_ "Description" SG_ 396 FLR_CT12_ModelBoxHeading "Heading of object

( Box model describing the object )";
BA_ "UserSigValidity" SG_ 396 FLR_CT12_ModelBoxHeading 3;
BA_ "Description" SG_ 396 FLR_CT12_ModelBoxLength "Length of the object

( Box model describing the object )";
BA_ "UserSigValidity" SG_ 396 FLR_CT12_ModelBoxLength 3;
BA_ "Description" SG_ 396 FLR_CT12_ModelBoxWidth "Width of the object

( Box model describing the object )";
BA_ "UserSigValidity" SG_ 396 FLR_CT12_ModelBoxWidth 3;
BA_ "Description" SG_ 396 FLR_CT12_ModelBoxX "X position, center of box

( Box model describing the object )";
BA_ "UserSigValidity" SG_ 396 FLR_CT12_ModelBoxX 3;
BA_ "Description" SG_ 396 FLR_CT12_ModelBoxY "Y position, center of box

( Box model describing the object )";
BA_ "UserSigValidity" SG_ 396 FLR_CT12_ModelBoxY 3;
BA_ "Description" SG_ 396 FLR_CT12_MotionClass "Tracked object motion classification";
BA_ "UserSigValidity" SG_ 396 FLR_CT12_MotionClass 3;
BA_ "Description" SG_ 396 FLR_CT12_ObjectId "A global ID, which is constant as long as the object is tracked. Note! A value of 0 indicates 'no object'";
BA_ "UserSigValidity" SG_ 396 FLR_CT12_ObjectId 3;
BA_ "Description" SG_ 396 FLR_CT12_ObservationHistory "Observation history of tracked object in as 32 bit-field for the last 32 cycles; for each bit: 1 = associated, 0 = not associated; LSB = most recent cycle, MSB = oldest cycle";
BA_ "UserSigValidity" SG_ 396 FLR_CT12_ObservationHistory 3;
BA_ "Description" SG_ 396 FLR_CT12_QualityBits "Bitmask for quality values described by ClusterTrackQualityBits";
BA_ "UserSigValidity" SG_ 396 FLR_CT12_QualityBits 3;
BA_ "Description" SG_ 396 FLR_CT12_StationaryCounter "Counts the cycles during which the object is ground stationary (i.e. absolute velocity over ground = 0)";
BA_ "UserSigValidity" SG_ 396 FLR_CT12_StationaryCounter 3;
BA_ "Description" SG_ 396 FLR_CT12_Type "Tracked object type classification";
BA_ "UserSigValidity" SG_ 396 FLR_CT12_Type 3;
BA_ "Description" SG_ 396 FLR_CT12_X_Acceleration "X acceleration 

( Movement estimation of object ) ";
BA_ "UserSigValidity" SG_ 396 FLR_CT12_X_Acceleration 3;
BA_ "Description" SG_ 396 FLR_CT12_X_Velocity "Absolute X velocity

( Movement estimation of object ) ";
BA_ "UserSigValidity" SG_ 396 FLR_CT12_X_Velocity 3;
BA_ "Description" SG_ 396 FLR_CT12_X_VelocityStdDev "Standard deviation of X velocity

( Movement estimation of object ) ";
BA_ "UserSigValidity" SG_ 396 FLR_CT12_X_VelocityStdDev 3;
BA_ "Description" SG_ 396 FLR_CT12_Y_Acceleration "Y acceleration 

( Movement estimation of object ) ";
BA_ "UserSigValidity" SG_ 396 FLR_CT12_Y_Acceleration 3;
BA_ "Description" SG_ 396 FLR_CT12_Y_Velocity "Absolute Y velocity

( Movement estimation of object ) ";
BA_ "UserSigValidity" SG_ 396 FLR_CT12_Y_Velocity 3;
BA_ "Description" SG_ 396 FLR_CT12_Y_VelocityStdDev "Standard deviation of Y velocity

( Movement estimation of object ) ";
BA_ "UserSigValidity" SG_ 396 FLR_CT12_Y_VelocityStdDev 3;
BA_ "Description" SG_ 397 FLR_CT13_CrcVal "The CRC checking process calculates the CRC over the entire data block, including the CRC result.

- CRC Polynomial (0x1021) , Initial Value : 0xFFFF, XOR value : 0x0000

- The mathematical expression to 16 bit CRC polynomial is given here. G(x) = x16 + ";
BA_ "GenSigStartValue" SG_ 397 FLR_CT13_CrcVal 65535;
BA_ "UserSigValidity" SG_ 397 FLR_CT13_CrcVal 3;
BA_ "Description" SG_ 397 FLR_CT13_AlvCntVal "[Alive counter] For the first transmission request for a data element the counter shall be initialized with 0 and shall be incremented by 1

for every subsequent send request. When the counter reaches the maximum value(0xFF), then it shall restart with â";
BA_ "UserSigValidity" SG_ 397 FLR_CT13_AlvCntVal 3;
BA_ "Description" SG_ 397 FLR_CT13_ListIndex "List index of cluster track";
BA_ "UserSigValidity" SG_ 397 FLR_CT13_ListIndex 3;
BA_ "Description" SG_ 397 FLR_CT13_SequenceCounter "[TimeSync]Sequence counter for checking the validity of message flow sequence";
BA_ "UserSigValidity" SG_ 397 FLR_CT13_SequenceCounter 3;
BA_ "Description" SG_ 397 FLR_CT13_TimeStamp "[TimeSync]System time, synchronized through AUTOSAR TimeSync";
BA_ "UserSigValidity" SG_ 397 FLR_CT13_TimeStamp 3;
BA_ "Description" SG_ 397 FLR_CT13_Latency "[TimeSync]Sensor latency from object capture scene to object transmission";
BA_ "UserSigValidity" SG_ 397 FLR_CT13_Latency 3;
BA_ "Description" SG_ 397 FLR_CT13_ClosestPointX "Kalman filtered closest point

X position ";
BA_ "UserSigValidity" SG_ 397 FLR_CT13_ClosestPointX 3;
BA_ "Description" SG_ 397 FLR_CT13_ClosestPointXStdDev "Standard deviation of X";
BA_ "UserSigValidity" SG_ 397 FLR_CT13_ClosestPointXStdDev 3;
BA_ "Description" SG_ 397 FLR_CT13_ClosestPointY "Kalman filtered closest point

Y position ";
BA_ "UserSigValidity" SG_ 397 FLR_CT13_ClosestPointY 3;
BA_ "Description" SG_ 397 FLR_CT13_ClosestPointYStdDev "Standard deviation of Y";
BA_ "UserSigValidity" SG_ 397 FLR_CT13_ClosestPointYStdDev 3;
BA_ "Description" SG_ 397 FLR_CT13_Confidence "Object confidence used in quality manager to provide 'Objektgate' (i.e. object quality) tracked object confidence is calculated based on the normalized difference of closest detection to the track's calculated closest point, for range, angle and velocity";
BA_ "UserSigValidity" SG_ 397 FLR_CT13_Confidence 3;
BA_ "Description" SG_ 397 FLR_CT13_Elevation "Elevation of the object";
BA_ "UserSigValidity" SG_ 397 FLR_CT13_Elevation 3;
BA_ "Description" SG_ 397 FLR_CT13_ElevationConfidence "Confidence the elevation classification is correct";
BA_ "UserSigValidity" SG_ 397 FLR_CT13_ElevationConfidence 3;
BA_ "Description" SG_ 397 FLR_CT13_ExistanceProbability "Confidence tracked object existence. Currently set to the association rate [0..100] over the last 6 cycles";
BA_ "UserSigValidity" SG_ 397 FLR_CT13_ExistanceProbability 3;
BA_ "Description" SG_ 397 FLR_CT13_Lifetime "Number of cycles the target has been alive. Unknown 0

Tops out at about 6 minutes of continuous tracking.";
BA_ "UserSigValidity" SG_ 397 FLR_CT13_Lifetime 3;
BA_ "Description" SG_ 397 FLR_CT13_ModelBoxHeading "Heading of object

( Box model describing the object )";
BA_ "UserSigValidity" SG_ 397 FLR_CT13_ModelBoxHeading 3;
BA_ "Description" SG_ 397 FLR_CT13_ModelBoxLength "Length of the object

( Box model describing the object )";
BA_ "UserSigValidity" SG_ 397 FLR_CT13_ModelBoxLength 3;
BA_ "Description" SG_ 397 FLR_CT13_ModelBoxWidth "Width of the object

( Box model describing the object )";
BA_ "UserSigValidity" SG_ 397 FLR_CT13_ModelBoxWidth 3;
BA_ "Description" SG_ 397 FLR_CT13_ModelBoxX "X position, center of box

( Box model describing the object )";
BA_ "UserSigValidity" SG_ 397 FLR_CT13_ModelBoxX 3;
BA_ "Description" SG_ 397 FLR_CT13_ModelBoxY "Y position, center of box

( Box model describing the object )";
BA_ "UserSigValidity" SG_ 397 FLR_CT13_ModelBoxY 3;
BA_ "Description" SG_ 397 FLR_CT13_MotionClass "Tracked object motion classification";
BA_ "UserSigValidity" SG_ 397 FLR_CT13_MotionClass 3;
BA_ "Description" SG_ 397 FLR_CT13_ObjectId "A global ID, which is constant as long as the object is tracked. Note! A value of 0 indicates 'no object'";
BA_ "UserSigValidity" SG_ 397 FLR_CT13_ObjectId 3;
BA_ "Description" SG_ 397 FLR_CT13_ObservationHistory "Observation history of tracked object in as 32 bit-field for the last 32 cycles; for each bit: 1 = associated, 0 = not associated; LSB = most recent cycle, MSB = oldest cycle";
BA_ "UserSigValidity" SG_ 397 FLR_CT13_ObservationHistory 3;
BA_ "Description" SG_ 397 FLR_CT13_QualityBits "Bitmask for quality values described by ClusterTrackQualityBits";
BA_ "UserSigValidity" SG_ 397 FLR_CT13_QualityBits 3;
BA_ "Description" SG_ 397 FLR_CT13_StationaryCounter "Counts the cycles during which the object is ground stationary (i.e. absolute velocity over ground = 0)";
BA_ "UserSigValidity" SG_ 397 FLR_CT13_StationaryCounter 3;
BA_ "Description" SG_ 397 FLR_CT13_Type "Tracked object type classification";
BA_ "UserSigValidity" SG_ 397 FLR_CT13_Type 3;
BA_ "Description" SG_ 397 FLR_CT13_X_Acceleration "X acceleration 

( Movement estimation of object ) ";
BA_ "UserSigValidity" SG_ 397 FLR_CT13_X_Acceleration 3;
BA_ "Description" SG_ 397 FLR_CT13_X_Velocity "Absolute X velocity

( Movement estimation of object ) ";
BA_ "UserSigValidity" SG_ 397 FLR_CT13_X_Velocity 3;
BA_ "Description" SG_ 397 FLR_CT13_X_VelocityStdDev "Standard deviation of X velocity

( Movement estimation of object ) ";
BA_ "UserSigValidity" SG_ 397 FLR_CT13_X_VelocityStdDev 3;
BA_ "Description" SG_ 397 FLR_CT13_Y_Acceleration "Y acceleration 

( Movement estimation of object ) ";
BA_ "UserSigValidity" SG_ 397 FLR_CT13_Y_Acceleration 3;
BA_ "Description" SG_ 397 FLR_CT13_Y_Velocity "Absolute Y velocity

( Movement estimation of object ) ";
BA_ "UserSigValidity" SG_ 397 FLR_CT13_Y_Velocity 3;
BA_ "Description" SG_ 397 FLR_CT13_Y_VelocityStdDev "Standard deviation of Y velocity

( Movement estimation of object ) ";
BA_ "UserSigValidity" SG_ 397 FLR_CT13_Y_VelocityStdDev 3;
BA_ "Description" SG_ 398 FLR_CT14_CrcVal "The CRC checking process calculates the CRC over the entire data block, including the CRC result.

- CRC Polynomial (0x1021) , Initial Value : 0xFFFF, XOR value : 0x0000

- The mathematical expression to 16 bit CRC polynomial is given here. G(x) = x16 + ";
BA_ "GenSigStartValue" SG_ 398 FLR_CT14_CrcVal 65535;
BA_ "UserSigValidity" SG_ 398 FLR_CT14_CrcVal 3;
BA_ "Description" SG_ 398 FLR_CT14_AlvCntVal "[Alive counter] For the first transmission request for a data element the counter shall be initialized with 0 and shall be incremented by 1

for every subsequent send request. When the counter reaches the maximum value(0xFF), then it shall restart with â";
BA_ "UserSigValidity" SG_ 398 FLR_CT14_AlvCntVal 3;
BA_ "Description" SG_ 398 FLR_CT14_ListIndex "List index of cluster track";
BA_ "UserSigValidity" SG_ 398 FLR_CT14_ListIndex 3;
BA_ "Description" SG_ 398 FLR_CT14_SequenceCounter "[TimeSync]Sequence counter for checking the validity of message flow sequence";
BA_ "UserSigValidity" SG_ 398 FLR_CT14_SequenceCounter 3;
BA_ "Description" SG_ 398 FLR_CT14_TimeStamp "[TimeSync]System time, synchronized through AUTOSAR TimeSync";
BA_ "UserSigValidity" SG_ 398 FLR_CT14_TimeStamp 3;
BA_ "Description" SG_ 398 FLR_CT14_Latency "[TimeSync]Sensor latency from object capture scene to object transmission";
BA_ "UserSigValidity" SG_ 398 FLR_CT14_Latency 3;
BA_ "Description" SG_ 398 FLR_CT14_ClosestPointX "Kalman filtered closest point

X position ";
BA_ "UserSigValidity" SG_ 398 FLR_CT14_ClosestPointX 3;
BA_ "Description" SG_ 398 FLR_CT14_ClosestPointXStdDev "Standard deviation of X";
BA_ "UserSigValidity" SG_ 398 FLR_CT14_ClosestPointXStdDev 3;
BA_ "Description" SG_ 398 FLR_CT14_ClosestPointY "Kalman filtered closest point

Y position ";
BA_ "UserSigValidity" SG_ 398 FLR_CT14_ClosestPointY 3;
BA_ "Description" SG_ 398 FLR_CT14_ClosestPointYStdDev "Standard deviation of Y";
BA_ "UserSigValidity" SG_ 398 FLR_CT14_ClosestPointYStdDev 3;
BA_ "Description" SG_ 398 FLR_CT14_Confidence "Object confidence used in quality manager to provide 'Objektgate' (i.e. object quality) tracked object confidence is calculated based on the normalized difference of closest detection to the track's calculated closest point, for range, angle and velocity";
BA_ "UserSigValidity" SG_ 398 FLR_CT14_Confidence 3;
BA_ "Description" SG_ 398 FLR_CT14_Elevation "Elevation of the object";
BA_ "UserSigValidity" SG_ 398 FLR_CT14_Elevation 3;
BA_ "Description" SG_ 398 FLR_CT14_ElevationConfidence "Confidence the elevation classification is correct";
BA_ "UserSigValidity" SG_ 398 FLR_CT14_ElevationConfidence 3;
BA_ "Description" SG_ 398 FLR_CT14_ExistanceProbability "Confidence tracked object existence. Currently set to the association rate [0..100] over the last 6 cycles";
BA_ "UserSigValidity" SG_ 398 FLR_CT14_ExistanceProbability 3;
BA_ "Description" SG_ 398 FLR_CT14_Lifetime "Number of cycles the target has been alive. Unknown 0

Tops out at about 6 minutes of continuous tracking.";
BA_ "UserSigValidity" SG_ 398 FLR_CT14_Lifetime 3;
BA_ "Description" SG_ 398 FLR_CT14_ModelBoxHeading "Heading of object

( Box model describing the object )";
BA_ "UserSigValidity" SG_ 398 FLR_CT14_ModelBoxHeading 3;
BA_ "Description" SG_ 398 FLR_CT14_ModelBoxLength "Length of the object

( Box model describing the object )";
BA_ "UserSigValidity" SG_ 398 FLR_CT14_ModelBoxLength 3;
BA_ "Description" SG_ 398 FLR_CT14_ModelBoxWidth "Width of the object

( Box model describing the object )";
BA_ "UserSigValidity" SG_ 398 FLR_CT14_ModelBoxWidth 3;
BA_ "Description" SG_ 398 FLR_CT14_ModelBoxX "X position, center of box

( Box model describing the object )";
BA_ "UserSigValidity" SG_ 398 FLR_CT14_ModelBoxX 3;
BA_ "Description" SG_ 398 FLR_CT14_ModelBoxY "Y position, center of box

( Box model describing the object )";
BA_ "UserSigValidity" SG_ 398 FLR_CT14_ModelBoxY 3;
BA_ "Description" SG_ 398 FLR_CT14_MotionClass "Tracked object motion classification";
BA_ "UserSigValidity" SG_ 398 FLR_CT14_MotionClass 3;
BA_ "Description" SG_ 398 FLR_CT14_ObjectId "A global ID, which is constant as long as the object is tracked. Note! A value of 0 indicates 'no object'";
BA_ "UserSigValidity" SG_ 398 FLR_CT14_ObjectId 3;
BA_ "Description" SG_ 398 FLR_CT14_ObservationHistory "Observation history of tracked object in as 32 bit-field for the last 32 cycles; for each bit: 1 = associated, 0 = not associated; LSB = most recent cycle, MSB = oldest cycle";
BA_ "UserSigValidity" SG_ 398 FLR_CT14_ObservationHistory 3;
BA_ "Description" SG_ 398 FLR_CT14_QualityBits "Bitmask for quality values described by ClusterTrackQualityBits";
BA_ "UserSigValidity" SG_ 398 FLR_CT14_QualityBits 3;
BA_ "Description" SG_ 398 FLR_CT14_StationaryCounter "Counts the cycles during which the object is ground stationary (i.e. absolute velocity over ground = 0)";
BA_ "UserSigValidity" SG_ 398 FLR_CT14_StationaryCounter 3;
BA_ "Description" SG_ 398 FLR_CT14_Type "Tracked object type classification";
BA_ "UserSigValidity" SG_ 398 FLR_CT14_Type 3;
BA_ "Description" SG_ 398 FLR_CT14_X_Acceleration "X acceleration 

( Movement estimation of object ) ";
BA_ "UserSigValidity" SG_ 398 FLR_CT14_X_Acceleration 3;
BA_ "Description" SG_ 398 FLR_CT14_X_Velocity "Absolute X velocity

( Movement estimation of object ) ";
BA_ "UserSigValidity" SG_ 398 FLR_CT14_X_Velocity 3;
BA_ "Description" SG_ 398 FLR_CT14_X_VelocityStdDev "Standard deviation of X velocity

( Movement estimation of object ) ";
BA_ "UserSigValidity" SG_ 398 FLR_CT14_X_VelocityStdDev 3;
BA_ "Description" SG_ 398 FLR_CT14_Y_Acceleration "Y acceleration 

( Movement estimation of object ) ";
BA_ "UserSigValidity" SG_ 398 FLR_CT14_Y_Acceleration 3;
BA_ "Description" SG_ 398 FLR_CT14_Y_Velocity "Absolute Y velocity

( Movement estimation of object ) ";
BA_ "UserSigValidity" SG_ 398 FLR_CT14_Y_Velocity 3;
BA_ "Description" SG_ 398 FLR_CT14_Y_VelocityStdDev "Standard deviation of Y velocity

( Movement estimation of object ) ";
BA_ "UserSigValidity" SG_ 398 FLR_CT14_Y_VelocityStdDev 3;
BA_ "Description" SG_ 399 FLR_CT15_CrcVal "The CRC checking process calculates the CRC over the entire data block, including the CRC result.

- CRC Polynomial (0x1021) , Initial Value : 0xFFFF, XOR value : 0x0000

- The mathematical expression to 16 bit CRC polynomial is given here. G(x) = x16 + ";
BA_ "GenSigStartValue" SG_ 399 FLR_CT15_CrcVal 65535;
BA_ "UserSigValidity" SG_ 399 FLR_CT15_CrcVal 3;
BA_ "Description" SG_ 399 FLR_CT15_AlvCntVal "[Alive counter] For the first transmission request for a data element the counter shall be initialized with 0 and shall be incremented by 1

for every subsequent send request. When the counter reaches the maximum value(0xFF), then it shall restart with â";
BA_ "UserSigValidity" SG_ 399 FLR_CT15_AlvCntVal 3;
BA_ "Description" SG_ 399 FLR_CT15_ListIndex "List index of cluster track";
BA_ "UserSigValidity" SG_ 399 FLR_CT15_ListIndex 3;
BA_ "Description" SG_ 399 FLR_CT15_SequenceCounter "[TimeSync]Sequence counter for checking the validity of message flow sequence";
BA_ "UserSigValidity" SG_ 399 FLR_CT15_SequenceCounter 3;
BA_ "Description" SG_ 399 FLR_CT15_TimeStamp "[TimeSync]System time, synchronized through AUTOSAR TimeSync";
BA_ "UserSigValidity" SG_ 399 FLR_CT15_TimeStamp 3;
BA_ "Description" SG_ 399 FLR_CT15_Latency "[TimeSync]Sensor latency from object capture scene to object transmission";
BA_ "UserSigValidity" SG_ 399 FLR_CT15_Latency 3;
BA_ "Description" SG_ 399 FLR_CT15_ClosestPointX "Kalman filtered closest point

X position ";
BA_ "UserSigValidity" SG_ 399 FLR_CT15_ClosestPointX 3;
BA_ "Description" SG_ 399 FLR_CT15_ClosestPointXStdDev "Standard deviation of X";
BA_ "UserSigValidity" SG_ 399 FLR_CT15_ClosestPointXStdDev 3;
BA_ "Description" SG_ 399 FLR_CT15_ClosestPointY "Kalman filtered closest point

Y position ";
BA_ "UserSigValidity" SG_ 399 FLR_CT15_ClosestPointY 3;
BA_ "Description" SG_ 399 FLR_CT15_ClosestPointYStdDev "Standard deviation of Y";
BA_ "UserSigValidity" SG_ 399 FLR_CT15_ClosestPointYStdDev 3;
BA_ "Description" SG_ 399 FLR_CT15_Confidence "Object confidence used in quality manager to provide 'Objektgate' (i.e. object quality) tracked object confidence is calculated based on the normalized difference of closest detection to the track's calculated closest point, for range, angle and velocity";
BA_ "UserSigValidity" SG_ 399 FLR_CT15_Confidence 3;
BA_ "Description" SG_ 399 FLR_CT15_Elevation "Elevation of the object";
BA_ "UserSigValidity" SG_ 399 FLR_CT15_Elevation 3;
BA_ "Description" SG_ 399 FLR_CT15_ElevationConfidence "Confidence the elevation classification is correct";
BA_ "UserSigValidity" SG_ 399 FLR_CT15_ElevationConfidence 3;
BA_ "Description" SG_ 399 FLR_CT15_ExistanceProbability "Confidence tracked object existence. Currently set to the association rate [0..100] over the last 6 cycles";
BA_ "UserSigValidity" SG_ 399 FLR_CT15_ExistanceProbability 3;
BA_ "Description" SG_ 399 FLR_CT15_Lifetime "Number of cycles the target has been alive. Unknown 0

Tops out at about 6 minutes of continuous tracking.";
BA_ "UserSigValidity" SG_ 399 FLR_CT15_Lifetime 3;
BA_ "Description" SG_ 399 FLR_CT15_ModelBoxHeading "Heading of object

( Box model describing the object )";
BA_ "UserSigValidity" SG_ 399 FLR_CT15_ModelBoxHeading 3;
BA_ "Description" SG_ 399 FLR_CT15_ModelBoxLength "Length of the object

( Box model describing the object )";
BA_ "UserSigValidity" SG_ 399 FLR_CT15_ModelBoxLength 3;
BA_ "Description" SG_ 399 FLR_CT15_ModelBoxWidth "Width of the object

( Box model describing the object )";
BA_ "UserSigValidity" SG_ 399 FLR_CT15_ModelBoxWidth 3;
BA_ "Description" SG_ 399 FLR_CT15_ModelBoxX "X position, center of box

( Box model describing the object )";
BA_ "UserSigValidity" SG_ 399 FLR_CT15_ModelBoxX 3;
BA_ "Description" SG_ 399 FLR_CT15_ModelBoxY "Y position, center of box

( Box model describing the object )";
BA_ "UserSigValidity" SG_ 399 FLR_CT15_ModelBoxY 3;
BA_ "Description" SG_ 399 FLR_CT15_MotionClass "Tracked object motion classification";
BA_ "UserSigValidity" SG_ 399 FLR_CT15_MotionClass 3;
BA_ "Description" SG_ 399 FLR_CT15_ObjectId "A global ID, which is constant as long as the object is tracked. Note! A value of 0 indicates 'no object'";
BA_ "UserSigValidity" SG_ 399 FLR_CT15_ObjectId 3;
BA_ "Description" SG_ 399 FLR_CT15_ObservationHistory "Observation history of tracked object in as 32 bit-field for the last 32 cycles; for each bit: 1 = associated, 0 = not associated; LSB = most recent cycle, MSB = oldest cycle";
BA_ "UserSigValidity" SG_ 399 FLR_CT15_ObservationHistory 3;
BA_ "Description" SG_ 399 FLR_CT15_QualityBits "Bitmask for quality values described by ClusterTrackQualityBits";
BA_ "UserSigValidity" SG_ 399 FLR_CT15_QualityBits 3;
BA_ "Description" SG_ 399 FLR_CT15_StationaryCounter "Counts the cycles during which the object is ground stationary (i.e. absolute velocity over ground = 0)";
BA_ "UserSigValidity" SG_ 399 FLR_CT15_StationaryCounter 3;
BA_ "Description" SG_ 399 FLR_CT15_Type "Tracked object type classification";
BA_ "UserSigValidity" SG_ 399 FLR_CT15_Type 3;
BA_ "Description" SG_ 399 FLR_CT15_X_Acceleration "X acceleration 

( Movement estimation of object ) ";
BA_ "UserSigValidity" SG_ 399 FLR_CT15_X_Acceleration 3;
BA_ "Description" SG_ 399 FLR_CT15_X_Velocity "Absolute X velocity

( Movement estimation of object ) ";
BA_ "UserSigValidity" SG_ 399 FLR_CT15_X_Velocity 3;
BA_ "Description" SG_ 399 FLR_CT15_X_VelocityStdDev "Standard deviation of X velocity

( Movement estimation of object ) ";
BA_ "UserSigValidity" SG_ 399 FLR_CT15_X_VelocityStdDev 3;
BA_ "Description" SG_ 399 FLR_CT15_Y_Acceleration "Y acceleration 

( Movement estimation of object ) ";
BA_ "UserSigValidity" SG_ 399 FLR_CT15_Y_Acceleration 3;
BA_ "Description" SG_ 399 FLR_CT15_Y_Velocity "Absolute Y velocity

( Movement estimation of object ) ";
BA_ "UserSigValidity" SG_ 399 FLR_CT15_Y_Velocity 3;
BA_ "Description" SG_ 399 FLR_CT15_Y_VelocityStdDev "Standard deviation of Y velocity

( Movement estimation of object ) ";
BA_ "UserSigValidity" SG_ 399 FLR_CT15_Y_VelocityStdDev 3;
VAL_ 384 FLR_CT0_Confidence 0 " Unknown" 1 " LoConfidence" 2 " MedConfidence" 3 " HiConfidence" ;
VAL_ 384 FLR_CT0_Elevation 0 " Unknown" 1 " Overridable" 2 " Relevant" 3 " Underridable" ;
VAL_ 384 FLR_CT0_ElevationConfidence 0 " Unknown" 1 " LoConfidence" 2 " MedConfidence" 3 " HiConfidence" ;
VAL_ 384 FLR_CT0_MotionClass 0 " Unknown" 1 " Stationary" 2 " Moving" 3 " Stopped" ;
VAL_ 384 FLR_CT0_QualityBits 0 " Sliding" 1 " Fused" 2 " ConfirmedByRspTracker" 3 " InsideFreespace" 4 " OutsideStationaryCloud" 5 " InsideRearBorder" 6 " AssociatedWithGoodDetection" 7 " Ghost" 8 " MirrorGhost" 9 " EgoMirrorGhost" 10 " GhostFromTrackGuardrail" 11 " OutsideFreespaceGhost" 12 " RoofGhost" 13 " TunnelMirrorGhost" 14 " CompanionGhost" 15 " AngleJumpCoasting" 16 " Occluded" 17 " GoodQuality" ;
VAL_ 384 FLR_CT0_Type 0 " Unknown" 1 " Car" 2 " Bicycle" 3 " Pedestrian" 4 " Motorcycle" 5 " Truck" 6 " Animal" 7 " Group2Pedestrians" 8 " GroupMultiplePedestrians" ;
VAL_ 385 FLR_CT1_Confidence 0 " Unknown" 1 " LoConfidence" 2 " MedConfidence" 3 " HiConfidence" ;
VAL_ 385 FLR_CT1_Elevation 0 " Unknown" 1 " Overridable" 2 " Relevant" 3 " Underridable" ;
VAL_ 385 FLR_CT1_ElevationConfidence 0 " Unknown" 1 " LoConfidence" 2 " MedConfidence" 3 " HiConfidence" ;
VAL_ 385 FLR_CT1_MotionClass 0 " Unknown" 1 " Stationary" 2 " Moving" 3 " Stopped" ;
VAL_ 385 FLR_CT1_QualityBits 0 " Sliding" 1 " Fused" 2 " ConfirmedByRspTracker" 3 " InsideFreespace" 4 " OutsideStationaryCloud" 5 " InsideRearBorder" 6 " AssociatedWithGoodDetection" 7 " Ghost" 8 " MirrorGhost" 9 " EgoMirrorGhost" 10 " GhostFromTrackGuardrail" 11 " OutsideFreespaceGhost" 12 " RoofGhost" 13 " TunnelMirrorGhost" 14 " CompanionGhost" 15 " AngleJumpCoasting" 16 " Occluded" 17 " GoodQuality" ;
VAL_ 385 FLR_CT1_Type 0 " Unknown" 1 " Car" 2 " Bicycle" 3 " Pedestrian" 4 " Motorcycle" 5 " Truck" 6 " Animal" 7 " Group2Pedestrians" 8 " GroupMultiplePedestrians" ;
VAL_ 386 FLR_CT2_Confidence 0 " Unknown" 1 " LoConfidence" 2 " MedConfidence" 3 " HiConfidence" ;
VAL_ 386 FLR_CT2_Elevation 0 " Unknown" 1 " Overridable" 2 " Relevant" 3 " Underridable" ;
VAL_ 386 FLR_CT2_ElevationConfidence 0 " Unknown" 1 " LoConfidence" 2 " MedConfidence" 3 " HiConfidence" ;
VAL_ 386 FLR_CT2_MotionClass 0 " Unknown" 1 " Stationary" 2 " Moving" 3 " Stopped" ;
VAL_ 386 FLR_CT2_QualityBits 0 " Sliding" 1 " Fused" 2 " ConfirmedByRspTracker" 3 " InsideFreespace" 4 " OutsideStationaryCloud" 5 " InsideRearBorder" 6 " AssociatedWithGoodDetection" 7 " Ghost" 8 " MirrorGhost" 9 " EgoMirrorGhost" 10 " GhostFromTrackGuardrail" 11 " OutsideFreespaceGhost" 12 " RoofGhost" 13 " TunnelMirrorGhost" 14 " CompanionGhost" 15 " AngleJumpCoasting" 16 " Occluded" 17 " GoodQuality" ;
VAL_ 386 FLR_CT2_Type 0 " Unknown" 1 " Car" 2 " Bicycle" 3 " Pedestrian" 4 " Motorcycle" 5 " Truck" 6 " Animal" 7 " Group2Pedestrians" 8 " GroupMultiplePedestrians" ;
VAL_ 387 FLR_CT3_Confidence 0 " Unknown" 1 " LoConfidence" 2 " MedConfidence" 3 " HiConfidence" ;
VAL_ 387 FLR_CT3_Elevation 0 " Unknown" 1 " Overridable" 2 " Relevant" 3 " Underridable" ;
VAL_ 387 FLR_CT3_ElevationConfidence 0 " Unknown" 1 " LoConfidence" 2 " MedConfidence" 3 " HiConfidence" ;
VAL_ 387 FLR_CT3_MotionClass 0 " Unknown" 1 " Stationary" 2 " Moving" 3 " Stopped" ;
VAL_ 387 FLR_CT3_QualityBits 0 " Sliding" 1 " Fused" 2 " ConfirmedByRspTracker" 3 " InsideFreespace" 4 " OutsideStationaryCloud" 5 " InsideRearBorder" 6 " AssociatedWithGoodDetection" 7 " Ghost" 8 " MirrorGhost" 9 " EgoMirrorGhost" 10 " GhostFromTrackGuardrail" 11 " OutsideFreespaceGhost" 12 " RoofGhost" 13 " TunnelMirrorGhost" 14 " CompanionGhost" 15 " AngleJumpCoasting" 16 " Occluded" 17 " GoodQuality" ;
VAL_ 387 FLR_CT3_Type 0 " Unknown" 1 " Car" 2 " Bicycle" 3 " Pedestrian" 4 " Motorcycle" 5 " Truck" 6 " Animal" 7 " Group2Pedestrians" 8 " GroupMultiplePedestrians" ;
VAL_ 388 FLR_CT4_Confidence 0 " Unknown" 1 " LoConfidence" 2 " MedConfidence" 3 " HiConfidence" ;
VAL_ 388 FLR_CT4_Elevation 0 " Unknown" 1 " Overridable" 2 " Relevant" 3 " Underridable" ;
VAL_ 388 FLR_CT4_ElevationConfidence 0 " Unknown" 1 " LoConfidence" 2 " MedConfidence" 3 " HiConfidence" ;
VAL_ 388 FLR_CT4_MotionClass 0 " Unknown" 1 " Stationary" 2 " Moving" 3 " Stopped" ;
VAL_ 388 FLR_CT4_QualityBits 0 " Sliding" 1 " Fused" 2 " ConfirmedByRspTracker" 3 " InsideFreespace" 4 " OutsideStationaryCloud" 5 " InsideRearBorder" 6 " AssociatedWithGoodDetection" 7 " Ghost" 8 " MirrorGhost" 9 " EgoMirrorGhost" 10 " GhostFromTrackGuardrail" 11 " OutsideFreespaceGhost" 12 " RoofGhost" 13 " TunnelMirrorGhost" 14 " CompanionGhost" 15 " AngleJumpCoasting" 16 " Occluded" 17 " GoodQuality" ;
VAL_ 388 FLR_CT4_Type 0 " Unknown" 1 " Car" 2 " Bicycle" 3 " Pedestrian" 4 " Motorcycle" 5 " Truck" 6 " Animal" 7 " Group2Pedestrians" 8 " GroupMultiplePedestrians" ;
VAL_ 389 FLR_CT5_Confidence 0 " Unknown" 1 " LoConfidence" 2 " MedConfidence" 3 " HiConfidence" ;
VAL_ 389 FLR_CT5_Elevation 0 " Unknown" 1 " Overridable" 2 " Relevant" 3 " Underridable" ;
VAL_ 389 FLR_CT5_ElevationConfidence 0 " Unknown" 1 " LoConfidence" 2 " MedConfidence" 3 " HiConfidence" ;
VAL_ 389 FLR_CT5_MotionClass 0 " Unknown" 1 " Stationary" 2 " Moving" 3 " Stopped" ;
VAL_ 389 FLR_CT5_QualityBits 0 " Sliding" 1 " Fused" 2 " ConfirmedByRspTracker" 3 " InsideFreespace" 4 " OutsideStationaryCloud" 5 " InsideRearBorder" 6 " AssociatedWithGoodDetection" 7 " Ghost" 8 " MirrorGhost" 9 " EgoMirrorGhost" 10 " GhostFromTrackGuardrail" 11 " OutsideFreespaceGhost" 12 " RoofGhost" 13 " TunnelMirrorGhost" 14 " CompanionGhost" 15 " AngleJumpCoasting" 16 " Occluded" 17 " GoodQuality" ;
VAL_ 389 FLR_CT5_Type 0 " Unknown" 1 " Car" 2 " Bicycle" 3 " Pedestrian" 4 " Motorcycle" 5 " Truck" 6 " Animal" 7 " Group2Pedestrians" 8 " GroupMultiplePedestrians" ;
VAL_ 390 FLR_CT6_Confidence 0 " Unknown" 1 " LoConfidence" 2 " MedConfidence" 3 " HiConfidence" ;
VAL_ 390 FLR_CT6_Elevation 0 " Unknown" 1 " Overridable" 2 " Relevant" 3 " Underridable" ;
VAL_ 390 FLR_CT6_ElevationConfidence 0 " Unknown" 1 " LoConfidence" 2 " MedConfidence" 3 " HiConfidence" ;
VAL_ 390 FLR_CT6_MotionClass 0 " Unknown" 1 " Stationary" 2 " Moving" 3 " Stopped" ;
VAL_ 390 FLR_CT6_QualityBits 0 " Sliding" 1 " Fused" 2 " ConfirmedByRspTracker" 3 " InsideFreespace" 4 " OutsideStationaryCloud" 5 " InsideRearBorder" 6 " AssociatedWithGoodDetection" 7 " Ghost" 8 " MirrorGhost" 9 " EgoMirrorGhost" 10 " GhostFromTrackGuardrail" 11 " OutsideFreespaceGhost" 12 " RoofGhost" 13 " TunnelMirrorGhost" 14 " CompanionGhost" 15 " AngleJumpCoasting" 16 " Occluded" 17 " GoodQuality" ;
VAL_ 390 FLR_CT6_Type 0 " Unknown" 1 " Car" 2 " Bicycle" 3 " Pedestrian" 4 " Motorcycle" 5 " Truck" 6 " Animal" 7 " Group2Pedestrians" 8 " GroupMultiplePedestrians" ;
VAL_ 391 FLR_CT7_Confidence 0 " Unknown" 1 " LoConfidence" 2 " MedConfidence" 3 " HiConfidence" ;
VAL_ 391 FLR_CT7_Elevation 0 " Unknown" 1 " Overridable" 2 " Relevant" 3 " Underridable" ;
VAL_ 391 FLR_CT7_ElevationConfidence 0 " Unknown" 1 " LoConfidence" 2 " MedConfidence" 3 " HiConfidence" ;
VAL_ 391 FLR_CT7_MotionClass 0 " Unknown" 1 " Stationary" 2 " Moving" 3 " Stopped" ;
VAL_ 391 FLR_CT7_QualityBits 0 " Sliding" 1 " Fused" 2 " ConfirmedByRspTracker" 3 " InsideFreespace" 4 " OutsideStationaryCloud" 5 " InsideRearBorder" 6 " AssociatedWithGoodDetection" 7 " Ghost" 8 " MirrorGhost" 9 " EgoMirrorGhost" 10 " GhostFromTrackGuardrail" 11 " OutsideFreespaceGhost" 12 " RoofGhost" 13 " TunnelMirrorGhost" 14 " CompanionGhost" 15 " AngleJumpCoasting" 16 " Occluded" 17 " GoodQuality" ;
VAL_ 391 FLR_CT7_Type 0 " Unknown" 1 " Car" 2 " Bicycle" 3 " Pedestrian" 4 " Motorcycle" 5 " Truck" 6 " Animal" 7 " Group2Pedestrians" 8 " GroupMultiplePedestrians" ;
VAL_ 392 FLR_CT8_Confidence 0 " Unknown" 1 " LoConfidence" 2 " MedConfidence" 3 " HiConfidence" ;
VAL_ 392 FLR_CT8_Elevation 0 " Unknown" 1 " Overridable" 2 " Relevant" 3 " Underridable" ;
VAL_ 392 FLR_CT8_ElevationConfidence 0 " Unknown" 1 " LoConfidence" 2 " MedConfidence" 3 " HiConfidence" ;
VAL_ 392 FLR_CT8_MotionClass 0 " Unknown" 1 " Stationary" 2 " Moving" 3 " Stopped" ;
VAL_ 392 FLR_CT8_QualityBits 0 " Sliding" 1 " Fused" 2 " ConfirmedByRspTracker" 3 " InsideFreespace" 4 " OutsideStationaryCloud" 5 " InsideRearBorder" 6 " AssociatedWithGoodDetection" 7 " Ghost" 8 " MirrorGhost" 9 " EgoMirrorGhost" 10 " GhostFromTrackGuardrail" 11 " OutsideFreespaceGhost" 12 " RoofGhost" 13 " TunnelMirrorGhost" 14 " CompanionGhost" 15 " AngleJumpCoasting" 16 " Occluded" 17 " GoodQuality" ;
VAL_ 392 FLR_CT8_Type 0 " Unknown" 1 " Car" 2 " Bicycle" 3 " Pedestrian" 4 " Motorcycle" 5 " Truck" 6 " Animal" 7 " Group2Pedestrians" 8 " GroupMultiplePedestrians" ;
VAL_ 393 FLR_CT9_Confidence 0 " Unknown" 1 " LoConfidence" 2 " MedConfidence" 3 " HiConfidence" ;
VAL_ 393 FLR_CT9_Elevation 0 " Unknown" 1 " Overridable" 2 " Relevant" 3 " Underridable" ;
VAL_ 393 FLR_CT9_ElevationConfidence 0 " Unknown" 1 " LoConfidence" 2 " MedConfidence" 3 " HiConfidence" ;
VAL_ 393 FLR_CT9_MotionClass 0 " Unknown" 1 " Stationary" 2 " Moving" 3 " Stopped" ;
VAL_ 393 FLR_CT9_QualityBits 0 " Sliding" 1 " Fused" 2 " ConfirmedByRspTracker" 3 " InsideFreespace" 4 " OutsideStationaryCloud" 5 " InsideRearBorder" 6 " AssociatedWithGoodDetection" 7 " Ghost" 8 " MirrorGhost" 9 " EgoMirrorGhost" 10 " GhostFromTrackGuardrail" 11 " OutsideFreespaceGhost" 12 " RoofGhost" 13 " TunnelMirrorGhost" 14 " CompanionGhost" 15 " AngleJumpCoasting" 16 " Occluded" 17 " GoodQuality" ;
VAL_ 393 FLR_CT9_Type 0 " Unknown" 1 " Car" 2 " Bicycle" 3 " Pedestrian" 4 " Motorcycle" 5 " Truck" 6 " Animal" 7 " Group2Pedestrians" 8 " GroupMultiplePedestrians" ;
VAL_ 394 FLR_CT10_Confidence 0 " Unknown" 1 " LoConfidence" 2 " MedConfidence" 3 " HiConfidence" ;
VAL_ 394 FLR_CT10_Elevation 0 " Unknown" 1 " Overridable" 2 " Relevant" 3 " Underridable" ;
VAL_ 394 FLR_CT10_ElevationConfidence 0 " Unknown" 1 " LoConfidence" 2 " MedConfidence" 3 " HiConfidence" ;
VAL_ 394 FLR_CT10_MotionClass 0 " Unknown" 1 " Stationary" 2 " Moving" 3 " Stopped" ;
VAL_ 394 FLR_CT10_QualityBits 0 " Sliding" 1 " Fused" 2 " ConfirmedByRspTracker" 3 " InsideFreespace" 4 " OutsideStationaryCloud" 5 " InsideRearBorder" 6 " AssociatedWithGoodDetection" 7 " Ghost" 8 " MirrorGhost" 9 " EgoMirrorGhost" 10 " GhostFromTrackGuardrail" 11 " OutsideFreespaceGhost" 12 " RoofGhost" 13 " TunnelMirrorGhost" 14 " CompanionGhost" 15 " AngleJumpCoasting" 16 " Occluded" 17 " GoodQuality" ;
VAL_ 394 FLR_CT10_Type 0 " Unknown" 1 " Car" 2 " Bicycle" 3 " Pedestrian" 4 " Motorcycle" 5 " Truck" 6 " Animal" 7 " Group2Pedestrians" 8 " GroupMultiplePedestrians" ;
VAL_ 395 FLR_CT11_Confidence 0 " Unknown" 1 " LoConfidence" 2 " MedConfidence" 3 " HiConfidence" ;
VAL_ 395 FLR_CT11_Elevation 0 " Unknown" 1 " Overridable" 2 " Relevant" 3 " Underridable" ;
VAL_ 395 FLR_CT11_ElevationConfidence 0 " Unknown" 1 " LoConfidence" 2 " MedConfidence" 3 " HiConfidence" ;
VAL_ 395 FLR_CT11_MotionClass 0 " Unknown" 1 " Stationary" 2 " Moving" 3 " Stopped" ;
VAL_ 395 FLR_CT11_QualityBits 0 " Sliding" 1 " Fused" 2 " ConfirmedByRspTracker" 3 " InsideFreespace" 4 " OutsideStationaryCloud" 5 " InsideRearBorder" 6 " AssociatedWithGoodDetection" 7 " Ghost" 8 " MirrorGhost" 9 " EgoMirrorGhost" 10 " GhostFromTrackGuardrail" 11 " OutsideFreespaceGhost" 12 " RoofGhost" 13 " TunnelMirrorGhost" 14 " CompanionGhost" 15 " AngleJumpCoasting" 16 " Occluded" 17 " GoodQuality" ;
VAL_ 395 FLR_CT11_Type 0 " Unknown" 1 " Car" 2 " Bicycle" 3 " Pedestrian" 4 " Motorcycle" 5 " Truck" 6 " Animal" 7 " Group2Pedestrians" 8 " GroupMultiplePedestrians" ;
VAL_ 396 FLR_CT12_Confidence 0 " Unknown" 1 " LoConfidence" 2 " MedConfidence" 3 " HiConfidence" ;
VAL_ 396 FLR_CT12_Elevation 0 " Unknown" 1 " Overridable" 2 " Relevant" 3 " Underridable" ;
VAL_ 396 FLR_CT12_ElevationConfidence 0 " Unknown" 1 " LoConfidence" 2 " MedConfidence" 3 " HiConfidence" ;
VAL_ 396 FLR_CT12_MotionClass 0 " Unknown" 1 " Stationary" 2 " Moving" 3 " Stopped" ;
VAL_ 396 FLR_CT12_QualityBits 0 " Sliding" 1 " Fused" 2 " ConfirmedByRspTracker" 3 " InsideFreespace" 4 " OutsideStationaryCloud" 5 " InsideRearBorder" 6 " AssociatedWithGoodDetection" 7 " Ghost" 8 " MirrorGhost" 9 " EgoMirrorGhost" 10 " GhostFromTrackGuardrail" 11 " OutsideFreespaceGhost" 12 " RoofGhost" 13 " TunnelMirrorGhost" 14 " CompanionGhost" 15 " AngleJumpCoasting" 16 " Occluded" 17 " GoodQuality" ;
VAL_ 396 FLR_CT12_Type 0 " Unknown" 1 " Car" 2 " Bicycle" 3 " Pedestrian" 4 " Motorcycle" 5 " Truck" 6 " Animal" 7 " Group2Pedestrians" 8 " GroupMultiplePedestrians" ;
VAL_ 397 FLR_CT13_Confidence 0 " Unknown" 1 " LoConfidence" 2 " MedConfidence" 3 " HiConfidence" ;
VAL_ 397 FLR_CT13_Elevation 0 " Unknown" 1 " Overridable" 2 " Relevant" 3 " Underridable" ;
VAL_ 397 FLR_CT13_ElevationConfidence 0 " Unknown" 1 " LoConfidence" 2 " MedConfidence" 3 " HiConfidence" ;
VAL_ 397 FLR_CT13_MotionClass 0 " Unknown" 1 " Stationary" 2 " Moving" 3 " Stopped" ;
VAL_ 397 FLR_CT13_QualityBits 0 " Sliding" 1 " Fused" 2 " ConfirmedByRspTracker" 3 " InsideFreespace" 4 " OutsideStationaryCloud" 5 " InsideRearBorder" 6 " AssociatedWithGoodDetection" 7 " Ghost" 8 " MirrorGhost" 9 " EgoMirrorGhost" 10 " GhostFromTrackGuardrail" 11 " OutsideFreespaceGhost" 12 " RoofGhost" 13 " TunnelMirrorGhost" 14 " CompanionGhost" 15 " AngleJumpCoasting" 16 " Occluded" 17 " GoodQuality" ;
VAL_ 397 FLR_CT13_Type 0 " Unknown" 1 " Car" 2 " Bicycle" 3 " Pedestrian" 4 " Motorcycle" 5 " Truck" 6 " Animal" 7 " Group2Pedestrians" 8 " GroupMultiplePedestrians" ;
VAL_ 398 FLR_CT14_Confidence 0 " Unknown" 1 " LoConfidence" 2 " MedConfidence" 3 " HiConfidence" ;
VAL_ 398 FLR_CT14_Elevation 0 " Unknown" 1 " Overridable" 2 " Relevant" 3 " Underridable" ;
VAL_ 398 FLR_CT14_ElevationConfidence 0 " Unknown" 1 " LoConfidence" 2 " MedConfidence" 3 " HiConfidence" ;
VAL_ 398 FLR_CT14_MotionClass 0 " Unknown" 1 " Stationary" 2 " Moving" 3 " Stopped" ;
VAL_ 398 FLR_CT14_QualityBits 0 " Sliding" 1 " Fused" 2 " ConfirmedByRspTracker" 3 " InsideFreespace" 4 " OutsideStationaryCloud" 5 " InsideRearBorder" 6 " AssociatedWithGoodDetection" 7 " Ghost" 8 " MirrorGhost" 9 " EgoMirrorGhost" 10 " GhostFromTrackGuardrail" 11 " OutsideFreespaceGhost" 12 " RoofGhost" 13 " TunnelMirrorGhost" 14 " CompanionGhost" 15 " AngleJumpCoasting" 16 " Occluded" 17 " GoodQuality" ;
VAL_ 398 FLR_CT14_Type 0 " Unknown" 1 " Car" 2 " Bicycle" 3 " Pedestrian" 4 " Motorcycle" 5 " Truck" 6 " Animal" 7 " Group2Pedestrians" 8 " GroupMultiplePedestrians" ;
VAL_ 399 FLR_CT15_Confidence 0 " Unknown" 1 " LoConfidence" 2 " MedConfidence" 3 " HiConfidence" ;
VAL_ 399 FLR_CT15_Elevation 0 " Unknown" 1 " Overridable" 2 " Relevant" 3 " Underridable" ;
VAL_ 399 FLR_CT15_ElevationConfidence 0 " Unknown" 1 " LoConfidence" 2 " MedConfidence" 3 " HiConfidence" ;
VAL_ 399 FLR_CT15_MotionClass 0 " Unknown" 1 " Stationary" 2 " Moving" 3 " Stopped" ;
VAL_ 399 FLR_CT15_QualityBits 0 " Sliding" 1 " Fused" 2 " ConfirmedByRspTracker" 3 " InsideFreespace" 4 " OutsideStationaryCloud" 5 " InsideRearBorder" 6 " AssociatedWithGoodDetection" 7 " Ghost" 8 " MirrorGhost" 9 " EgoMirrorGhost" 10 " GhostFromTrackGuardrail" 11 " OutsideFreespaceGhost" 12 " RoofGhost" 13 " TunnelMirrorGhost" 14 " CompanionGhost" 15 " AngleJumpCoasting" 16 " Occluded" 17 " GoodQuality" ;
VAL_ 399 FLR_CT15_Type 0 " Unknown" 1 " Car" 2 " Bicycle" 3 " Pedestrian" 4 " Motorcycle" 5 " Truck" 6 " Animal" 7 " Group2Pedestrians" 8 " GroupMultiplePedestrians" ;
SIG_GROUP_ 384 L_FR_RDR_ClusterTrack0_50ms 1 : FLR_CT0_CrcVal FLR_CT0_AlvCntVal FLR_CT0_ListIndex FLR_CT0_SequenceCounter FLR_CT0_TimeStamp FLR_CT0_Latency FLR_CT0_ClosestPointX FLR_CT0_ClosestPointXStdDev FLR_CT0_ClosestPointY FLR_CT0_ClosestPointYStdDev FLR_CT0_Confidence FLR_CT0_Elevation FLR_CT0_ElevationConfidence FLR_CT0_ExistanceProbability FLR_CT0_Lifetime FLR_CT0_ModelBoxHeading FLR_CT0_ModelBoxLength FLR_CT0_ModelBoxWidth FLR_CT0_ModelBoxX FLR_CT0_ModelBoxY FLR_CT0_MotionClass FLR_CT0_ObjectId FLR_CT0_ObservationHistory FLR_CT0_QualityBits FLR_CT0_StationaryCounter FLR_CT0_Type FLR_CT0_X_Acceleration FLR_CT0_X_Velocity FLR_CT0_X_VelocityStdDev FLR_CT0_Y_Acceleration FLR_CT0_Y_Velocity FLR_CT0_Y_VelocityStdDev;
SIG_GROUP_ 385 L_FR_RDR_ClusterTrack1_50ms 1 : FLR_CT1_CrcVal FLR_CT1_AlvCntVal FLR_CT1_ListIndex FLR_CT1_SequenceCounter FLR_CT1_TimeStamp FLR_CT1_Latency FLR_CT1_ClosestPointX FLR_CT1_ClosestPointXStdDev FLR_CT1_ClosestPointY FLR_CT1_ClosestPointYStdDev FLR_CT1_Confidence FLR_CT1_Elevation FLR_CT1_ElevationConfidence FLR_CT1_ExistanceProbability FLR_CT1_Lifetime FLR_CT1_ModelBoxHeading FLR_CT1_ModelBoxLength FLR_CT1_ModelBoxWidth FLR_CT1_ModelBoxX FLR_CT1_ModelBoxY FLR_CT1_MotionClass FLR_CT1_ObjectId FLR_CT1_ObservationHistory FLR_CT1_QualityBits FLR_CT1_StationaryCounter FLR_CT1_Type FLR_CT1_X_Acceleration FLR_CT1_X_Velocity FLR_CT1_X_VelocityStdDev FLR_CT1_Y_Acceleration FLR_CT1_Y_Velocity FLR_CT1_Y_VelocityStdDev;
SIG_GROUP_ 386 L_FR_RDR_ClusterTrack2_50ms 1 : FLR_CT2_CrcVal FLR_CT2_AlvCntVal FLR_CT2_ListIndex FLR_CT2_SequenceCounter FLR_CT2_TimeStamp FLR_CT2_Latency FLR_CT2_ClosestPointX FLR_CT2_ClosestPointXStdDev FLR_CT2_ClosestPointY FLR_CT2_ClosestPointYStdDev FLR_CT2_Confidence FLR_CT2_Elevation FLR_CT2_ElevationConfidence FLR_CT2_ExistanceProbability FLR_CT2_Lifetime FLR_CT2_ModelBoxHeading FLR_CT2_ModelBoxLength FLR_CT2_ModelBoxWidth FLR_CT2_ModelBoxX FLR_CT2_ModelBoxY FLR_CT2_MotionClass FLR_CT2_ObjectId FLR_CT2_ObservationHistory FLR_CT2_QualityBits FLR_CT2_StationaryCounter FLR_CT2_Type FLR_CT2_X_Acceleration FLR_CT2_X_Velocity FLR_CT2_X_VelocityStdDev FLR_CT2_Y_Acceleration FLR_CT2_Y_Velocity FLR_CT2_Y_VelocityStdDev;
SIG_GROUP_ 387 L_FR_RDR_ClusterTrack3_50ms 1 : FLR_CT3_CrcVal FLR_CT3_AlvCntVal FLR_CT3_ListIndex FLR_CT3_SequenceCounter FLR_CT3_TimeStamp FLR_CT3_Latency FLR_CT3_ClosestPointX FLR_CT3_ClosestPointXStdDev FLR_CT3_ClosestPointY FLR_CT3_ClosestPointYStdDev FLR_CT3_Confidence FLR_CT3_Elevation FLR_CT3_ElevationConfidence FLR_CT3_ExistanceProbability FLR_CT3_Lifetime FLR_CT3_ModelBoxHeading FLR_CT3_ModelBoxLength FLR_CT3_ModelBoxWidth FLR_CT3_ModelBoxX FLR_CT3_ModelBoxY FLR_CT3_MotionClass FLR_CT3_ObjectId FLR_CT3_ObservationHistory FLR_CT3_QualityBits FLR_CT3_StationaryCounter FLR_CT3_Type FLR_CT3_X_Acceleration FLR_CT3_X_Velocity FLR_CT3_X_VelocityStdDev FLR_CT3_Y_Acceleration FLR_CT3_Y_Velocity FLR_CT3_Y_VelocityStdDev;
SIG_GROUP_ 388 L_FR_RDR_ClusterTrack4_50ms 1 : FLR_CT4_CrcVal FLR_CT4_AlvCntVal FLR_CT4_ListIndex FLR_CT4_SequenceCounter FLR_CT4_TimeStamp FLR_CT4_Latency FLR_CT4_ClosestPointX FLR_CT4_ClosestPointXStdDev FLR_CT4_ClosestPointY FLR_CT4_ClosestPointYStdDev FLR_CT4_Confidence FLR_CT4_Elevation FLR_CT4_ElevationConfidence FLR_CT4_ExistanceProbability FLR_CT4_Lifetime FLR_CT4_ModelBoxHeading FLR_CT4_ModelBoxLength FLR_CT4_ModelBoxWidth FLR_CT4_ModelBoxX FLR_CT4_ModelBoxY FLR_CT4_MotionClass FLR_CT4_ObjectId FLR_CT4_ObservationHistory FLR_CT4_QualityBits FLR_CT4_StationaryCounter FLR_CT4_Type FLR_CT4_X_Acceleration FLR_CT4_X_Velocity FLR_CT4_X_VelocityStdDev FLR_CT4_Y_Acceleration FLR_CT4_Y_Velocity FLR_CT4_Y_VelocityStdDev;
SIG_GROUP_ 389 L_FR_RDR_ClusterTrack5_50ms 1 : FLR_CT5_CrcVal FLR_CT5_AlvCntVal FLR_CT5_ListIndex FLR_CT5_SequenceCounter FLR_CT5_TimeStamp FLR_CT5_Latency FLR_CT5_ClosestPointX FLR_CT5_ClosestPointXStdDev FLR_CT5_ClosestPointY FLR_CT5_ClosestPointYStdDev FLR_CT5_Confidence FLR_CT5_Elevation FLR_CT5_ElevationConfidence FLR_CT5_ExistanceProbability FLR_CT5_Lifetime FLR_CT5_ModelBoxHeading FLR_CT5_ModelBoxLength FLR_CT5_ModelBoxWidth FLR_CT5_ModelBoxX FLR_CT5_ModelBoxY FLR_CT5_MotionClass FLR_CT5_ObjectId FLR_CT5_ObservationHistory FLR_CT5_QualityBits FLR_CT5_StationaryCounter FLR_CT5_Type FLR_CT5_X_Acceleration FLR_CT5_X_Velocity FLR_CT5_X_VelocityStdDev FLR_CT5_Y_Acceleration FLR_CT5_Y_Velocity FLR_CT5_Y_VelocityStdDev;
SIG_GROUP_ 390 L_FR_RDR_ClusterTrack6_50ms 1 : FLR_CT6_CrcVal FLR_CT6_AlvCntVal FLR_CT6_ListIndex FLR_CT6_SequenceCounter FLR_CT6_TimeStamp FLR_CT6_Latency FLR_CT6_ClosestPointX FLR_CT6_ClosestPointXStdDev FLR_CT6_ClosestPointY FLR_CT6_ClosestPointYStdDev FLR_CT6_Confidence FLR_CT6_Elevation FLR_CT6_ElevationConfidence FLR_CT6_ExistanceProbability FLR_CT6_Lifetime FLR_CT6_ModelBoxHeading FLR_CT6_ModelBoxLength FLR_CT6_ModelBoxWidth FLR_CT6_ModelBoxX FLR_CT6_ModelBoxY FLR_CT6_MotionClass FLR_CT6_ObjectId FLR_CT6_ObservationHistory FLR_CT6_QualityBits FLR_CT6_StationaryCounter FLR_CT6_Type FLR_CT6_X_Acceleration FLR_CT6_X_Velocity FLR_CT6_X_VelocityStdDev FLR_CT6_Y_Acceleration FLR_CT6_Y_Velocity FLR_CT6_Y_VelocityStdDev;
SIG_GROUP_ 391 L_FR_RDR_ClusterTrack7_50ms 1 : FLR_CT7_CrcVal FLR_CT7_AlvCntVal FLR_CT7_ListIndex FLR_CT7_SequenceCounter FLR_CT7_TimeStamp FLR_CT7_Latency FLR_CT7_ClosestPointX FLR_CT7_ClosestPointXStdDev FLR_CT7_ClosestPointY FLR_CT7_ClosestPointYStdDev FLR_CT7_Confidence FLR_CT7_Elevation FLR_CT7_ElevationConfidence FLR_CT7_ExistanceProbability FLR_CT7_Lifetime FLR_CT7_ModelBoxHeading FLR_CT7_ModelBoxLength FLR_CT7_ModelBoxWidth FLR_CT7_ModelBoxX FLR_CT7_ModelBoxY FLR_CT7_MotionClass FLR_CT7_ObjectId FLR_CT7_ObservationHistory FLR_CT7_QualityBits FLR_CT7_StationaryCounter FLR_CT7_Type FLR_CT7_X_Acceleration FLR_CT7_X_Velocity FLR_CT7_X_VelocityStdDev FLR_CT7_Y_Acceleration FLR_CT7_Y_Velocity FLR_CT7_Y_VelocityStdDev;
SIG_GROUP_ 392 L_FR_RDR_ClusterTrack8_50ms 1 : FLR_CT8_CrcVal FLR_CT8_AlvCntVal FLR_CT8_ListIndex FLR_CT8_SequenceCounter FLR_CT8_TimeStamp FLR_CT8_Latency FLR_CT8_ClosestPointX FLR_CT8_ClosestPointXStdDev FLR_CT8_ClosestPointY FLR_CT8_ClosestPointYStdDev FLR_CT8_Confidence FLR_CT8_Elevation FLR_CT8_ElevationConfidence FLR_CT8_ExistanceProbability FLR_CT8_Lifetime FLR_CT8_ModelBoxHeading FLR_CT8_ModelBoxLength FLR_CT8_ModelBoxWidth FLR_CT8_ModelBoxX FLR_CT8_ModelBoxY FLR_CT8_MotionClass FLR_CT8_ObjectId FLR_CT8_ObservationHistory FLR_CT8_QualityBits FLR_CT8_StationaryCounter FLR_CT8_Type FLR_CT8_X_Acceleration FLR_CT8_X_Velocity FLR_CT8_X_VelocityStdDev FLR_CT8_Y_Acceleration FLR_CT8_Y_Velocity FLR_CT8_Y_VelocityStdDev;
SIG_GROUP_ 393 L_FR_RDR_ClusterTrack9_50ms 1 : FLR_CT9_CrcVal FLR_CT9_AlvCntVal FLR_CT9_ListIndex FLR_CT9_SequenceCounter FLR_CT9_TimeStamp FLR_CT9_Latency FLR_CT9_ClosestPointX FLR_CT9_ClosestPointXStdDev FLR_CT9_ClosestPointY FLR_CT9_ClosestPointYStdDev FLR_CT9_Confidence FLR_CT9_Elevation FLR_CT9_ElevationConfidence FLR_CT9_ExistanceProbability FLR_CT9_Lifetime FLR_CT9_ModelBoxHeading FLR_CT9_ModelBoxLength FLR_CT9_ModelBoxWidth FLR_CT9_ModelBoxX FLR_CT9_ModelBoxY FLR_CT9_MotionClass FLR_CT9_ObjectId FLR_CT9_ObservationHistory FLR_CT9_QualityBits FLR_CT9_StationaryCounter FLR_CT9_Type FLR_CT9_X_Acceleration FLR_CT9_X_Velocity FLR_CT9_X_VelocityStdDev FLR_CT9_Y_Acceleration FLR_CT9_Y_Velocity FLR_CT9_Y_VelocityStdDev;
SIG_GROUP_ 394 L_FR_RDR_ClusterTrack10_50ms 1 : FLR_CT10_CrcVal FLR_CT10_AlvCntVal FLR_CT10_ListIndex FLR_CT10_SequenceCounter FLR_CT10_TimeStamp FLR_CT10_Latency FLR_CT10_ClosestPointX FLR_CT10_ClosestPointXStdDev FLR_CT10_ClosestPointY FLR_CT10_ClosestPointYStdDev FLR_CT10_Confidence FLR_CT10_Elevation FLR_CT10_ElevationConfidence FLR_CT10_ExistanceProbability FLR_CT10_Lifetime FLR_CT10_ModelBoxHeading FLR_CT10_ModelBoxLength FLR_CT10_ModelBoxWidth FLR_CT10_ModelBoxX FLR_CT10_ModelBoxY FLR_CT10_MotionClass FLR_CT10_ObjectId FLR_CT10_ObservationHistory FLR_CT10_QualityBits FLR_CT10_StationaryCounter FLR_CT10_Type FLR_CT10_X_Acceleration FLR_CT10_X_Velocity FLR_CT10_X_VelocityStdDev FLR_CT10_Y_Acceleration FLR_CT10_Y_Velocity FLR_CT10_Y_VelocityStdDev;
SIG_GROUP_ 395 L_FR_RDR_ClusterTrack11_50ms 1 : FLR_CT11_CrcVal FLR_CT11_AlvCntVal FLR_CT11_ListIndex FLR_CT11_SequenceCounter FLR_CT11_TimeStamp FLR_CT11_Latency FLR_CT11_ClosestPointX FLR_CT11_ClosestPointXStdDev FLR_CT11_ClosestPointY FLR_CT11_ClosestPointYStdDev FLR_CT11_Confidence FLR_CT11_Elevation FLR_CT11_ElevationConfidence FLR_CT11_ExistanceProbability FLR_CT11_Lifetime FLR_CT11_ModelBoxHeading FLR_CT11_ModelBoxLength FLR_CT11_ModelBoxWidth FLR_CT11_ModelBoxX FLR_CT11_ModelBoxY FLR_CT11_MotionClass FLR_CT11_ObjectId FLR_CT11_ObservationHistory FLR_CT11_QualityBits FLR_CT11_StationaryCounter FLR_CT11_Type FLR_CT11_X_Acceleration FLR_CT11_X_Velocity FLR_CT11_X_VelocityStdDev FLR_CT11_Y_Acceleration FLR_CT11_Y_Velocity FLR_CT11_Y_VelocityStdDev;
SIG_GROUP_ 396 L_FR_RDR_ClusterTrack12_50ms 1 : FLR_CT12_CrcVal FLR_CT12_AlvCntVal FLR_CT12_ListIndex FLR_CT12_SequenceCounter FLR_CT12_TimeStamp FLR_CT12_Latency FLR_CT12_ClosestPointX FLR_CT12_ClosestPointXStdDev FLR_CT12_ClosestPointY FLR_CT12_ClosestPointYStdDev FLR_CT12_Confidence FLR_CT12_Elevation FLR_CT12_ElevationConfidence FLR_CT12_ExistanceProbability FLR_CT12_Lifetime FLR_CT12_ModelBoxHeading FLR_CT12_ModelBoxLength FLR_CT12_ModelBoxWidth FLR_CT12_ModelBoxX FLR_CT12_ModelBoxY FLR_CT12_MotionClass FLR_CT12_ObjectId FLR_CT12_ObservationHistory FLR_CT12_QualityBits FLR_CT12_StationaryCounter FLR_CT12_Type FLR_CT12_X_Acceleration FLR_CT12_X_Velocity FLR_CT12_X_VelocityStdDev FLR_CT12_Y_Acceleration FLR_CT12_Y_Velocity FLR_CT12_Y_VelocityStdDev;
SIG_GROUP_ 397 L_FR_RDR_ClusterTrack13_50ms 1 : FLR_CT13_CrcVal FLR_CT13_AlvCntVal FLR_CT13_ListIndex FLR_CT13_SequenceCounter FLR_CT13_TimeStamp FLR_CT13_Latency FLR_CT13_ClosestPointX FLR_CT13_ClosestPointXStdDev FLR_CT13_ClosestPointY FLR_CT13_ClosestPointYStdDev FLR_CT13_Confidence FLR_CT13_Elevation FLR_CT13_ElevationConfidence FLR_CT13_ExistanceProbability FLR_CT13_Lifetime FLR_CT13_ModelBoxHeading FLR_CT13_ModelBoxLength FLR_CT13_ModelBoxWidth FLR_CT13_ModelBoxX FLR_CT13_ModelBoxY FLR_CT13_MotionClass FLR_CT13_ObjectId FLR_CT13_ObservationHistory FLR_CT13_QualityBits FLR_CT13_StationaryCounter FLR_CT13_Type FLR_CT13_X_Acceleration FLR_CT13_X_Velocity FLR_CT13_X_VelocityStdDev FLR_CT13_Y_Acceleration FLR_CT13_Y_Velocity FLR_CT13_Y_VelocityStdDev;
SIG_GROUP_ 398 L_FR_RDR_ClusterTrack14_50ms 1 : FLR_CT14_CrcVal FLR_CT14_AlvCntVal FLR_CT14_ListIndex FLR_CT14_SequenceCounter FLR_CT14_TimeStamp FLR_CT14_Latency FLR_CT14_ClosestPointX FLR_CT14_ClosestPointXStdDev FLR_CT14_ClosestPointY FLR_CT14_ClosestPointYStdDev FLR_CT14_Confidence FLR_CT14_Elevation FLR_CT14_ElevationConfidence FLR_CT14_ExistanceProbability FLR_CT14_Lifetime FLR_CT14_ModelBoxHeading FLR_CT14_ModelBoxLength FLR_CT14_ModelBoxWidth FLR_CT14_ModelBoxX FLR_CT14_ModelBoxY FLR_CT14_MotionClass FLR_CT14_ObjectId FLR_CT14_ObservationHistory FLR_CT14_QualityBits FLR_CT14_StationaryCounter FLR_CT14_Type FLR_CT14_X_Acceleration FLR_CT14_X_Velocity FLR_CT14_X_VelocityStdDev FLR_CT14_Y_Acceleration FLR_CT14_Y_Velocity FLR_CT14_Y_VelocityStdDev;
SIG_GROUP_ 399 L_FR_RDR_ClusterTrack15_50ms 1 : FLR_CT15_CrcVal FLR_CT15_AlvCntVal FLR_CT15_ListIndex FLR_CT15_SequenceCounter FLR_CT15_TimeStamp FLR_CT15_Latency FLR_CT15_ClosestPointX FLR_CT15_ClosestPointXStdDev FLR_CT15_ClosestPointY FLR_CT15_ClosestPointYStdDev FLR_CT15_Confidence FLR_CT15_Elevation FLR_CT15_ElevationConfidence FLR_CT15_ExistanceProbability FLR_CT15_Lifetime FLR_CT15_ModelBoxHeading FLR_CT15_ModelBoxLength FLR_CT15_ModelBoxWidth FLR_CT15_ModelBoxX FLR_CT15_ModelBoxY FLR_CT15_MotionClass FLR_CT15_ObjectId FLR_CT15_ObservationHistory FLR_CT15_QualityBits FLR_CT15_StationaryCounter FLR_CT15_Type FLR_CT15_X_Acceleration FLR_CT15_X_Velocity FLR_CT15_X_VelocityStdDev FLR_CT15_Y_Acceleration FLR_CT15_Y_Velocity FLR_CT15_Y_VelocityStdDev;
