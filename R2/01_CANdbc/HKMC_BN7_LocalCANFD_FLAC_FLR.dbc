VERSION ""

NS_ :

BS_:

BU_: FR_CMR FR_RDR

BO_ 400 L_FR_RDR_ClusterTrack16_50ms: 64 FR_RDR
 SG_ FLR_CT16_CrcVal : 0|16@1+ (1,0) [0|65535] ""  FR_CMR
 SG_ FLR_CT16_AlvCntVal : 16|8@1+ (1,0) [0|255] ""  FR_CMR
 SG_ FLR_CT16_ListIndex : 24|4@1+ (1,0) [0|15] ""  FR_CMR
 SG_ FLR_CT16_SequenceCounter : 28|4@1+ (1,0) [0|15] ""  FR_CMR
 SG_ FLR_CT16_TimeStamp : 32|32@1+ (1,0) [0|4294967295] ""  FR_CMR
 SG_ FLR_CT16_Latency : 64|8@1+ (1,0) [0|255] "ms"  FR_CMR
 SG_ FLR_CT16_ClosestPointX : 72|12@1+ (0.05,-3) [-3|200] "m"  FR_CMR
 SG_ FLR_CT16_ClosestPointXStdDev : 84|7@1+ (0.05,0) [0|6] "m"  FR_CMR
 SG_ FLR_CT16_ClosestPointY : 91|10@1- (0.1,0) [-51|51] "m"  FR_CMR
 SG_ FLR_CT16_ClosestPointYStdDev : 101|6@1+ (0.1,0) [0|6] "m"  FR_CMR
 SG_ FLR_CT16_Confidence : 107|2@1+ (1,0) [0|3] ""  FR_CMR
 SG_ FLR_CT16_Elevation : 109|2@1+ (1,0) [0|3] ""  FR_CMR
 SG_ FLR_CT16_ElevationConfidence : 111|2@1+ (1,0) [0|3] ""  FR_CMR
 SG_ FLR_CT16_ExistanceProbability : 113|5@1+ (5,0) [0|100] "%"  FR_CMR
 SG_ FLR_CT16_Lifetime : 118|13@1+ (1,0) [0|8190] "Cycles"  FR_CMR
 SG_ FLR_CT16_ModelBoxHeading : 131|13@1- (0.001,0) [-3.15|3.15] "rad"  FR_CMR
 SG_ FLR_CT16_ModelBoxLength : 144|9@1+ (0.1,0) [0|50] "m"  FR_CMR
 SG_ FLR_CT16_ModelBoxWidth : 153|8@1+ (0.1,0) [0|25] "m"  FR_CMR
 SG_ FLR_CT16_ModelBoxX : 161|11@1+ (0.05,-25) [-25|75] "m"  FR_CMR
 SG_ FLR_CT16_ModelBoxY : 172|9@1- (0.1,0) [-25|25] "m"  FR_CMR
 SG_ FLR_CT16_MotionClass : 181|2@1+ (1,0) [0|3] ""  FR_CMR
 SG_ FLR_CT16_ObjectId : 183|16@1+ (1,0) [0|65535] ""  FR_CMR
 SG_ FLR_CT16_ObservationHistory : 199|16@1+ (1,0) [0|65535] ""  FR_CMR
 SG_ FLR_CT16_QualityBits : 215|18@1+ (1,0) [0|262143] ""  FR_CMR
 SG_ FLR_CT16_StationaryCounter : 233|16@1+ (1,0) [0|65535] ""  FR_CMR
 SG_ FLR_CT16_Type : 249|4@1+ (1,0) [0|8] ""  FR_CMR
 SG_ FLR_CT16_X_Acceleration : 253|9@1- (0.1,0) [-25|25] "m/s^2"  FR_CMR
 SG_ FLR_CT16_X_Velocity : 262|13@1- (0.05,0) [-120|120] "m/s"  FR_CMR
 SG_ FLR_CT16_X_VelocityStdDev : 275|7@1+ (0.05,0) [0|6] "m/s"  FR_CMR
 SG_ FLR_CT16_Y_Acceleration : 282|8@1- (0.25,0) [-25|25] "m/s^2"  FR_CMR
 SG_ FLR_CT16_Y_Velocity : 290|11@1- (0.1,0) [-100|100] "m/s"  FR_CMR
 SG_ FLR_CT16_Y_VelocityStdDev : 301|7@1+ (0.05,0) [0|6] "m/s"  FR_CMR

BO_ 401 L_FR_RDR_ClusterTrack17_50ms: 64 FR_RDR
 SG_ FLR_CT17_CrcVal : 0|16@1+ (1,0) [0|65535] ""  FR_CMR
 SG_ FLR_CT17_AlvCntVal : 16|8@1+ (1,0) [0|255] ""  FR_CMR
 SG_ FLR_CT17_ListIndex : 24|4@1+ (1,0) [0|15] ""  FR_CMR
 SG_ FLR_CT17_SequenceCounter : 28|4@1+ (1,0) [0|15] ""  FR_CMR
 SG_ FLR_CT17_TimeStamp : 32|32@1+ (1,0) [0|4294967295] ""  FR_CMR
 SG_ FLR_CT17_Latency : 64|8@1+ (1,0) [0|255] "ms"  FR_CMR
 SG_ FLR_CT17_ClosestPointX : 72|12@1+ (0.05,-3) [-3|200] "m"  FR_CMR
 SG_ FLR_CT17_ClosestPointXStdDev : 84|7@1+ (0.05,0) [0|6] "m"  FR_CMR
 SG_ FLR_CT17_ClosestPointY : 91|10@1- (0.1,0) [-51|51] "m"  FR_CMR
 SG_ FLR_CT17_ClosestPointYStdDev : 101|6@1+ (0.1,0) [0|6] "m"  FR_CMR
 SG_ FLR_CT17_Confidence : 107|2@1+ (1,0) [0|3] ""  FR_CMR
 SG_ FLR_CT17_Elevation : 109|2@1+ (1,0) [0|3] ""  FR_CMR
 SG_ FLR_CT17_ElevationConfidence : 111|2@1+ (1,0) [0|3] ""  FR_CMR
 SG_ FLR_CT17_ExistanceProbability : 113|5@1+ (5,0) [0|100] "%"  FR_CMR
 SG_ FLR_CT17_Lifetime : 118|13@1+ (1,0) [0|8190] "Cycles"  FR_CMR
 SG_ FLR_CT17_ModelBoxHeading : 131|13@1- (0.001,0) [-3.15|3.15] "rad"  FR_CMR
 SG_ FLR_CT17_ModelBoxLength : 144|9@1+ (0.1,0) [0|50] "m"  FR_CMR
 SG_ FLR_CT17_ModelBoxWidth : 153|8@1+ (0.1,0) [0|25] "m"  FR_CMR
 SG_ FLR_CT17_ModelBoxX : 161|11@1+ (0.05,-25) [-25|75] "m"  FR_CMR
 SG_ FLR_CT17_ModelBoxY : 172|9@1- (0.1,0) [-25|25] "m"  FR_CMR
 SG_ FLR_CT17_MotionClass : 181|2@1+ (1,0) [0|3] ""  FR_CMR
 SG_ FLR_CT17_ObjectId : 183|16@1+ (1,0) [0|65535] ""  FR_CMR
 SG_ FLR_CT17_ObservationHistory : 199|16@1+ (1,0) [0|65535] ""  FR_CMR
 SG_ FLR_CT17_QualityBits : 215|18@1+ (1,0) [0|262143] ""  FR_CMR
 SG_ FLR_CT17_StationaryCounter : 233|16@1+ (1,0) [0|65535] ""  FR_CMR
 SG_ FLR_CT17_Type : 249|4@1+ (1,0) [0|8] ""  FR_CMR
 SG_ FLR_CT17_X_Acceleration : 253|9@1- (0.1,0) [-25|25] "m/s^2"  FR_CMR
 SG_ FLR_CT17_X_Velocity : 262|13@1- (0.05,0) [-120|120] "m/s"  FR_CMR
 SG_ FLR_CT17_X_VelocityStdDev : 275|7@1+ (0.05,0) [0|6] "m/s"  FR_CMR
 SG_ FLR_CT17_Y_Acceleration : 282|8@1- (0.25,0) [-25|25] "m/s^2"  FR_CMR
 SG_ FLR_CT17_Y_Velocity : 290|11@1- (0.1,0) [-100|100] "m/s"  FR_CMR
 SG_ FLR_CT17_Y_VelocityStdDev : 301|7@1+ (0.05,0) [0|6] "m/s"  FR_CMR

BO_ 402 L_FR_RDR_ClusterTrack18_50ms: 64 FR_RDR
 SG_ FLR_CT18_CrcVal : 0|16@1+ (1,0) [0|65535] ""  FR_CMR
 SG_ FLR_CT18_AlvCntVal : 16|8@1+ (1,0) [0|255] ""  FR_CMR
 SG_ FLR_CT18_ListIndex : 24|4@1+ (1,0) [0|15] ""  FR_CMR
 SG_ FLR_CT18_SequenceCounter : 28|4@1+ (1,0) [0|15] ""  FR_CMR
 SG_ FLR_CT18_TimeStamp : 32|32@1+ (1,0) [0|4294967295] ""  FR_CMR
 SG_ FLR_CT18_Latency : 64|8@1+ (1,0) [0|255] "ms"  FR_CMR
 SG_ FLR_CT18_ClosestPointX : 72|12@1+ (0.05,-3) [-3|200] "m"  FR_CMR
 SG_ FLR_CT18_ClosestPointXStdDev : 84|7@1+ (0.05,0) [0|6] "m"  FR_CMR
 SG_ FLR_CT18_ClosestPointY : 91|10@1- (0.1,0) [-51|51] "m"  FR_CMR
 SG_ FLR_CT18_ClosestPointYStdDev : 101|6@1+ (0.1,0) [0|6] "m"  FR_CMR
 SG_ FLR_CT18_Confidence : 107|2@1+ (1,0) [0|3] ""  FR_CMR
 SG_ FLR_CT18_Elevation : 109|2@1+ (1,0) [0|3] ""  FR_CMR
 SG_ FLR_CT18_ElevationConfidence : 111|2@1+ (1,0) [0|3] ""  FR_CMR
 SG_ FLR_CT18_ExistanceProbability : 113|5@1+ (5,0) [0|100] "%"  FR_CMR
 SG_ FLR_CT18_Lifetime : 118|13@1+ (1,0) [0|8190] "Cycles"  FR_CMR
 SG_ FLR_CT18_ModelBoxHeading : 131|13@1- (0.001,0) [-3.15|3.15] "rad"  FR_CMR
 SG_ FLR_CT18_ModelBoxLength : 144|9@1+ (0.1,0) [0|50] "m"  FR_CMR
 SG_ FLR_CT18_ModelBoxWidth : 153|8@1+ (0.1,0) [0|25] "m"  FR_CMR
 SG_ FLR_CT18_ModelBoxX : 161|11@1+ (0.05,-25) [-25|75] "m"  FR_CMR
 SG_ FLR_CT18_ModelBoxY : 172|9@1- (0.1,0) [-25|25] "m"  FR_CMR
 SG_ FLR_CT18_MotionClass : 181|2@1+ (1,0) [0|3] ""  FR_CMR
 SG_ FLR_CT18_ObjectId : 183|16@1+ (1,0) [0|65535] ""  FR_CMR
 SG_ FLR_CT18_ObservationHistory : 199|16@1+ (1,0) [0|65535] ""  FR_CMR
 SG_ FLR_CT18_QualityBits : 215|18@1+ (1,0) [0|262143] ""  FR_CMR
 SG_ FLR_CT18_StationaryCounter : 233|16@1+ (1,0) [0|65535] ""  FR_CMR
 SG_ FLR_CT18_Type : 249|4@1+ (1,0) [0|8] ""  FR_CMR
 SG_ FLR_CT18_X_Acceleration : 253|9@1- (0.1,0) [-25|25] "m/s^2"  FR_CMR
 SG_ FLR_CT18_X_Velocity : 262|13@1- (0.05,0) [-120|120] "m/s"  FR_CMR
 SG_ FLR_CT18_X_VelocityStdDev : 275|7@1+ (0.05,0) [0|6] "m/s"  FR_CMR
 SG_ FLR_CT18_Y_Acceleration : 282|8@1- (0.25,0) [-25|25] "m/s^2"  FR_CMR
 SG_ FLR_CT18_Y_Velocity : 290|11@1- (0.1,0) [-100|100] "m/s"  FR_CMR
 SG_ FLR_CT18_Y_VelocityStdDev : 301|7@1+ (0.05,0) [0|6] "m/s"  FR_CMR

BO_ 403 L_FR_RDR_ClusterTrack19_50ms: 64 FR_RDR
 SG_ FLR_CT19_CrcVal : 0|16@1+ (1,0) [0|65535] ""  FR_CMR
 SG_ FLR_CT19_AlvCntVal : 16|8@1+ (1,0) [0|255] ""  FR_CMR
 SG_ FLR_CT19_ListIndex : 24|4@1+ (1,0) [0|15] ""  FR_CMR
 SG_ FLR_CT19_SequenceCounter : 28|4@1+ (1,0) [0|15] ""  FR_CMR
 SG_ FLR_CT19_TimeStamp : 32|32@1+ (1,0) [0|4294967295] ""  FR_CMR
 SG_ FLR_CT19_Latency : 64|8@1+ (1,0) [0|255] "ms"  FR_CMR
 SG_ FLR_CT19_ClosestPointX : 72|12@1+ (0.05,-3) [-3|200] "m"  FR_CMR
 SG_ FLR_CT19_ClosestPointXStdDev : 84|7@1+ (0.05,0) [0|6] "m"  FR_CMR
 SG_ FLR_CT19_ClosestPointY : 91|10@1- (0.1,0) [-51|51] "m"  FR_CMR
 SG_ FLR_CT19_ClosestPointYStdDev : 101|6@1+ (0.1,0) [0|6] "m"  FR_CMR
 SG_ FLR_CT19_Confidence : 107|2@1+ (1,0) [0|3] ""  FR_CMR
 SG_ FLR_CT19_Elevation : 109|2@1+ (1,0) [0|3] ""  FR_CMR
 SG_ FLR_CT19_ElevationConfidence : 111|2@1+ (1,0) [0|3] ""  FR_CMR
 SG_ FLR_CT19_ExistanceProbability : 113|5@1+ (5,0) [0|100] "%"  FR_CMR
 SG_ FLR_CT19_Lifetime : 118|13@1+ (1,0) [0|8190] "Cycles"  FR_CMR
 SG_ FLR_CT19_ModelBoxHeading : 131|13@1- (0.001,0) [-3.15|3.15] "rad"  FR_CMR
 SG_ FLR_CT19_ModelBoxLength : 144|9@1+ (0.1,0) [0|50] "m"  FR_CMR
 SG_ FLR_CT19_ModelBoxWidth : 153|8@1+ (0.1,0) [0|25] "m"  FR_CMR
 SG_ FLR_CT19_ModelBoxX : 161|11@1+ (0.05,-25) [-25|75] "m"  FR_CMR
 SG_ FLR_CT19_ModelBoxY : 172|9@1- (0.1,0) [-25|25] "m"  FR_CMR
 SG_ FLR_CT19_MotionClass : 181|2@1+ (1,0) [0|3] ""  FR_CMR
 SG_ FLR_CT19_ObjectId : 183|16@1+ (1,0) [0|65535] ""  FR_CMR
 SG_ FLR_CT19_ObservationHistory : 199|16@1+ (1,0) [0|65535] ""  FR_CMR
 SG_ FLR_CT19_QualityBits : 215|18@1+ (1,0) [0|262143] ""  FR_CMR
 SG_ FLR_CT19_StationaryCounter : 233|16@1+ (1,0) [0|65535] ""  FR_CMR
 SG_ FLR_CT19_Type : 249|4@1+ (1,0) [0|8] ""  FR_CMR
 SG_ FLR_CT19_X_Acceleration : 253|9@1- (0.1,0) [-25|25] "m/s^2"  FR_CMR
 SG_ FLR_CT19_X_Velocity : 262|13@1- (0.05,0) [-120|120] "m/s"  FR_CMR
 SG_ FLR_CT19_X_VelocityStdDev : 275|7@1+ (0.05,0) [0|6] "m/s"  FR_CMR
 SG_ FLR_CT19_Y_Acceleration : 282|8@1- (0.25,0) [-25|25] "m/s^2"  FR_CMR
 SG_ FLR_CT19_Y_Velocity : 290|11@1- (0.1,0) [-100|100] "m/s"  FR_CMR
 SG_ FLR_CT19_Y_VelocityStdDev : 301|7@1+ (0.05,0) [0|6] "m/s"  FR_CMR

BO_ 404 L_FR_RDR_ClusterTrack20_50ms: 64 FR_RDR
 SG_ FLR_CT20_CrcVal : 0|16@1+ (1,0) [0|65535] ""  FR_CMR
 SG_ FLR_CT20_AlvCntVal : 16|8@1+ (1,0) [0|255] ""  FR_CMR
 SG_ FLR_CT20_ListIndex : 24|4@1+ (1,0) [0|15] ""  FR_CMR
 SG_ FLR_CT20_SequenceCounter : 28|4@1+ (1,0) [0|15] ""  FR_CMR
 SG_ FLR_CT20_TimeStamp : 32|32@1+ (1,0) [0|4294967295] ""  FR_CMR
 SG_ FLR_CT20_Latency : 64|8@1+ (1,0) [0|255] "ms"  FR_CMR
 SG_ FLR_CT20_ClosestPointX : 72|12@1+ (0.05,-3) [-3|200] "m"  FR_CMR
 SG_ FLR_CT20_ClosestPointXStdDev : 84|7@1+ (0.05,0) [0|6] "m"  FR_CMR
 SG_ FLR_CT20_ClosestPointY : 91|10@1- (0.1,0) [-51|51] "m"  FR_CMR
 SG_ FLR_CT20_ClosestPointYStdDev : 101|6@1+ (0.1,0) [0|6] "m"  FR_CMR
 SG_ FLR_CT20_Confidence : 107|2@1+ (1,0) [0|3] ""  FR_CMR
 SG_ FLR_CT20_Elevation : 109|2@1+ (1,0) [0|3] ""  FR_CMR
 SG_ FLR_CT20_ElevationConfidence : 111|2@1+ (1,0) [0|3] ""  FR_CMR
 SG_ FLR_CT20_ExistanceProbability : 113|5@1+ (5,0) [0|100] "%"  FR_CMR
 SG_ FLR_CT20_Lifetime : 118|13@1+ (1,0) [0|8190] "Cycles"  FR_CMR
 SG_ FLR_CT20_ModelBoxHeading : 131|13@1- (0.001,0) [-3.15|3.15] "rad"  FR_CMR
 SG_ FLR_CT20_ModelBoxLength : 144|9@1+ (0.1,0) [0|50] "m"  FR_CMR
 SG_ FLR_CT20_ModelBoxWidth : 153|8@1+ (0.1,0) [0|25] "m"  FR_CMR
 SG_ FLR_CT20_ModelBoxX : 161|11@1+ (0.05,-25) [-25|75] "m"  FR_CMR
 SG_ FLR_CT20_ModelBoxY : 172|9@1- (0.1,0) [-25|25] "m"  FR_CMR
 SG_ FLR_CT20_MotionClass : 181|2@1+ (1,0) [0|3] ""  FR_CMR
 SG_ FLR_CT20_ObjectId : 183|16@1+ (1,0) [0|65535] ""  FR_CMR
 SG_ FLR_CT20_ObservationHistory : 199|16@1+ (1,0) [0|65535] ""  FR_CMR
 SG_ FLR_CT20_QualityBits : 215|18@1+ (1,0) [0|262143] ""  FR_CMR
 SG_ FLR_CT20_StationaryCounter : 233|16@1+ (1,0) [0|65535] ""  FR_CMR
 SG_ FLR_CT20_Type : 249|4@1+ (1,0) [0|8] ""  FR_CMR
 SG_ FLR_CT20_X_Acceleration : 253|9@1- (0.1,0) [-25|25] "m/s^2"  FR_CMR
 SG_ FLR_CT20_X_Velocity : 262|13@1- (0.05,0) [-120|120] "m/s"  FR_CMR
 SG_ FLR_CT20_X_VelocityStdDev : 275|7@1+ (0.05,0) [0|6] "m/s"  FR_CMR
 SG_ FLR_CT20_Y_Acceleration : 282|8@1- (0.25,0) [-25|25] "m/s^2"  FR_CMR
 SG_ FLR_CT20_Y_Velocity : 290|11@1- (0.1,0) [-100|100] "m/s"  FR_CMR
 SG_ FLR_CT20_Y_VelocityStdDev : 301|7@1+ (0.05,0) [0|6] "m/s"  FR_CMR

BO_ 405 L_FR_RDR_ClusterTrack21_50ms: 64 FR_RDR
 SG_ FLR_CT21_CrcVal : 0|16@1+ (1,0) [0|65535] ""  FR_CMR
 SG_ FLR_CT21_AlvCntVal : 16|8@1+ (1,0) [0|255] ""  FR_CMR
 SG_ FLR_CT21_ListIndex : 24|4@1+ (1,0) [0|15] ""  FR_CMR
 SG_ FLR_CT21_SequenceCounter : 28|4@1+ (1,0) [0|15] ""  FR_CMR
 SG_ FLR_CT21_TimeStamp : 32|32@1+ (1,0) [0|4294967295] ""  FR_CMR
 SG_ FLR_CT21_Latency : 64|8@1+ (1,0) [0|255] "ms"  FR_CMR
 SG_ FLR_CT21_ClosestPointX : 72|12@1+ (0.05,-3) [-3|200] "m"  FR_CMR
 SG_ FLR_CT21_ClosestPointXStdDev : 84|7@1+ (0.05,0) [0|6] "m"  FR_CMR
 SG_ FLR_CT21_ClosestPointY : 91|10@1- (0.1,0) [-51|51] "m"  FR_CMR
 SG_ FLR_CT21_ClosestPointYStdDev : 101|6@1+ (0.1,0) [0|6] "m"  FR_CMR
 SG_ FLR_CT21_Confidence : 107|2@1+ (1,0) [0|3] ""  FR_CMR
 SG_ FLR_CT21_Elevation : 109|2@1+ (1,0) [0|3] ""  FR_CMR
 SG_ FLR_CT21_ElevationConfidence : 111|2@1+ (1,0) [0|3] ""  FR_CMR
 SG_ FLR_CT21_ExistanceProbability : 113|5@1+ (5,0) [0|100] "%"  FR_CMR
 SG_ FLR_CT21_Lifetime : 118|13@1+ (1,0) [0|8190] "Cycles"  FR_CMR
 SG_ FLR_CT21_ModelBoxHeading : 131|13@1- (0.001,0) [-3.15|3.15] "rad"  FR_CMR
 SG_ FLR_CT21_ModelBoxLength : 144|9@1+ (0.1,0) [0|50] "m"  FR_CMR
 SG_ FLR_CT21_ModelBoxWidth : 153|8@1+ (0.1,0) [0|25] "m"  FR_CMR
 SG_ FLR_CT21_ModelBoxX : 161|11@1+ (0.05,-25) [-25|75] "m"  FR_CMR
 SG_ FLR_CT21_ModelBoxY : 172|9@1- (0.1,0) [-25|25] "m"  FR_CMR
 SG_ FLR_CT21_MotionClass : 181|2@1+ (1,0) [0|3] ""  FR_CMR
 SG_ FLR_CT21_ObjectId : 183|16@1+ (1,0) [0|65535] ""  FR_CMR
 SG_ FLR_CT21_ObservationHistory : 199|16@1+ (1,0) [0|65535] ""  FR_CMR
 SG_ FLR_CT21_QualityBits : 215|18@1+ (1,0) [0|262143] ""  FR_CMR
 SG_ FLR_CT21_StationaryCounter : 233|16@1+ (1,0) [0|65535] ""  FR_CMR
 SG_ FLR_CT21_Type : 249|4@1+ (1,0) [0|8] ""  FR_CMR
 SG_ FLR_CT21_X_Acceleration : 253|9@1- (0.1,0) [-25|25] "m/s^2"  FR_CMR
 SG_ FLR_CT21_X_Velocity : 262|13@1- (0.05,0) [-120|120] "m/s"  FR_CMR
 SG_ FLR_CT21_X_VelocityStdDev : 275|7@1+ (0.05,0) [0|6] "m/s"  FR_CMR
 SG_ FLR_CT21_Y_Acceleration : 282|8@1- (0.25,0) [-25|25] "m/s^2"  FR_CMR
 SG_ FLR_CT21_Y_Velocity : 290|11@1- (0.1,0) [-100|100] "m/s"  FR_CMR
 SG_ FLR_CT21_Y_VelocityStdDev : 301|7@1+ (0.05,0) [0|6] "m/s"  FR_CMR

BO_ 406 L_FR_RDR_ClusterTrack22_50ms: 64 FR_RDR
 SG_ FLR_CT22_CrcVal : 0|16@1+ (1,0) [0|65535] ""  FR_CMR
 SG_ FLR_CT22_AlvCntVal : 16|8@1+ (1,0) [0|255] ""  FR_CMR
 SG_ FLR_CT22_ListIndex : 24|4@1+ (1,0) [0|15] ""  FR_CMR
 SG_ FLR_CT22_SequenceCounter : 28|4@1+ (1,0) [0|15] ""  FR_CMR
 SG_ FLR_CT22_TimeStamp : 32|32@1+ (1,0) [0|4294967295] ""  FR_CMR
 SG_ FLR_CT22_Latency : 64|8@1+ (1,0) [0|255] "ms"  FR_CMR
 SG_ FLR_CT22_ClosestPointX : 72|12@1+ (0.05,-3) [-3|200] "m"  FR_CMR
 SG_ FLR_CT22_ClosestPointXStdDev : 84|7@1+ (0.05,0) [0|6] "m"  FR_CMR
 SG_ FLR_CT22_ClosestPointY : 91|10@1- (0.1,0) [-51|51] "m"  FR_CMR
 SG_ FLR_CT22_ClosestPointYStdDev : 101|6@1+ (0.1,0) [0|6] "m"  FR_CMR
 SG_ FLR_CT22_Confidence : 107|2@1+ (1,0) [0|3] ""  FR_CMR
 SG_ FLR_CT22_Elevation : 109|2@1+ (1,0) [0|3] ""  FR_CMR
 SG_ FLR_CT22_ElevationConfidence : 111|2@1+ (1,0) [0|3] ""  FR_CMR
 SG_ FLR_CT22_ExistanceProbability : 113|5@1+ (5,0) [0|100] "%"  FR_CMR
 SG_ FLR_CT22_Lifetime : 118|13@1+ (1,0) [0|8190] "Cycles"  FR_CMR
 SG_ FLR_CT22_ModelBoxHeading : 131|13@1- (0.001,0) [-3.15|3.15] "rad"  FR_CMR
 SG_ FLR_CT22_ModelBoxLength : 144|9@1+ (0.1,0) [0|50] "m"  FR_CMR
 SG_ FLR_CT22_ModelBoxWidth : 153|8@1+ (0.1,0) [0|25] "m"  FR_CMR
 SG_ FLR_CT22_ModelBoxX : 161|11@1+ (0.05,-25) [-25|75] "m"  FR_CMR
 SG_ FLR_CT22_ModelBoxY : 172|9@1- (0.1,0) [-25|25] "m"  FR_CMR
 SG_ FLR_CT22_MotionClass : 181|2@1+ (1,0) [0|3] ""  FR_CMR
 SG_ FLR_CT22_ObjectId : 183|16@1+ (1,0) [0|65535] ""  FR_CMR
 SG_ FLR_CT22_ObservationHistory : 199|16@1+ (1,0) [0|65535] ""  FR_CMR
 SG_ FLR_CT22_QualityBits : 215|18@1+ (1,0) [0|262143] ""  FR_CMR
 SG_ FLR_CT22_StationaryCounter : 233|16@1+ (1,0) [0|65535] ""  FR_CMR
 SG_ FLR_CT22_Type : 249|4@1+ (1,0) [0|8] ""  FR_CMR
 SG_ FLR_CT22_X_Acceleration : 253|9@1- (0.1,0) [-25|25] "m/s^2"  FR_CMR
 SG_ FLR_CT22_X_Velocity : 262|13@1- (0.05,0) [-120|120] "m/s"  FR_CMR
 SG_ FLR_CT22_X_VelocityStdDev : 275|7@1+ (0.05,0) [0|6] "m/s"  FR_CMR
 SG_ FLR_CT22_Y_Acceleration : 282|8@1- (0.25,0) [-25|25] "m/s^2"  FR_CMR
 SG_ FLR_CT22_Y_Velocity : 290|11@1- (0.1,0) [-100|100] "m/s"  FR_CMR
 SG_ FLR_CT22_Y_VelocityStdDev : 301|7@1+ (0.05,0) [0|6] "m/s"  FR_CMR

BO_ 407 L_FR_RDR_ClusterTrack23_50ms: 64 FR_RDR
 SG_ FLR_CT23_CrcVal : 0|16@1+ (1,0) [0|65535] ""  FR_CMR
 SG_ FLR_CT23_AlvCntVal : 16|8@1+ (1,0) [0|255] ""  FR_CMR
 SG_ FLR_CT23_ListIndex : 24|4@1+ (1,0) [0|15] ""  FR_CMR
 SG_ FLR_CT23_SequenceCounter : 28|4@1+ (1,0) [0|15] ""  FR_CMR
 SG_ FLR_CT23_TimeStamp : 32|32@1+ (1,0) [0|4294967295] ""  FR_CMR
 SG_ FLR_CT23_Latency : 64|8@1+ (1,0) [0|255] "ms"  FR_CMR
 SG_ FLR_CT23_ClosestPointX : 72|12@1+ (0.05,-3) [-3|200] "m"  FR_CMR
 SG_ FLR_CT23_ClosestPointXStdDev : 84|7@1+ (0.05,0) [0|6] "m"  FR_CMR
 SG_ FLR_CT23_ClosestPointY : 91|10@1- (0.1,0) [-51|51] "m"  FR_CMR
 SG_ FLR_CT23_ClosestPointYStdDev : 101|6@1+ (0.1,0) [0|6] "m"  FR_CMR
 SG_ FLR_CT23_Confidence : 107|2@1+ (1,0) [0|3] ""  FR_CMR
 SG_ FLR_CT23_Elevation : 109|2@1+ (1,0) [0|3] ""  FR_CMR
 SG_ FLR_CT23_ElevationConfidence : 111|2@1+ (1,0) [0|3] ""  FR_CMR
 SG_ FLR_CT23_ExistanceProbability : 113|5@1+ (5,0) [0|100] "%"  FR_CMR
 SG_ FLR_CT23_Lifetime : 118|13@1+ (1,0) [0|8190] "Cycles"  FR_CMR
 SG_ FLR_CT23_ModelBoxHeading : 131|13@1- (0.001,0) [-3.15|3.15] "rad"  FR_CMR
 SG_ FLR_CT23_ModelBoxLength : 144|9@1+ (0.1,0) [0|50] "m"  FR_CMR
 SG_ FLR_CT23_ModelBoxWidth : 153|8@1+ (0.1,0) [0|25] "m"  FR_CMR
 SG_ FLR_CT23_ModelBoxX : 161|11@1+ (0.05,-25) [-25|75] "m"  FR_CMR
 SG_ FLR_CT23_ModelBoxY : 172|9@1- (0.1,0) [-25|25] "m"  FR_CMR
 SG_ FLR_CT23_MotionClass : 181|2@1+ (1,0) [0|3] ""  FR_CMR
 SG_ FLR_CT23_ObjectId : 183|16@1+ (1,0) [0|65535] ""  FR_CMR
 SG_ FLR_CT23_ObservationHistory : 199|16@1+ (1,0) [0|65535] ""  FR_CMR
 SG_ FLR_CT23_QualityBits : 215|18@1+ (1,0) [0|262143] ""  FR_CMR
 SG_ FLR_CT23_StationaryCounter : 233|16@1+ (1,0) [0|65535] ""  FR_CMR
 SG_ FLR_CT23_Type : 249|4@1+ (1,0) [0|8] ""  FR_CMR
 SG_ FLR_CT23_X_Acceleration : 253|9@1- (0.1,0) [-25|25] "m/s^2"  FR_CMR
 SG_ FLR_CT23_X_Velocity : 262|13@1- (0.05,0) [-120|120] "m/s"  FR_CMR
 SG_ FLR_CT23_X_VelocityStdDev : 275|7@1+ (0.05,0) [0|6] "m/s"  FR_CMR
 SG_ FLR_CT23_Y_Acceleration : 282|8@1- (0.25,0) [-25|25] "m/s^2"  FR_CMR
 SG_ FLR_CT23_Y_Velocity : 290|11@1- (0.1,0) [-100|100] "m/s"  FR_CMR
 SG_ FLR_CT23_Y_VelocityStdDev : 301|7@1+ (0.05,0) [0|6] "m/s"  FR_CMR

BO_ 408 L_FR_RDR_ClusterTrack24_50ms: 64 FR_RDR
 SG_ FLR_CT24_CrcVal : 0|16@1+ (1,0) [0|65535] ""  FR_CMR
 SG_ FLR_CT24_AlvCntVal : 16|8@1+ (1,0) [0|255] ""  FR_CMR
 SG_ FLR_CT24_ListIndex : 24|4@1+ (1,0) [0|15] ""  FR_CMR
 SG_ FLR_CT24_SequenceCounter : 28|4@1+ (1,0) [0|15] ""  FR_CMR
 SG_ FLR_CT24_TimeStamp : 32|32@1+ (1,0) [0|4294967295] ""  FR_CMR
 SG_ FLR_CT24_Latency : 64|8@1+ (1,0) [0|255] "ms"  FR_CMR
 SG_ FLR_CT24_ClosestPointX : 72|12@1+ (0.05,-3) [-3|200] "m"  FR_CMR
 SG_ FLR_CT24_ClosestPointXStdDev : 84|7@1+ (0.05,0) [0|6] "m"  FR_CMR
 SG_ FLR_CT24_ClosestPointY : 91|10@1- (0.1,0) [-51|51] "m"  FR_CMR
 SG_ FLR_CT24_ClosestPointYStdDev : 101|6@1+ (0.1,0) [0|6] "m"  FR_CMR
 SG_ FLR_CT24_Confidence : 107|2@1+ (1,0) [0|3] ""  FR_CMR
 SG_ FLR_CT24_Elevation : 109|2@1+ (1,0) [0|3] ""  FR_CMR
 SG_ FLR_CT24_ElevationConfidence : 111|2@1+ (1,0) [0|3] ""  FR_CMR
 SG_ FLR_CT24_ExistanceProbability : 113|5@1+ (5,0) [0|100] "%"  FR_CMR
 SG_ FLR_CT24_Lifetime : 118|13@1+ (1,0) [0|8190] "Cycles"  FR_CMR
 SG_ FLR_CT24_ModelBoxHeading : 131|13@1- (0.001,0) [-3.15|3.15] "rad"  FR_CMR
 SG_ FLR_CT24_ModelBoxLength : 144|9@1+ (0.1,0) [0|50] "m"  FR_CMR
 SG_ FLR_CT24_ModelBoxWidth : 153|8@1+ (0.1,0) [0|25] "m"  FR_CMR
 SG_ FLR_CT24_ModelBoxX : 161|11@1+ (0.05,-25) [-25|75] "m"  FR_CMR
 SG_ FLR_CT24_ModelBoxY : 172|9@1- (0.1,0) [-25|25] "m"  FR_CMR
 SG_ FLR_CT24_MotionClass : 181|2@1+ (1,0) [0|3] ""  FR_CMR
 SG_ FLR_CT24_ObjectId : 183|16@1+ (1,0) [0|65535] ""  FR_CMR
 SG_ FLR_CT24_ObservationHistory : 199|16@1+ (1,0) [0|65535] ""  FR_CMR
 SG_ FLR_CT24_QualityBits : 215|18@1+ (1,0) [0|262143] ""  FR_CMR
 SG_ FLR_CT24_StationaryCounter : 233|16@1+ (1,0) [0|65535] ""  FR_CMR
 SG_ FLR_CT24_Type : 249|4@1+ (1,0) [0|8] ""  FR_CMR
 SG_ FLR_CT24_X_Acceleration : 253|9@1- (0.1,0) [-25|25] "m/s^2"  FR_CMR
 SG_ FLR_CT24_X_Velocity : 262|13@1- (0.05,0) [-120|120] "m/s"  FR_CMR
 SG_ FLR_CT24_X_VelocityStdDev : 275|7@1+ (0.05,0) [0|6] "m/s"  FR_CMR
 SG_ FLR_CT24_Y_Acceleration : 282|8@1- (0.25,0) [-25|25] "m/s^2"  FR_CMR
 SG_ FLR_CT24_Y_Velocity : 290|11@1- (0.1,0) [-100|100] "m/s"  FR_CMR
 SG_ FLR_CT24_Y_VelocityStdDev : 301|7@1+ (0.05,0) [0|6] "m/s"  FR_CMR

BO_ 409 L_FR_RDR_ClusterTrack25_50ms: 64 FR_RDR
 SG_ FLR_CT25_CrcVal : 0|16@1+ (1,0) [0|65535] ""  FR_CMR
 SG_ FLR_CT25_AlvCntVal : 16|8@1+ (1,0) [0|255] ""  FR_CMR
 SG_ FLR_CT25_ListIndex : 24|4@1+ (1,0) [0|15] ""  FR_CMR
 SG_ FLR_CT25_SequenceCounter : 28|4@1+ (1,0) [0|15] ""  FR_CMR
 SG_ FLR_CT25_TimeStamp : 32|32@1+ (1,0) [0|4294967295] ""  FR_CMR
 SG_ FLR_CT25_Latency : 64|8@1+ (1,0) [0|255] "ms"  FR_CMR
 SG_ FLR_CT25_ClosestPointX : 72|12@1+ (0.05,-3) [-3|200] "m"  FR_CMR
 SG_ FLR_CT25_ClosestPointXStdDev : 84|7@1+ (0.05,0) [0|6] "m"  FR_CMR
 SG_ FLR_CT25_ClosestPointY : 91|10@1- (0.1,0) [-51|51] "m"  FR_CMR
 SG_ FLR_CT25_ClosestPointYStdDev : 101|6@1+ (0.1,0) [0|6] "m"  FR_CMR
 SG_ FLR_CT25_Confidence : 107|2@1+ (1,0) [0|3] ""  FR_CMR
 SG_ FLR_CT25_Elevation : 109|2@1+ (1,0) [0|3] ""  FR_CMR
 SG_ FLR_CT25_ElevationConfidence : 111|2@1+ (1,0) [0|3] ""  FR_CMR
 SG_ FLR_CT25_ExistanceProbability : 113|5@1+ (5,0) [0|100] "%"  FR_CMR
 SG_ FLR_CT25_Lifetime : 118|13@1+ (1,0) [0|8190] "Cycles"  FR_CMR
 SG_ FLR_CT25_ModelBoxHeading : 131|13@1- (0.001,0) [-3.15|3.15] "rad"  FR_CMR
 SG_ FLR_CT25_ModelBoxLength : 144|9@1+ (0.1,0) [0|50] "m"  FR_CMR
 SG_ FLR_CT25_ModelBoxWidth : 153|8@1+ (0.1,0) [0|25] "m"  FR_CMR
 SG_ FLR_CT25_ModelBoxX : 161|11@1+ (0.05,-25) [-25|75] "m"  FR_CMR
 SG_ FLR_CT25_ModelBoxY : 172|9@1- (0.1,0) [-25|25] "m"  FR_CMR
 SG_ FLR_CT25_MotionClass : 181|2@1+ (1,0) [0|3] ""  FR_CMR
 SG_ FLR_CT25_ObjectId : 183|16@1+ (1,0) [0|65535] ""  FR_CMR
 SG_ FLR_CT25_ObservationHistory : 199|16@1+ (1,0) [0|65535] ""  FR_CMR
 SG_ FLR_CT25_QualityBits : 215|18@1+ (1,0) [0|262143] ""  FR_CMR
 SG_ FLR_CT25_StationaryCounter : 233|16@1+ (1,0) [0|65535] ""  FR_CMR
 SG_ FLR_CT25_Type : 249|4@1+ (1,0) [0|8] ""  FR_CMR
 SG_ FLR_CT25_X_Acceleration : 253|9@1- (0.1,0) [-25|25] "m/s^2"  FR_CMR
 SG_ FLR_CT25_X_Velocity : 262|13@1- (0.05,0) [-120|120] "m/s"  FR_CMR
 SG_ FLR_CT25_X_VelocityStdDev : 275|7@1+ (0.05,0) [0|6] "m/s"  FR_CMR
 SG_ FLR_CT25_Y_Acceleration : 282|8@1- (0.25,0) [-25|25] "m/s^2"  FR_CMR
 SG_ FLR_CT25_Y_Velocity : 290|11@1- (0.1,0) [-100|100] "m/s"  FR_CMR
 SG_ FLR_CT25_Y_VelocityStdDev : 301|7@1+ (0.05,0) [0|6] "m/s"  FR_CMR

BO_ 410 L_FR_RDR_ClusterTrack26_50ms: 64 FR_RDR
 SG_ FLR_CT26_CrcVal : 0|16@1+ (1,0) [0|65535] ""  FR_CMR
 SG_ FLR_CT26_AlvCntVal : 16|8@1+ (1,0) [0|255] ""  FR_CMR
 SG_ FLR_CT26_ListIndex : 24|4@1+ (1,0) [0|15] ""  FR_CMR
 SG_ FLR_CT26_SequenceCounter : 28|4@1+ (1,0) [0|15] ""  FR_CMR
 SG_ FLR_CT26_TimeStamp : 32|32@1+ (1,0) [0|4294967295] ""  FR_CMR
 SG_ FLR_CT26_Latency : 64|8@1+ (1,0) [0|255] "ms"  FR_CMR
 SG_ FLR_CT26_ClosestPointX : 72|12@1+ (0.05,-3) [-3|200] "m"  FR_CMR
 SG_ FLR_CT26_ClosestPointXStdDev : 84|7@1+ (0.05,0) [0|6] "m"  FR_CMR
 SG_ FLR_CT26_ClosestPointY : 91|10@1- (0.1,0) [-51|51] "m"  FR_CMR
 SG_ FLR_CT26_ClosestPointYStdDev : 101|6@1+ (0.1,0) [0|6] "m"  FR_CMR
 SG_ FLR_CT26_Confidence : 107|2@1+ (1,0) [0|3] ""  FR_CMR
 SG_ FLR_CT26_Elevation : 109|2@1+ (1,0) [0|3] ""  FR_CMR
 SG_ FLR_CT26_ElevationConfidence : 111|2@1+ (1,0) [0|3] ""  FR_CMR
 SG_ FLR_CT26_ExistanceProbability : 113|5@1+ (5,0) [0|100] "%"  FR_CMR
 SG_ FLR_CT26_Lifetime : 118|13@1+ (1,0) [0|8190] "Cycles"  FR_CMR
 SG_ FLR_CT26_ModelBoxHeading : 131|13@1- (0.001,0) [-3.15|3.15] "rad"  FR_CMR
 SG_ FLR_CT26_ModelBoxLength : 144|9@1+ (0.1,0) [0|50] "m"  FR_CMR
 SG_ FLR_CT26_ModelBoxWidth : 153|8@1+ (0.1,0) [0|25] "m"  FR_CMR
 SG_ FLR_CT26_ModelBoxX : 161|11@1+ (0.05,-25) [-25|75] "m"  FR_CMR
 SG_ FLR_CT26_ModelBoxY : 172|9@1- (0.1,0) [-25|25] "m"  FR_CMR
 SG_ FLR_CT26_MotionClass : 181|2@1+ (1,0) [0|3] ""  FR_CMR
 SG_ FLR_CT26_ObjectId : 183|16@1+ (1,0) [0|65535] ""  FR_CMR
 SG_ FLR_CT26_ObservationHistory : 199|16@1+ (1,0) [0|65535] ""  FR_CMR
 SG_ FLR_CT26_QualityBits : 215|18@1+ (1,0) [0|262143] ""  FR_CMR
 SG_ FLR_CT26_StationaryCounter : 233|16@1+ (1,0) [0|65535] ""  FR_CMR
 SG_ FLR_CT26_Type : 249|4@1+ (1,0) [0|8] ""  FR_CMR
 SG_ FLR_CT26_X_Acceleration : 253|9@1- (0.1,0) [-25|25] "m/s^2"  FR_CMR
 SG_ FLR_CT26_X_Velocity : 262|13@1- (0.05,0) [-120|120] "m/s"  FR_CMR
 SG_ FLR_CT26_X_VelocityStdDev : 275|7@1+ (0.05,0) [0|6] "m/s"  FR_CMR
 SG_ FLR_CT26_Y_Acceleration : 282|8@1- (0.25,0) [-25|25] "m/s^2"  FR_CMR
 SG_ FLR_CT26_Y_Velocity : 290|11@1- (0.1,0) [-100|100] "m/s"  FR_CMR
 SG_ FLR_CT26_Y_VelocityStdDev : 301|7@1+ (0.05,0) [0|6] "m/s"  FR_CMR

BO_ 411 L_FR_RDR_ClusterTrack27_50ms: 64 FR_RDR
 SG_ FLR_CT27_CrcVal : 0|16@1+ (1,0) [0|65535] ""  FR_CMR
 SG_ FLR_CT27_AlvCntVal : 16|8@1+ (1,0) [0|255] ""  FR_CMR
 SG_ FLR_CT27_ListIndex : 24|4@1+ (1,0) [0|15] ""  FR_CMR
 SG_ FLR_CT27_SequenceCounter : 28|4@1+ (1,0) [0|15] ""  FR_CMR
 SG_ FLR_CT27_TimeStamp : 32|32@1+ (1,0) [0|4294967295] ""  FR_CMR
 SG_ FLR_CT27_Latency : 64|8@1+ (1,0) [0|255] "ms"  FR_CMR
 SG_ FLR_CT27_ClosestPointX : 72|12@1+ (0.05,-3) [-3|200] "m"  FR_CMR
 SG_ FLR_CT27_ClosestPointXStdDev : 84|7@1+ (0.05,0) [0|6] "m"  FR_CMR
 SG_ FLR_CT27_ClosestPointY : 91|10@1- (0.1,0) [-51|51] "m"  FR_CMR
 SG_ FLR_CT27_ClosestPointYStdDev : 101|6@1+ (0.1,0) [0|6] "m"  FR_CMR
 SG_ FLR_CT27_Confidence : 107|2@1+ (1,0) [0|3] ""  FR_CMR
 SG_ FLR_CT27_Elevation : 109|2@1+ (1,0) [0|3] ""  FR_CMR
 SG_ FLR_CT27_ElevationConfidence : 111|2@1+ (1,0) [0|3] ""  FR_CMR
 SG_ FLR_CT27_ExistanceProbability : 113|5@1+ (5,0) [0|100] "%"  FR_CMR
 SG_ FLR_CT27_Lifetime : 118|13@1+ (1,0) [0|8190] "Cycles"  FR_CMR
 SG_ FLR_CT27_ModelBoxHeading : 131|13@1- (0.001,0) [-3.15|3.15] "rad"  FR_CMR
 SG_ FLR_CT27_ModelBoxLength : 144|9@1+ (0.1,0) [0|50] "m"  FR_CMR
 SG_ FLR_CT27_ModelBoxWidth : 153|8@1+ (0.1,0) [0|25] "m"  FR_CMR
 SG_ FLR_CT27_ModelBoxX : 161|11@1+ (0.05,-25) [-25|75] "m"  FR_CMR
 SG_ FLR_CT27_ModelBoxY : 172|9@1- (0.1,0) [-25|25] "m"  FR_CMR
 SG_ FLR_CT27_MotionClass : 181|2@1+ (1,0) [0|3] ""  FR_CMR
 SG_ FLR_CT27_ObjectId : 183|16@1+ (1,0) [0|65535] ""  FR_CMR
 SG_ FLR_CT27_ObservationHistory : 199|16@1+ (1,0) [0|65535] ""  FR_CMR
 SG_ FLR_CT27_QualityBits : 215|18@1+ (1,0) [0|262143] ""  FR_CMR
 SG_ FLR_CT27_StationaryCounter : 233|16@1+ (1,0) [0|65535] ""  FR_CMR
 SG_ FLR_CT27_Type : 249|4@1+ (1,0) [0|8] ""  FR_CMR
 SG_ FLR_CT27_X_Acceleration : 253|9@1- (0.1,0) [-25|25] "m/s^2"  FR_CMR
 SG_ FLR_CT27_X_Velocity : 262|13@1- (0.05,0) [-120|120] "m/s"  FR_CMR
 SG_ FLR_CT27_X_VelocityStdDev : 275|7@1+ (0.05,0) [0|6] "m/s"  FR_CMR
 SG_ FLR_CT27_Y_Acceleration : 282|8@1- (0.25,0) [-25|25] "m/s^2"  FR_CMR
 SG_ FLR_CT27_Y_Velocity : 290|11@1- (0.1,0) [-100|100] "m/s"  FR_CMR
 SG_ FLR_CT27_Y_VelocityStdDev : 301|7@1+ (0.05,0) [0|6] "m/s"  FR_CMR

BO_ 412 L_FR_RDR_ClusterTrack28_50ms: 64 FR_RDR
 SG_ FLR_CT28_CrcVal : 0|16@1+ (1,0) [0|65535] ""  FR_CMR
 SG_ FLR_CT28_AlvCntVal : 16|8@1+ (1,0) [0|255] ""  FR_CMR
 SG_ FLR_CT28_ListIndex : 24|4@1+ (1,0) [0|15] ""  FR_CMR
 SG_ FLR_CT28_SequenceCounter : 28|4@1+ (1,0) [0|15] ""  FR_CMR
 SG_ FLR_CT28_TimeStamp : 32|32@1+ (1,0) [0|4294967295] ""  FR_CMR
 SG_ FLR_CT28_Latency : 64|8@1+ (1,0) [0|255] "ms"  FR_CMR
 SG_ FLR_CT28_ClosestPointX : 72|12@1+ (0.05,-3) [-3|200] "m"  FR_CMR
 SG_ FLR_CT28_ClosestPointXStdDev : 84|7@1+ (0.05,0) [0|6] "m"  FR_CMR
 SG_ FLR_CT28_ClosestPointY : 91|10@1- (0.1,0) [-51|51] "m"  FR_CMR
 SG_ FLR_CT28_ClosestPointYStdDev : 101|6@1+ (0.1,0) [0|6] "m"  FR_CMR
 SG_ FLR_CT28_Confidence : 107|2@1+ (1,0) [0|3] ""  FR_CMR
 SG_ FLR_CT28_Elevation : 109|2@1+ (1,0) [0|3] ""  FR_CMR
 SG_ FLR_CT28_ElevationConfidence : 111|2@1+ (1,0) [0|3] ""  FR_CMR
 SG_ FLR_CT28_ExistanceProbability : 113|5@1+ (5,0) [0|100] "%"  FR_CMR
 SG_ FLR_CT28_Lifetime : 118|13@1+ (1,0) [0|8190] "Cycles"  FR_CMR
 SG_ FLR_CT28_ModelBoxHeading : 131|13@1- (0.001,0) [-3.15|3.15] "rad"  FR_CMR
 SG_ FLR_CT28_ModelBoxLength : 144|9@1+ (0.1,0) [0|50] "m"  FR_CMR
 SG_ FLR_CT28_ModelBoxWidth : 153|8@1+ (0.1,0) [0|25] "m"  FR_CMR
 SG_ FLR_CT28_ModelBoxX : 161|11@1+ (0.05,-25) [-25|75] "m"  FR_CMR
 SG_ FLR_CT28_ModelBoxY : 172|9@1- (0.1,0) [-25|25] "m"  FR_CMR
 SG_ FLR_CT28_MotionClass : 181|2@1+ (1,0) [0|3] ""  FR_CMR
 SG_ FLR_CT28_ObjectId : 183|16@1+ (1,0) [0|65535] ""  FR_CMR
 SG_ FLR_CT28_ObservationHistory : 199|16@1+ (1,0) [0|65535] ""  FR_CMR
 SG_ FLR_CT28_QualityBits : 215|18@1+ (1,0) [0|262143] ""  FR_CMR
 SG_ FLR_CT28_StationaryCounter : 233|16@1+ (1,0) [0|65535] ""  FR_CMR
 SG_ FLR_CT28_Type : 249|4@1+ (1,0) [0|8] ""  FR_CMR
 SG_ FLR_CT28_X_Acceleration : 253|9@1- (0.1,0) [-25|25] "m/s^2"  FR_CMR
 SG_ FLR_CT28_X_Velocity : 262|13@1- (0.05,0) [-120|120] "m/s"  FR_CMR
 SG_ FLR_CT28_X_VelocityStdDev : 275|7@1+ (0.05,0) [0|6] "m/s"  FR_CMR
 SG_ FLR_CT28_Y_Acceleration : 282|8@1- (0.25,0) [-25|25] "m/s^2"  FR_CMR
 SG_ FLR_CT28_Y_Velocity : 290|11@1- (0.1,0) [-100|100] "m/s"  FR_CMR
 SG_ FLR_CT28_Y_VelocityStdDev : 301|7@1+ (0.05,0) [0|6] "m/s"  FR_CMR

BO_ 413 L_FR_RDR_ClusterTrack29_50ms: 64 FR_RDR
 SG_ FLR_CT29_CrcVal : 0|16@1+ (1,0) [0|65535] ""  FR_CMR
 SG_ FLR_CT29_AlvCntVal : 16|8@1+ (1,0) [0|255] ""  FR_CMR
 SG_ FLR_CT29_ListIndex : 24|4@1+ (1,0) [0|15] ""  FR_CMR
 SG_ FLR_CT29_SequenceCounter : 28|4@1+ (1,0) [0|15] ""  FR_CMR
 SG_ FLR_CT29_TimeStamp : 32|32@1+ (1,0) [0|4294967295] ""  FR_CMR
 SG_ FLR_CT29_Latency : 64|8@1+ (1,0) [0|255] "ms"  FR_CMR
 SG_ FLR_CT29_ClosestPointX : 72|12@1+ (0.05,-3) [-3|200] "m"  FR_CMR
 SG_ FLR_CT29_ClosestPointXStdDev : 84|7@1+ (0.05,0) [0|6] "m"  FR_CMR
 SG_ FLR_CT29_ClosestPointY : 91|10@1- (0.1,0) [-51|51] "m"  FR_CMR
 SG_ FLR_CT29_ClosestPointYStdDev : 101|6@1+ (0.1,0) [0|6] "m"  FR_CMR
 SG_ FLR_CT29_Confidence : 107|2@1+ (1,0) [0|3] ""  FR_CMR
 SG_ FLR_CT29_Elevation : 109|2@1+ (1,0) [0|3] ""  FR_CMR
 SG_ FLR_CT29_ElevationConfidence : 111|2@1+ (1,0) [0|3] ""  FR_CMR
 SG_ FLR_CT29_ExistanceProbability : 113|5@1+ (5,0) [0|100] "%"  FR_CMR
 SG_ FLR_CT29_Lifetime : 118|13@1+ (1,0) [0|8190] "Cycles"  FR_CMR
 SG_ FLR_CT29_ModelBoxHeading : 131|13@1- (0.001,0) [-3.15|3.15] "rad"  FR_CMR
 SG_ FLR_CT29_ModelBoxLength : 144|9@1+ (0.1,0) [0|50] "m"  FR_CMR
 SG_ FLR_CT29_ModelBoxWidth : 153|8@1+ (0.1,0) [0|25] "m"  FR_CMR
 SG_ FLR_CT29_ModelBoxX : 161|11@1+ (0.05,-25) [-25|75] "m"  FR_CMR
 SG_ FLR_CT29_ModelBoxY : 172|9@1- (0.1,0) [-25|25] "m"  FR_CMR
 SG_ FLR_CT29_MotionClass : 181|2@1+ (1,0) [0|3] ""  FR_CMR
 SG_ FLR_CT29_ObjectId : 183|16@1+ (1,0) [0|65535] ""  FR_CMR
 SG_ FLR_CT29_ObservationHistory : 199|16@1+ (1,0) [0|65535] ""  FR_CMR
 SG_ FLR_CT29_QualityBits : 215|18@1+ (1,0) [0|262143] ""  FR_CMR
 SG_ FLR_CT29_StationaryCounter : 233|16@1+ (1,0) [0|65535] ""  FR_CMR
 SG_ FLR_CT29_Type : 249|4@1+ (1,0) [0|8] ""  FR_CMR
 SG_ FLR_CT29_X_Acceleration : 253|9@1- (0.1,0) [-25|25] "m/s^2"  FR_CMR
 SG_ FLR_CT29_X_Velocity : 262|13@1- (0.05,0) [-120|120] "m/s"  FR_CMR
 SG_ FLR_CT29_X_VelocityStdDev : 275|7@1+ (0.05,0) [0|6] "m/s"  FR_CMR
 SG_ FLR_CT29_Y_Acceleration : 282|8@1- (0.25,0) [-25|25] "m/s^2"  FR_CMR
 SG_ FLR_CT29_Y_Velocity : 290|11@1- (0.1,0) [-100|100] "m/s"  FR_CMR
 SG_ FLR_CT29_Y_VelocityStdDev : 301|7@1+ (0.05,0) [0|6] "m/s"  FR_CMR

BO_ 448 L_FR_RDR_StationaryTrack0_50ms: 64 FR_RDR
 SG_ FLR_ST0_CrcVal : 0|16@1+ (1,0) [0|65535] ""  FR_CMR
 SG_ FLR_ST0_AlvCntVal : 16|8@1+ (1,0) [0|255] ""  FR_CMR
 SG_ FLR_ST0_Elevation : 24|3@1+ (1,0) [0|5] ""  FR_CMR
 SG_ FLR_ST0_ElevationConfidence : 27|2@1+ (1,0) [0|3] ""  FR_CMR
 SG_ FLR_ST0_Lifetime : 29|8@1+ (1,0) [0|255] "Cycles"  FR_CMR
 SG_ FLR_ST0_ObjectId : 37|16@1+ (1,0) [0|65535] ""  FR_CMR
 SG_ FLR_ST0_PositionX : 53|12@1+ (0.05,-3) [-3|200] "m"  FR_CMR
 SG_ FLR_ST0_PositionY : 65|12@1- (0.05,0) [-100|100] "m"  FR_CMR
 SG_ FLR_ST0_PredictionCounter : 77|8@1+ (1,0) [0|255] "Cycles"  FR_CMR
 SG_ FLR_ST0_PropertyBits : 85|3@1+ (1,0) [0|7] ""  FR_CMR
 SG_ FLR_ST0_Quality : 88|2@1+ (1,0) [0|3] ""  FR_CMR
 SG_ FLR_ST0_X_Velocity : 90|13@1- (0.05,0) [-120|120] "m/s"  FR_CMR
 SG_ FLR_ST0_Y_Velocity : 103|13@1- (0.05,0) [-120|120] "m/s"  FR_CMR

BO_ 449 L_FR_RDR_StationaryTrack1_50ms: 64 FR_RDR
 SG_ FLR_ST1_CrcVal : 0|16@1+ (1,0) [0|65535] ""  FR_CMR
 SG_ FLR_ST1_AlvCntVal : 16|8@1+ (1,0) [0|255] ""  FR_CMR
 SG_ FLR_ST1_Elevation : 24|3@1+ (1,0) [0|5] ""  FR_CMR
 SG_ FLR_ST1_ElevationConfidence : 27|2@1+ (1,0) [0|3] ""  FR_CMR
 SG_ FLR_ST1_Lifetime : 29|8@1+ (1,0) [0|255] "Cycles"  FR_CMR
 SG_ FLR_ST1_ObjectId : 37|16@1+ (1,0) [0|65535] ""  FR_CMR
 SG_ FLR_ST1_PositionX : 53|12@1+ (0.05,-3) [-3|200] "m"  FR_CMR
 SG_ FLR_ST1_PositionY : 65|12@1- (0.05,0) [-100|100] "m"  FR_CMR
 SG_ FLR_ST1_PredictionCounter : 77|8@1+ (1,0) [0|255] "Cycles"  FR_CMR
 SG_ FLR_ST1_PropertyBits : 85|3@1+ (1,0) [0|7] ""  FR_CMR
 SG_ FLR_ST1_Quality : 88|2@1+ (1,0) [0|3] ""  FR_CMR
 SG_ FLR_ST1_X_Velocity : 90|13@1- (0.05,0) [-120|120] "m/s"  FR_CMR
 SG_ FLR_ST1_Y_Velocity : 103|13@1- (0.05,0) [-120|120] "m/s"  FR_CMR

BO_ 450 L_FR_RDR_StationaryTrack2_50ms: 64 FR_RDR
 SG_ FLR_ST2_CrcVal : 0|16@1+ (1,0) [0|65535] ""  FR_CMR
 SG_ FLR_ST2_AlvCntVal : 16|8@1+ (1,0) [0|255] ""  FR_CMR
 SG_ FLR_ST2_Elevation : 24|3@1+ (1,0) [0|5] ""  FR_CMR
 SG_ FLR_ST2_ElevationConfidence : 27|2@1+ (1,0) [0|3] ""  FR_CMR
 SG_ FLR_ST2_Lifetime : 29|8@1+ (1,0) [0|255] "Cycles"  FR_CMR
 SG_ FLR_ST2_ObjectId : 37|16@1+ (1,0) [0|65535] ""  FR_CMR
 SG_ FLR_ST2_PositionX : 53|12@1+ (0.05,-3) [-3|200] "m"  FR_CMR
 SG_ FLR_ST2_PositionY : 65|12@1- (0.05,0) [-100|100] "m"  FR_CMR
 SG_ FLR_ST2_PredictionCounter : 77|8@1+ (1,0) [0|255] "Cycles"  FR_CMR
 SG_ FLR_ST2_PropertyBits : 85|3@1+ (1,0) [0|7] ""  FR_CMR
 SG_ FLR_ST2_Quality : 88|2@1+ (1,0) [0|3] ""  FR_CMR
 SG_ FLR_ST2_X_Velocity : 90|13@1- (0.05,0) [-120|120] "m/s"  FR_CMR
 SG_ FLR_ST2_Y_Velocity : 103|13@1- (0.05,0) [-120|120] "m/s"  FR_CMR

BO_ 451 L_FR_RDR_StationaryTrack3_50ms: 64 FR_RDR
 SG_ FLR_ST3_CrcVal : 0|16@1+ (1,0) [0|65535] ""  FR_CMR
 SG_ FLR_ST3_AlvCntVal : 16|8@1+ (1,0) [0|255] ""  FR_CMR
 SG_ FLR_ST3_Elevation : 24|3@1+ (1,0) [0|5] ""  FR_CMR
 SG_ FLR_ST3_ElevationConfidence : 27|2@1+ (1,0) [0|3] ""  FR_CMR
 SG_ FLR_ST3_Lifetime : 29|8@1+ (1,0) [0|255] "Cycles"  FR_CMR
 SG_ FLR_ST3_ObjectId : 37|16@1+ (1,0) [0|65535] ""  FR_CMR
 SG_ FLR_ST3_PositionX : 53|12@1+ (0.05,-3) [-3|200] "m"  FR_CMR
 SG_ FLR_ST3_PositionY : 65|12@1- (0.05,0) [-100|100] "m"  FR_CMR
 SG_ FLR_ST3_PredictionCounter : 77|8@1+ (1,0) [0|255] "Cycles"  FR_CMR
 SG_ FLR_ST3_PropertyBits : 85|3@1+ (1,0) [0|7] ""  FR_CMR
 SG_ FLR_ST3_Quality : 88|2@1+ (1,0) [0|3] ""  FR_CMR
 SG_ FLR_ST3_X_Velocity : 90|13@1- (0.05,0) [-120|120] "m/s"  FR_CMR
 SG_ FLR_ST3_Y_Velocity : 103|13@1- (0.05,0) [-120|120] "m/s"  FR_CMR

CM_ BO_ 400 "[P] Periodic";
CM_ SG_ 400 FLR_CT16_CrcVal "CyclicRedundancyCheckValue";
CM_ SG_ 400 FLR_CT16_AlvCntVal "AliveCounter";
CM_ SG_ 400 FLR_CT16_ListIndex "TrackListIndex";
CM_ SG_ 400 FLR_CT16_SequenceCounter "SequenceCounter";
CM_ SG_ 400 FLR_CT16_TimeStamp "TimeStamp";
CM_ SG_ 400 FLR_CT16_Latency "Sensor latency";
CM_ SG_ 400 FLR_CT16_ClosestPointX "ClosestPointX";
CM_ SG_ 400 FLR_CT16_ClosestPointXStdDev "ClosestPointXStdDev";
CM_ SG_ 400 FLR_CT16_ClosestPointY "ClosestPointY";
CM_ SG_ 400 FLR_CT16_ClosestPointYStdDev "ClosestPointYStdDev";
CM_ SG_ 400 FLR_CT16_Confidence "Confidence";
CM_ SG_ 400 FLR_CT16_Elevation "Elevation";
CM_ SG_ 400 FLR_CT16_ElevationConfidence "ElevationConfidence";
CM_ SG_ 400 FLR_CT16_ExistanceProbability "ExistanceProbability";
CM_ SG_ 400 FLR_CT16_Lifetime "Lifetime";
CM_ SG_ 400 FLR_CT16_ModelBoxHeading "ModelBoxHeading";
CM_ SG_ 400 FLR_CT16_ModelBoxLength "ModelBoxLength";
CM_ SG_ 400 FLR_CT16_ModelBoxWidth "ModelBoxWidth";
CM_ SG_ 400 FLR_CT16_ModelBoxX "ModelBoxX";
CM_ SG_ 400 FLR_CT16_ModelBoxY "ModelBoxY";
CM_ SG_ 400 FLR_CT16_MotionClass "MotionClass";
CM_ SG_ 400 FLR_CT16_ObjectId "ObjectId";
CM_ SG_ 400 FLR_CT16_ObservationHistory "ObservationHistory";
CM_ SG_ 400 FLR_CT16_QualityBits "QualityBits";
CM_ SG_ 400 FLR_CT16_StationaryCounter "StationaryCounter";
CM_ SG_ 400 FLR_CT16_Type "Type";
CM_ SG_ 400 FLR_CT16_X_Acceleration "X_Acceleration";
CM_ SG_ 400 FLR_CT16_X_Velocity "X_Velocity";
CM_ SG_ 400 FLR_CT16_X_VelocityStdDev "X_VelocityStdDev";
CM_ SG_ 400 FLR_CT16_Y_Acceleration "Y_Acceleration";
CM_ SG_ 400 FLR_CT16_Y_Velocity "Y_Velocity";
CM_ SG_ 400 FLR_CT16_Y_VelocityStdDev "Y_VelocityStdDev";
CM_ BO_ 401 "[P] Periodic";
CM_ SG_ 401 FLR_CT17_CrcVal "CyclicRedundancyCheckValue";
CM_ SG_ 401 FLR_CT17_AlvCntVal "AliveCounter";
CM_ SG_ 401 FLR_CT17_ListIndex "TrackListIndex";
CM_ SG_ 401 FLR_CT17_SequenceCounter "SequenceCounter";
CM_ SG_ 401 FLR_CT17_TimeStamp "TimeStamp";
CM_ SG_ 401 FLR_CT17_Latency "Sensor latency";
CM_ SG_ 401 FLR_CT17_ClosestPointX "ClosestPointX";
CM_ SG_ 401 FLR_CT17_ClosestPointXStdDev "ClosestPointXStdDev";
CM_ SG_ 401 FLR_CT17_ClosestPointY "ClosestPointY";
CM_ SG_ 401 FLR_CT17_ClosestPointYStdDev "ClosestPointYStdDev";
CM_ SG_ 401 FLR_CT17_Confidence "Confidence";
CM_ SG_ 401 FLR_CT17_Elevation "Elevation";
CM_ SG_ 401 FLR_CT17_ElevationConfidence "ElevationConfidence";
CM_ SG_ 401 FLR_CT17_ExistanceProbability "ExistanceProbability";
CM_ SG_ 401 FLR_CT17_Lifetime "Lifetime";
CM_ SG_ 401 FLR_CT17_ModelBoxHeading "ModelBoxHeading";
CM_ SG_ 401 FLR_CT17_ModelBoxLength "ModelBoxLength";
CM_ SG_ 401 FLR_CT17_ModelBoxWidth "ModelBoxWidth";
CM_ SG_ 401 FLR_CT17_ModelBoxX "ModelBoxX";
CM_ SG_ 401 FLR_CT17_ModelBoxY "ModelBoxY";
CM_ SG_ 401 FLR_CT17_MotionClass "MotionClass";
CM_ SG_ 401 FLR_CT17_ObjectId "ObjectId";
CM_ SG_ 401 FLR_CT17_ObservationHistory "ObservationHistory";
CM_ SG_ 401 FLR_CT17_QualityBits "QualityBits";
CM_ SG_ 401 FLR_CT17_StationaryCounter "StationaryCounter";
CM_ SG_ 401 FLR_CT17_Type "Type";
CM_ SG_ 401 FLR_CT17_X_Acceleration "X_Acceleration";
CM_ SG_ 401 FLR_CT17_X_Velocity "X_Velocity";
CM_ SG_ 401 FLR_CT17_X_VelocityStdDev "X_VelocityStdDev";
CM_ SG_ 401 FLR_CT17_Y_Acceleration "Y_Acceleration";
CM_ SG_ 401 FLR_CT17_Y_Velocity "Y_Velocity";
CM_ SG_ 401 FLR_CT17_Y_VelocityStdDev "Y_VelocityStdDev";
CM_ BO_ 402 "[P] Periodic";
CM_ SG_ 402 FLR_CT18_CrcVal "CyclicRedundancyCheckValue";
CM_ SG_ 402 FLR_CT18_AlvCntVal "AliveCounter";
CM_ SG_ 402 FLR_CT18_ListIndex "TrackListIndex";
CM_ SG_ 402 FLR_CT18_SequenceCounter "SequenceCounter";
CM_ SG_ 402 FLR_CT18_TimeStamp "TimeStamp";
CM_ SG_ 402 FLR_CT18_Latency "Sensor latency";
CM_ SG_ 402 FLR_CT18_ClosestPointX "ClosestPointX";
CM_ SG_ 402 FLR_CT18_ClosestPointXStdDev "ClosestPointXStdDev";
CM_ SG_ 402 FLR_CT18_ClosestPointY "ClosestPointY";
CM_ SG_ 402 FLR_CT18_ClosestPointYStdDev "ClosestPointYStdDev";
CM_ SG_ 402 FLR_CT18_Confidence "Confidence";
CM_ SG_ 402 FLR_CT18_Elevation "Elevation";
CM_ SG_ 402 FLR_CT18_ElevationConfidence "ElevationConfidence";
CM_ SG_ 402 FLR_CT18_ExistanceProbability "ExistanceProbability";
CM_ SG_ 402 FLR_CT18_Lifetime "Lifetime";
CM_ SG_ 402 FLR_CT18_ModelBoxHeading "ModelBoxHeading";
CM_ SG_ 402 FLR_CT18_ModelBoxLength "ModelBoxLength";
CM_ SG_ 402 FLR_CT18_ModelBoxWidth "ModelBoxWidth";
CM_ SG_ 402 FLR_CT18_ModelBoxX "ModelBoxX";
CM_ SG_ 402 FLR_CT18_ModelBoxY "ModelBoxY";
CM_ SG_ 402 FLR_CT18_MotionClass "MotionClass";
CM_ SG_ 402 FLR_CT18_ObjectId "ObjectId";
CM_ SG_ 402 FLR_CT18_ObservationHistory "ObservationHistory";
CM_ SG_ 402 FLR_CT18_QualityBits "QualityBits";
CM_ SG_ 402 FLR_CT18_StationaryCounter "StationaryCounter";
CM_ SG_ 402 FLR_CT18_Type "Type";
CM_ SG_ 402 FLR_CT18_X_Acceleration "X_Acceleration";
CM_ SG_ 402 FLR_CT18_X_Velocity "X_Velocity";
CM_ SG_ 402 FLR_CT18_X_VelocityStdDev "X_VelocityStdDev";
CM_ SG_ 402 FLR_CT18_Y_Acceleration "Y_Acceleration";
CM_ SG_ 402 FLR_CT18_Y_Velocity "Y_Velocity";
CM_ SG_ 402 FLR_CT18_Y_VelocityStdDev "Y_VelocityStdDev";
CM_ BO_ 403 "[P] Periodic";
CM_ SG_ 403 FLR_CT19_CrcVal "CyclicRedundancyCheckValue";
CM_ SG_ 403 FLR_CT19_AlvCntVal "AliveCounter";
CM_ SG_ 403 FLR_CT19_ListIndex "TrackListIndex";
CM_ SG_ 403 FLR_CT19_SequenceCounter "SequenceCounter";
CM_ SG_ 403 FLR_CT19_TimeStamp "TimeStamp";
CM_ SG_ 403 FLR_CT19_Latency "Sensor latency";
CM_ SG_ 403 FLR_CT19_ClosestPointX "ClosestPointX";
CM_ SG_ 403 FLR_CT19_ClosestPointXStdDev "ClosestPointXStdDev";
CM_ SG_ 403 FLR_CT19_ClosestPointY "ClosestPointY";
CM_ SG_ 403 FLR_CT19_ClosestPointYStdDev "ClosestPointYStdDev";
CM_ SG_ 403 FLR_CT19_Confidence "Confidence";
CM_ SG_ 403 FLR_CT19_Elevation "Elevation";
CM_ SG_ 403 FLR_CT19_ElevationConfidence "ElevationConfidence";
CM_ SG_ 403 FLR_CT19_ExistanceProbability "ExistanceProbability";
CM_ SG_ 403 FLR_CT19_Lifetime "Lifetime";
CM_ SG_ 403 FLR_CT19_ModelBoxHeading "ModelBoxHeading";
CM_ SG_ 403 FLR_CT19_ModelBoxLength "ModelBoxLength";
CM_ SG_ 403 FLR_CT19_ModelBoxWidth "ModelBoxWidth";
CM_ SG_ 403 FLR_CT19_ModelBoxX "ModelBoxX";
CM_ SG_ 403 FLR_CT19_ModelBoxY "ModelBoxY";
CM_ SG_ 403 FLR_CT19_MotionClass "MotionClass";
CM_ SG_ 403 FLR_CT19_ObjectId "ObjectId";
CM_ SG_ 403 FLR_CT19_ObservationHistory "ObservationHistory";
CM_ SG_ 403 FLR_CT19_QualityBits "QualityBits";
CM_ SG_ 403 FLR_CT19_StationaryCounter "StationaryCounter";
CM_ SG_ 403 FLR_CT19_Type "Type";
CM_ SG_ 403 FLR_CT19_X_Acceleration "X_Acceleration";
CM_ SG_ 403 FLR_CT19_X_Velocity "X_Velocity";
CM_ SG_ 403 FLR_CT19_X_VelocityStdDev "X_VelocityStdDev";
CM_ SG_ 403 FLR_CT19_Y_Acceleration "Y_Acceleration";
CM_ SG_ 403 FLR_CT19_Y_Velocity "Y_Velocity";
CM_ SG_ 403 FLR_CT19_Y_VelocityStdDev "Y_VelocityStdDev";
CM_ BO_ 404 "[P] Periodic";
CM_ SG_ 404 FLR_CT20_CrcVal "CyclicRedundancyCheckValue";
CM_ SG_ 404 FLR_CT20_AlvCntVal "AliveCounter";
CM_ SG_ 404 FLR_CT20_ListIndex "TrackListIndex";
CM_ SG_ 404 FLR_CT20_SequenceCounter "SequenceCounter";
CM_ SG_ 404 FLR_CT20_TimeStamp "TimeStamp";
CM_ SG_ 404 FLR_CT20_Latency "Sensor latency";
CM_ SG_ 404 FLR_CT20_ClosestPointX "ClosestPointX";
CM_ SG_ 404 FLR_CT20_ClosestPointXStdDev "ClosestPointXStdDev";
CM_ SG_ 404 FLR_CT20_ClosestPointY "ClosestPointY";
CM_ SG_ 404 FLR_CT20_ClosestPointYStdDev "ClosestPointYStdDev";
CM_ SG_ 404 FLR_CT20_Confidence "Confidence";
CM_ SG_ 404 FLR_CT20_Elevation "Elevation";
CM_ SG_ 404 FLR_CT20_ElevationConfidence "ElevationConfidence";
CM_ SG_ 404 FLR_CT20_ExistanceProbability "ExistanceProbability";
CM_ SG_ 404 FLR_CT20_Lifetime "Lifetime";
CM_ SG_ 404 FLR_CT20_ModelBoxHeading "ModelBoxHeading";
CM_ SG_ 404 FLR_CT20_ModelBoxLength "ModelBoxLength";
CM_ SG_ 404 FLR_CT20_ModelBoxWidth "ModelBoxWidth";
CM_ SG_ 404 FLR_CT20_ModelBoxX "ModelBoxX";
CM_ SG_ 404 FLR_CT20_ModelBoxY "ModelBoxY";
CM_ SG_ 404 FLR_CT20_MotionClass "MotionClass";
CM_ SG_ 404 FLR_CT20_ObjectId "ObjectId";
CM_ SG_ 404 FLR_CT20_ObservationHistory "ObservationHistory";
CM_ SG_ 404 FLR_CT20_QualityBits "QualityBits";
CM_ SG_ 404 FLR_CT20_StationaryCounter "StationaryCounter";
CM_ SG_ 404 FLR_CT20_Type "Type";
CM_ SG_ 404 FLR_CT20_X_Acceleration "X_Acceleration";
CM_ SG_ 404 FLR_CT20_X_Velocity "X_Velocity";
CM_ SG_ 404 FLR_CT20_X_VelocityStdDev "X_VelocityStdDev";
CM_ SG_ 404 FLR_CT20_Y_Acceleration "Y_Acceleration";
CM_ SG_ 404 FLR_CT20_Y_Velocity "Y_Velocity";
CM_ SG_ 404 FLR_CT20_Y_VelocityStdDev "Y_VelocityStdDev";
CM_ BO_ 405 "[P] Periodic";
CM_ SG_ 405 FLR_CT21_CrcVal "CyclicRedundancyCheckValue";
CM_ SG_ 405 FLR_CT21_AlvCntVal "AliveCounter";
CM_ SG_ 405 FLR_CT21_ListIndex "TrackListIndex";
CM_ SG_ 405 FLR_CT21_SequenceCounter "SequenceCounter";
CM_ SG_ 405 FLR_CT21_TimeStamp "TimeStamp";
CM_ SG_ 405 FLR_CT21_Latency "Sensor latency";
CM_ SG_ 405 FLR_CT21_ClosestPointX "ClosestPointX";
CM_ SG_ 405 FLR_CT21_ClosestPointXStdDev "ClosestPointXStdDev";
CM_ SG_ 405 FLR_CT21_ClosestPointY "ClosestPointY";
CM_ SG_ 405 FLR_CT21_ClosestPointYStdDev "ClosestPointYStdDev";
CM_ SG_ 405 FLR_CT21_Confidence "Confidence";
CM_ SG_ 405 FLR_CT21_Elevation "Elevation";
CM_ SG_ 405 FLR_CT21_ElevationConfidence "ElevationConfidence";
CM_ SG_ 405 FLR_CT21_ExistanceProbability "ExistanceProbability";
CM_ SG_ 405 FLR_CT21_Lifetime "Lifetime";
CM_ SG_ 405 FLR_CT21_ModelBoxHeading "ModelBoxHeading";
CM_ SG_ 405 FLR_CT21_ModelBoxLength "ModelBoxLength";
CM_ SG_ 405 FLR_CT21_ModelBoxWidth "ModelBoxWidth";
CM_ SG_ 405 FLR_CT21_ModelBoxX "ModelBoxX";
CM_ SG_ 405 FLR_CT21_ModelBoxY "ModelBoxY";
CM_ SG_ 405 FLR_CT21_MotionClass "MotionClass";
CM_ SG_ 405 FLR_CT21_ObjectId "ObjectId";
CM_ SG_ 405 FLR_CT21_ObservationHistory "ObservationHistory";
CM_ SG_ 405 FLR_CT21_QualityBits "QualityBits";
CM_ SG_ 405 FLR_CT21_StationaryCounter "StationaryCounter";
CM_ SG_ 405 FLR_CT21_Type "Type";
CM_ SG_ 405 FLR_CT21_X_Acceleration "X_Acceleration";
CM_ SG_ 405 FLR_CT21_X_Velocity "X_Velocity";
CM_ SG_ 405 FLR_CT21_X_VelocityStdDev "X_VelocityStdDev";
CM_ SG_ 405 FLR_CT21_Y_Acceleration "Y_Acceleration";
CM_ SG_ 405 FLR_CT21_Y_Velocity "Y_Velocity";
CM_ SG_ 405 FLR_CT21_Y_VelocityStdDev "Y_VelocityStdDev";
CM_ BO_ 406 "[P] Periodic";
CM_ SG_ 406 FLR_CT22_CrcVal "CyclicRedundancyCheckValue";
CM_ SG_ 406 FLR_CT22_AlvCntVal "AliveCounter";
CM_ SG_ 406 FLR_CT22_ListIndex "TrackListIndex";
CM_ SG_ 406 FLR_CT22_SequenceCounter "SequenceCounter";
CM_ SG_ 406 FLR_CT22_TimeStamp "TimeStamp";
CM_ SG_ 406 FLR_CT22_Latency "Sensor latency";
CM_ SG_ 406 FLR_CT22_ClosestPointX "ClosestPointX";
CM_ SG_ 406 FLR_CT22_ClosestPointXStdDev "ClosestPointXStdDev";
CM_ SG_ 406 FLR_CT22_ClosestPointY "ClosestPointY";
CM_ SG_ 406 FLR_CT22_ClosestPointYStdDev "ClosestPointYStdDev";
CM_ SG_ 406 FLR_CT22_Confidence "Confidence";
CM_ SG_ 406 FLR_CT22_Elevation "Elevation";
CM_ SG_ 406 FLR_CT22_ElevationConfidence "ElevationConfidence";
CM_ SG_ 406 FLR_CT22_ExistanceProbability "ExistanceProbability";
CM_ SG_ 406 FLR_CT22_Lifetime "Lifetime";
CM_ SG_ 406 FLR_CT22_ModelBoxHeading "ModelBoxHeading";
CM_ SG_ 406 FLR_CT22_ModelBoxLength "ModelBoxLength";
CM_ SG_ 406 FLR_CT22_ModelBoxWidth "ModelBoxWidth";
CM_ SG_ 406 FLR_CT22_ModelBoxX "ModelBoxX";
CM_ SG_ 406 FLR_CT22_ModelBoxY "ModelBoxY";
CM_ SG_ 406 FLR_CT22_MotionClass "MotionClass";
CM_ SG_ 406 FLR_CT22_ObjectId "ObjectId";
CM_ SG_ 406 FLR_CT22_ObservationHistory "ObservationHistory";
CM_ SG_ 406 FLR_CT22_QualityBits "QualityBits";
CM_ SG_ 406 FLR_CT22_StationaryCounter "StationaryCounter";
CM_ SG_ 406 FLR_CT22_Type "Type";
CM_ SG_ 406 FLR_CT22_X_Acceleration "X_Acceleration";
CM_ SG_ 406 FLR_CT22_X_Velocity "X_Velocity";
CM_ SG_ 406 FLR_CT22_X_VelocityStdDev "X_VelocityStdDev";
CM_ SG_ 406 FLR_CT22_Y_Acceleration "Y_Acceleration";
CM_ SG_ 406 FLR_CT22_Y_Velocity "Y_Velocity";
CM_ SG_ 406 FLR_CT22_Y_VelocityStdDev "Y_VelocityStdDev";
CM_ BO_ 407 "[P] Periodic";
CM_ SG_ 407 FLR_CT23_CrcVal "CyclicRedundancyCheckValue";
CM_ SG_ 407 FLR_CT23_AlvCntVal "AliveCounter";
CM_ SG_ 407 FLR_CT23_ListIndex "TrackListIndex";
CM_ SG_ 407 FLR_CT23_SequenceCounter "SequenceCounter";
CM_ SG_ 407 FLR_CT23_TimeStamp "TimeStamp";
CM_ SG_ 407 FLR_CT23_Latency "Sensor latency";
CM_ SG_ 407 FLR_CT23_ClosestPointX "ClosestPointX";
CM_ SG_ 407 FLR_CT23_ClosestPointXStdDev "ClosestPointXStdDev";
CM_ SG_ 407 FLR_CT23_ClosestPointY "ClosestPointY";
CM_ SG_ 407 FLR_CT23_ClosestPointYStdDev "ClosestPointYStdDev";
CM_ SG_ 407 FLR_CT23_Confidence "Confidence";
CM_ SG_ 407 FLR_CT23_Elevation "Elevation";
CM_ SG_ 407 FLR_CT23_ElevationConfidence "ElevationConfidence";
CM_ SG_ 407 FLR_CT23_ExistanceProbability "ExistanceProbability";
CM_ SG_ 407 FLR_CT23_Lifetime "Lifetime";
CM_ SG_ 407 FLR_CT23_ModelBoxHeading "ModelBoxHeading";
CM_ SG_ 407 FLR_CT23_ModelBoxLength "ModelBoxLength";
CM_ SG_ 407 FLR_CT23_ModelBoxWidth "ModelBoxWidth";
CM_ SG_ 407 FLR_CT23_ModelBoxX "ModelBoxX";
CM_ SG_ 407 FLR_CT23_ModelBoxY "ModelBoxY";
CM_ SG_ 407 FLR_CT23_MotionClass "MotionClass";
CM_ SG_ 407 FLR_CT23_ObjectId "ObjectId";
CM_ SG_ 407 FLR_CT23_ObservationHistory "ObservationHistory";
CM_ SG_ 407 FLR_CT23_QualityBits "QualityBits";
CM_ SG_ 407 FLR_CT23_StationaryCounter "StationaryCounter";
CM_ SG_ 407 FLR_CT23_Type "Type";
CM_ SG_ 407 FLR_CT23_X_Acceleration "X_Acceleration";
CM_ SG_ 407 FLR_CT23_X_Velocity "X_Velocity";
CM_ SG_ 407 FLR_CT23_X_VelocityStdDev "X_VelocityStdDev";
CM_ SG_ 407 FLR_CT23_Y_Acceleration "Y_Acceleration";
CM_ SG_ 407 FLR_CT23_Y_Velocity "Y_Velocity";
CM_ SG_ 407 FLR_CT23_Y_VelocityStdDev "Y_VelocityStdDev";
CM_ BO_ 408 "[P] Periodic";
CM_ SG_ 408 FLR_CT24_CrcVal "CyclicRedundancyCheckValue";
CM_ SG_ 408 FLR_CT24_AlvCntVal "AliveCounter";
CM_ SG_ 408 FLR_CT24_ListIndex "TrackListIndex";
CM_ SG_ 408 FLR_CT24_SequenceCounter "SequenceCounter";
CM_ SG_ 408 FLR_CT24_TimeStamp "TimeStamp";
CM_ SG_ 408 FLR_CT24_Latency "Sensor latency";
CM_ SG_ 408 FLR_CT24_ClosestPointX "ClosestPointX";
CM_ SG_ 408 FLR_CT24_ClosestPointXStdDev "ClosestPointXStdDev";
CM_ SG_ 408 FLR_CT24_ClosestPointY "ClosestPointY";
CM_ SG_ 408 FLR_CT24_ClosestPointYStdDev "ClosestPointYStdDev";
CM_ SG_ 408 FLR_CT24_Confidence "Confidence";
CM_ SG_ 408 FLR_CT24_Elevation "Elevation";
CM_ SG_ 408 FLR_CT24_ElevationConfidence "ElevationConfidence";
CM_ SG_ 408 FLR_CT24_ExistanceProbability "ExistanceProbability";
CM_ SG_ 408 FLR_CT24_Lifetime "Lifetime";
CM_ SG_ 408 FLR_CT24_ModelBoxHeading "ModelBoxHeading";
CM_ SG_ 408 FLR_CT24_ModelBoxLength "ModelBoxLength";
CM_ SG_ 408 FLR_CT24_ModelBoxWidth "ModelBoxWidth";
CM_ SG_ 408 FLR_CT24_ModelBoxX "ModelBoxX";
CM_ SG_ 408 FLR_CT24_ModelBoxY "ModelBoxY";
CM_ SG_ 408 FLR_CT24_MotionClass "MotionClass";
CM_ SG_ 408 FLR_CT24_ObjectId "ObjectId";
CM_ SG_ 408 FLR_CT24_ObservationHistory "ObservationHistory";
CM_ SG_ 408 FLR_CT24_QualityBits "QualityBits";
CM_ SG_ 408 FLR_CT24_StationaryCounter "StationaryCounter";
CM_ SG_ 408 FLR_CT24_Type "Type";
CM_ SG_ 408 FLR_CT24_X_Acceleration "X_Acceleration";
CM_ SG_ 408 FLR_CT24_X_Velocity "X_Velocity";
CM_ SG_ 408 FLR_CT24_X_VelocityStdDev "X_VelocityStdDev";
CM_ SG_ 408 FLR_CT24_Y_Acceleration "Y_Acceleration";
CM_ SG_ 408 FLR_CT24_Y_Velocity "Y_Velocity";
CM_ SG_ 408 FLR_CT24_Y_VelocityStdDev "Y_VelocityStdDev";
CM_ BO_ 409 "[P] Periodic";
CM_ SG_ 409 FLR_CT25_CrcVal "CyclicRedundancyCheckValue";
CM_ SG_ 409 FLR_CT25_AlvCntVal "AliveCounter";
CM_ SG_ 409 FLR_CT25_ListIndex "TrackListIndex";
CM_ SG_ 409 FLR_CT25_SequenceCounter "SequenceCounter";
CM_ SG_ 409 FLR_CT25_TimeStamp "TimeStamp";
CM_ SG_ 409 FLR_CT25_Latency "Sensor latency";
CM_ SG_ 409 FLR_CT25_ClosestPointX "ClosestPointX";
CM_ SG_ 409 FLR_CT25_ClosestPointXStdDev "ClosestPointXStdDev";
CM_ SG_ 409 FLR_CT25_ClosestPointY "ClosestPointY";
CM_ SG_ 409 FLR_CT25_ClosestPointYStdDev "ClosestPointYStdDev";
CM_ SG_ 409 FLR_CT25_Confidence "Confidence";
CM_ SG_ 409 FLR_CT25_Elevation "Elevation";
CM_ SG_ 409 FLR_CT25_ElevationConfidence "ElevationConfidence";
CM_ SG_ 409 FLR_CT25_ExistanceProbability "ExistanceProbability";
CM_ SG_ 409 FLR_CT25_Lifetime "Lifetime";
CM_ SG_ 409 FLR_CT25_ModelBoxHeading "ModelBoxHeading";
CM_ SG_ 409 FLR_CT25_ModelBoxLength "ModelBoxLength";
CM_ SG_ 409 FLR_CT25_ModelBoxWidth "ModelBoxWidth";
CM_ SG_ 409 FLR_CT25_ModelBoxX "ModelBoxX";
CM_ SG_ 409 FLR_CT25_ModelBoxY "ModelBoxY";
CM_ SG_ 409 FLR_CT25_MotionClass "MotionClass";
CM_ SG_ 409 FLR_CT25_ObjectId "ObjectId";
CM_ SG_ 409 FLR_CT25_ObservationHistory "ObservationHistory";
CM_ SG_ 409 FLR_CT25_QualityBits "QualityBits";
CM_ SG_ 409 FLR_CT25_StationaryCounter "StationaryCounter";
CM_ SG_ 409 FLR_CT25_Type "Type";
CM_ SG_ 409 FLR_CT25_X_Acceleration "X_Acceleration";
CM_ SG_ 409 FLR_CT25_X_Velocity "X_Velocity";
CM_ SG_ 409 FLR_CT25_X_VelocityStdDev "X_VelocityStdDev";
CM_ SG_ 409 FLR_CT25_Y_Acceleration "Y_Acceleration";
CM_ SG_ 409 FLR_CT25_Y_Velocity "Y_Velocity";
CM_ SG_ 409 FLR_CT25_Y_VelocityStdDev "Y_VelocityStdDev";
CM_ BO_ 410 "[P] Periodic";
CM_ SG_ 410 FLR_CT26_CrcVal "CyclicRedundancyCheckValue";
CM_ SG_ 410 FLR_CT26_AlvCntVal "AliveCounter";
CM_ SG_ 410 FLR_CT26_ListIndex "TrackListIndex";
CM_ SG_ 410 FLR_CT26_SequenceCounter "SequenceCounter";
CM_ SG_ 410 FLR_CT26_TimeStamp "TimeStamp";
CM_ SG_ 410 FLR_CT26_Latency "Sensor latency";
CM_ SG_ 410 FLR_CT26_ClosestPointX "ClosestPointX";
CM_ SG_ 410 FLR_CT26_ClosestPointXStdDev "ClosestPointXStdDev";
CM_ SG_ 410 FLR_CT26_ClosestPointY "ClosestPointY";
CM_ SG_ 410 FLR_CT26_ClosestPointYStdDev "ClosestPointYStdDev";
CM_ SG_ 410 FLR_CT26_Confidence "Confidence";
CM_ SG_ 410 FLR_CT26_Elevation "Elevation";
CM_ SG_ 410 FLR_CT26_ElevationConfidence "ElevationConfidence";
CM_ SG_ 410 FLR_CT26_ExistanceProbability "ExistanceProbability";
CM_ SG_ 410 FLR_CT26_Lifetime "Lifetime";
CM_ SG_ 410 FLR_CT26_ModelBoxHeading "ModelBoxHeading";
CM_ SG_ 410 FLR_CT26_ModelBoxLength "ModelBoxLength";
CM_ SG_ 410 FLR_CT26_ModelBoxWidth "ModelBoxWidth";
CM_ SG_ 410 FLR_CT26_ModelBoxX "ModelBoxX";
CM_ SG_ 410 FLR_CT26_ModelBoxY "ModelBoxY";
CM_ SG_ 410 FLR_CT26_MotionClass "MotionClass";
CM_ SG_ 410 FLR_CT26_ObjectId "ObjectId";
CM_ SG_ 410 FLR_CT26_ObservationHistory "ObservationHistory";
CM_ SG_ 410 FLR_CT26_QualityBits "QualityBits";
CM_ SG_ 410 FLR_CT26_StationaryCounter "StationaryCounter";
CM_ SG_ 410 FLR_CT26_Type "Type";
CM_ SG_ 410 FLR_CT26_X_Acceleration "X_Acceleration";
CM_ SG_ 410 FLR_CT26_X_Velocity "X_Velocity";
CM_ SG_ 410 FLR_CT26_X_VelocityStdDev "X_VelocityStdDev";
CM_ SG_ 410 FLR_CT26_Y_Acceleration "Y_Acceleration";
CM_ SG_ 410 FLR_CT26_Y_Velocity "Y_Velocity";
CM_ SG_ 410 FLR_CT26_Y_VelocityStdDev "Y_VelocityStdDev";
CM_ BO_ 411 "[P] Periodic";
CM_ SG_ 411 FLR_CT27_CrcVal "CyclicRedundancyCheckValue";
CM_ SG_ 411 FLR_CT27_AlvCntVal "AliveCounter";
CM_ SG_ 411 FLR_CT27_ListIndex "TrackListIndex";
CM_ SG_ 411 FLR_CT27_SequenceCounter "SequenceCounter";
CM_ SG_ 411 FLR_CT27_TimeStamp "TimeStamp";
CM_ SG_ 411 FLR_CT27_Latency "Sensor latency";
CM_ SG_ 411 FLR_CT27_ClosestPointX "ClosestPointX";
CM_ SG_ 411 FLR_CT27_ClosestPointXStdDev "ClosestPointXStdDev";
CM_ SG_ 411 FLR_CT27_ClosestPointY "ClosestPointY";
CM_ SG_ 411 FLR_CT27_ClosestPointYStdDev "ClosestPointYStdDev";
CM_ SG_ 411 FLR_CT27_Confidence "Confidence";
CM_ SG_ 411 FLR_CT27_Elevation "Elevation";
CM_ SG_ 411 FLR_CT27_ElevationConfidence "ElevationConfidence";
CM_ SG_ 411 FLR_CT27_ExistanceProbability "ExistanceProbability";
CM_ SG_ 411 FLR_CT27_Lifetime "Lifetime";
CM_ SG_ 411 FLR_CT27_ModelBoxHeading "ModelBoxHeading";
CM_ SG_ 411 FLR_CT27_ModelBoxLength "ModelBoxLength";
CM_ SG_ 411 FLR_CT27_ModelBoxWidth "ModelBoxWidth";
CM_ SG_ 411 FLR_CT27_ModelBoxX "ModelBoxX";
CM_ SG_ 411 FLR_CT27_ModelBoxY "ModelBoxY";
CM_ SG_ 411 FLR_CT27_MotionClass "MotionClass";
CM_ SG_ 411 FLR_CT27_ObjectId "ObjectId";
CM_ SG_ 411 FLR_CT27_ObservationHistory "ObservationHistory";
CM_ SG_ 411 FLR_CT27_QualityBits "QualityBits";
CM_ SG_ 411 FLR_CT27_StationaryCounter "StationaryCounter";
CM_ SG_ 411 FLR_CT27_Type "Type";
CM_ SG_ 411 FLR_CT27_X_Acceleration "X_Acceleration";
CM_ SG_ 411 FLR_CT27_X_Velocity "X_Velocity";
CM_ SG_ 411 FLR_CT27_X_VelocityStdDev "X_VelocityStdDev";
CM_ SG_ 411 FLR_CT27_Y_Acceleration "Y_Acceleration";
CM_ SG_ 411 FLR_CT27_Y_Velocity "Y_Velocity";
CM_ SG_ 411 FLR_CT27_Y_VelocityStdDev "Y_VelocityStdDev";
CM_ BO_ 412 "[P] Periodic";
CM_ SG_ 412 FLR_CT28_CrcVal "CyclicRedundancyCheckValue";
CM_ SG_ 412 FLR_CT28_AlvCntVal "AliveCounter";
CM_ SG_ 412 FLR_CT28_ListIndex "TrackListIndex";
CM_ SG_ 412 FLR_CT28_SequenceCounter "SequenceCounter";
CM_ SG_ 412 FLR_CT28_TimeStamp "TimeStamp";
CM_ SG_ 412 FLR_CT28_Latency "Sensor latency";
CM_ SG_ 412 FLR_CT28_ClosestPointX "ClosestPointX";
CM_ SG_ 412 FLR_CT28_ClosestPointXStdDev "ClosestPointXStdDev";
CM_ SG_ 412 FLR_CT28_ClosestPointY "ClosestPointY";
CM_ SG_ 412 FLR_CT28_ClosestPointYStdDev "ClosestPointYStdDev";
CM_ SG_ 412 FLR_CT28_Confidence "Confidence";
CM_ SG_ 412 FLR_CT28_Elevation "Elevation";
CM_ SG_ 412 FLR_CT28_ElevationConfidence "ElevationConfidence";
CM_ SG_ 412 FLR_CT28_ExistanceProbability "ExistanceProbability";
CM_ SG_ 412 FLR_CT28_Lifetime "Lifetime";
CM_ SG_ 412 FLR_CT28_ModelBoxHeading "ModelBoxHeading";
CM_ SG_ 412 FLR_CT28_ModelBoxLength "ModelBoxLength";
CM_ SG_ 412 FLR_CT28_ModelBoxWidth "ModelBoxWidth";
CM_ SG_ 412 FLR_CT28_ModelBoxX "ModelBoxX";
CM_ SG_ 412 FLR_CT28_ModelBoxY "ModelBoxY";
CM_ SG_ 412 FLR_CT28_MotionClass "MotionClass";
CM_ SG_ 412 FLR_CT28_ObjectId "ObjectId";
CM_ SG_ 412 FLR_CT28_ObservationHistory "ObservationHistory";
CM_ SG_ 412 FLR_CT28_QualityBits "QualityBits";
CM_ SG_ 412 FLR_CT28_StationaryCounter "StationaryCounter";
CM_ SG_ 412 FLR_CT28_Type "Type";
CM_ SG_ 412 FLR_CT28_X_Acceleration "X_Acceleration";
CM_ SG_ 412 FLR_CT28_X_Velocity "X_Velocity";
CM_ SG_ 412 FLR_CT28_X_VelocityStdDev "X_VelocityStdDev";
CM_ SG_ 412 FLR_CT28_Y_Acceleration "Y_Acceleration";
CM_ SG_ 412 FLR_CT28_Y_Velocity "Y_Velocity";
CM_ SG_ 412 FLR_CT28_Y_VelocityStdDev "Y_VelocityStdDev";
CM_ BO_ 413 "[P] Periodic";
CM_ SG_ 413 FLR_CT29_CrcVal "CyclicRedundancyCheckValue";
CM_ SG_ 413 FLR_CT29_AlvCntVal "AliveCounter";
CM_ SG_ 413 FLR_CT29_ListIndex "TrackListIndex";
CM_ SG_ 413 FLR_CT29_SequenceCounter "SequenceCounter";
CM_ SG_ 413 FLR_CT29_TimeStamp "TimeStamp";
CM_ SG_ 413 FLR_CT29_Latency "Sensor latency";
CM_ SG_ 413 FLR_CT29_ClosestPointX "ClosestPointX";
CM_ SG_ 413 FLR_CT29_ClosestPointXStdDev "ClosestPointXStdDev";
CM_ SG_ 413 FLR_CT29_ClosestPointY "ClosestPointY";
CM_ SG_ 413 FLR_CT29_ClosestPointYStdDev "ClosestPointYStdDev";
CM_ SG_ 413 FLR_CT29_Confidence "Confidence";
CM_ SG_ 413 FLR_CT29_Elevation "Elevation";
CM_ SG_ 413 FLR_CT29_ElevationConfidence "ElevationConfidence";
CM_ SG_ 413 FLR_CT29_ExistanceProbability "ExistanceProbability";
CM_ SG_ 413 FLR_CT29_Lifetime "Lifetime";
CM_ SG_ 413 FLR_CT29_ModelBoxHeading "ModelBoxHeading";
CM_ SG_ 413 FLR_CT29_ModelBoxLength "ModelBoxLength";
CM_ SG_ 413 FLR_CT29_ModelBoxWidth "ModelBoxWidth";
CM_ SG_ 413 FLR_CT29_ModelBoxX "ModelBoxX";
CM_ SG_ 413 FLR_CT29_ModelBoxY "ModelBoxY";
CM_ SG_ 413 FLR_CT29_MotionClass "MotionClass";
CM_ SG_ 413 FLR_CT29_ObjectId "ObjectId";
CM_ SG_ 413 FLR_CT29_ObservationHistory "ObservationHistory";
CM_ SG_ 413 FLR_CT29_QualityBits "QualityBits";
CM_ SG_ 413 FLR_CT29_StationaryCounter "StationaryCounter";
CM_ SG_ 413 FLR_CT29_Type "Type";
CM_ SG_ 413 FLR_CT29_X_Acceleration "X_Acceleration";
CM_ SG_ 413 FLR_CT29_X_Velocity "X_Velocity";
CM_ SG_ 413 FLR_CT29_X_VelocityStdDev "X_VelocityStdDev";
CM_ SG_ 413 FLR_CT29_Y_Acceleration "Y_Acceleration";
CM_ SG_ 413 FLR_CT29_Y_Velocity "Y_Velocity";
CM_ SG_ 413 FLR_CT29_Y_VelocityStdDev "Y_VelocityStdDev";
CM_ BO_ 448 "[P] Periodic";
CM_ SG_ 448 FLR_ST0_CrcVal "CyclicRedundancyCheckValue";
CM_ SG_ 448 FLR_ST0_AlvCntVal "AliveCounter";
CM_ SG_ 448 FLR_ST0_Elevation "Elevation";
CM_ SG_ 448 FLR_ST0_ElevationConfidence "ElevationConfidence";
CM_ SG_ 448 FLR_ST0_Lifetime "Lifetime";
CM_ SG_ 448 FLR_ST0_ObjectId "ObjectId";
CM_ SG_ 448 FLR_ST0_PositionX "PositionX";
CM_ SG_ 448 FLR_ST0_PositionY "PositionY";
CM_ SG_ 448 FLR_ST0_PredictionCounter "PredictionCounter";
CM_ SG_ 448 FLR_ST0_PropertyBits "PropertyBits";
CM_ SG_ 448 FLR_ST0_Quality "Quality";
CM_ SG_ 448 FLR_ST0_X_Velocity "X_Velocity";
CM_ SG_ 448 FLR_ST0_Y_Velocity "Y_Velocity";
CM_ BO_ 449 "[P] Periodic";
CM_ SG_ 449 FLR_ST1_CrcVal "CyclicRedundancyCheckValue";
CM_ SG_ 449 FLR_ST1_AlvCntVal "AliveCounter";
CM_ SG_ 449 FLR_ST1_Elevation "Elevation";
CM_ SG_ 449 FLR_ST1_ElevationConfidence "ElevationConfidence";
CM_ SG_ 449 FLR_ST1_Lifetime "Lifetime";
CM_ SG_ 449 FLR_ST1_ObjectId "ObjectId";
CM_ SG_ 449 FLR_ST1_PositionX "PositionX";
CM_ SG_ 449 FLR_ST1_PositionY "PositionY";
CM_ SG_ 449 FLR_ST1_PredictionCounter "PredictionCounter";
CM_ SG_ 449 FLR_ST1_PropertyBits "PropertyBits";
CM_ SG_ 449 FLR_ST1_Quality "Quality";
CM_ SG_ 449 FLR_ST1_X_Velocity "X_Velocity";
CM_ SG_ 449 FLR_ST1_Y_Velocity "Y_Velocity";
CM_ BO_ 450 "[P] Periodic";
CM_ SG_ 450 FLR_ST2_CrcVal "CyclicRedundancyCheckValue";
CM_ SG_ 450 FLR_ST2_AlvCntVal "AliveCounter";
CM_ SG_ 450 FLR_ST2_Elevation "Elevation";
CM_ SG_ 450 FLR_ST2_ElevationConfidence "ElevationConfidence";
CM_ SG_ 450 FLR_ST2_Lifetime "Lifetime";
CM_ SG_ 450 FLR_ST2_ObjectId "ObjectId";
CM_ SG_ 450 FLR_ST2_PositionX "PositionX";
CM_ SG_ 450 FLR_ST2_PositionY "PositionY";
CM_ SG_ 450 FLR_ST2_PredictionCounter "PredictionCounter";
CM_ SG_ 450 FLR_ST2_PropertyBits "PropertyBits";
CM_ SG_ 450 FLR_ST2_Quality "Quality";
CM_ SG_ 450 FLR_ST2_X_Velocity "X_Velocity";
CM_ SG_ 450 FLR_ST2_Y_Velocity "Y_Velocity";
CM_ BO_ 451 "[P] Periodic";
CM_ SG_ 451 FLR_ST3_CrcVal "CyclicRedundancyCheckValue";
CM_ SG_ 451 FLR_ST3_AlvCntVal "AliveCounter";
CM_ SG_ 451 FLR_ST3_Elevation "Elevation";
CM_ SG_ 451 FLR_ST3_ElevationConfidence "ElevationConfidence";
CM_ SG_ 451 FLR_ST3_Lifetime "Lifetime";
CM_ SG_ 451 FLR_ST3_ObjectId "ObjectId";
CM_ SG_ 451 FLR_ST3_PositionX "PositionX";
CM_ SG_ 451 FLR_ST3_PositionY "PositionY";
CM_ SG_ 451 FLR_ST3_PredictionCounter "PredictionCounter";
CM_ SG_ 451 FLR_ST3_PropertyBits "PropertyBits";
CM_ SG_ 451 FLR_ST3_Quality "Quality";
CM_ SG_ 451 FLR_ST3_X_Velocity "X_Velocity";
CM_ SG_ 451 FLR_ST3_Y_Velocity "Y_Velocity";
BA_DEF_ BO_  "GenMsgILSupport" ENUM  "No","Yes","vector_leerstring";
BA_DEF_ BO_  "DiagState" ENUM  "No","Yes","vector_leerstring";
BA_DEF_ BO_  "DiagRequest" ENUM  "No","Yes","vector_leerstring";
BA_DEF_ BO_  "VFrameFormat" ENUM  "StandardCAN","ExtendedCAN","reserved","reserved","reserved","reserved","reserved","reserved","reserved","reserved","reserved","reserved","reserved","reserved","StandardCAN_FD","ExtendedCAN_FD";
BA_DEF_ BO_  "GenMsgSendType" ENUM  "Cyclic","NoMsgSendType";
BA_DEF_ SG_  "UserSigValidity" ENUM  "B+","ACC","IG","IG1","IG2","IG3","IG1 or IG2","IG1 or IG3","Undef";
BA_DEF_ SG_  "RoutingFactor" INT 1 1215752192;
BA_DEF_ SG_  "Description" STRING ;
BA_DEF_ SG_  "Version" STRING ;
BA_DEF_ BO_  "GenMsgCycleTime" INT 0 2000;
BA_DEF_ BO_  "GenMsgStartDelayTime" INT 0 2000;
BA_DEF_ SG_  "UsrSigPurpose" ENUM  "Undef","FN","DIAG","DEV","NM";
BA_DEF_ SG_  "GenSigStartValue" INT 0 0;
BA_DEF_DEF_  "GenMsgILSupport" "Yes";
BA_DEF_DEF_  "DiagState" "No";
BA_DEF_DEF_  "DiagRequest" "No";
BA_DEF_DEF_  "VFrameFormat" "";
BA_DEF_DEF_  "GenMsgSendType" "NoMsgSendType";
BA_DEF_DEF_  "UserSigValidity" "IG";
BA_DEF_DEF_  "RoutingFactor" 1;
BA_DEF_DEF_  "Description" "";
BA_DEF_DEF_  "Version" "";
BA_DEF_DEF_  "GenMsgCycleTime" 0;
BA_DEF_DEF_  "GenMsgStartDelayTime" 0;
BA_DEF_DEF_  "UsrSigPurpose" "FN";
BA_DEF_DEF_  "GenSigStartValue" 0;
BA_ "GenMsgSendType" BO_ 400 0;
BA_ "GenMsgCycleTime" BO_ 400 50;
BA_ "VFrameFormat" BO_ 400 14;
BA_ "GenMsgSendType" BO_ 401 0;
BA_ "GenMsgCycleTime" BO_ 401 50;
BA_ "VFrameFormat" BO_ 401 14;
BA_ "GenMsgSendType" BO_ 402 0;
BA_ "GenMsgCycleTime" BO_ 402 50;
BA_ "VFrameFormat" BO_ 402 14;
BA_ "GenMsgSendType" BO_ 403 0;
BA_ "GenMsgCycleTime" BO_ 403 50;
BA_ "VFrameFormat" BO_ 403 14;
BA_ "GenMsgSendType" BO_ 404 0;
BA_ "GenMsgCycleTime" BO_ 404 50;
BA_ "VFrameFormat" BO_ 404 14;
BA_ "GenMsgSendType" BO_ 405 0;
BA_ "GenMsgCycleTime" BO_ 405 50;
BA_ "VFrameFormat" BO_ 405 14;
BA_ "GenMsgSendType" BO_ 406 0;
BA_ "GenMsgCycleTime" BO_ 406 50;
BA_ "VFrameFormat" BO_ 406 14;
BA_ "GenMsgSendType" BO_ 407 0;
BA_ "GenMsgCycleTime" BO_ 407 50;
BA_ "VFrameFormat" BO_ 407 14;
BA_ "GenMsgSendType" BO_ 408 0;
BA_ "GenMsgCycleTime" BO_ 408 50;
BA_ "VFrameFormat" BO_ 408 14;
BA_ "GenMsgSendType" BO_ 409 0;
BA_ "GenMsgCycleTime" BO_ 409 50;
BA_ "VFrameFormat" BO_ 409 14;
BA_ "GenMsgSendType" BO_ 410 0;
BA_ "GenMsgCycleTime" BO_ 410 50;
BA_ "VFrameFormat" BO_ 410 14;
BA_ "GenMsgSendType" BO_ 411 0;
BA_ "GenMsgCycleTime" BO_ 411 50;
BA_ "VFrameFormat" BO_ 411 14;
BA_ "GenMsgSendType" BO_ 412 0;
BA_ "GenMsgCycleTime" BO_ 412 50;
BA_ "VFrameFormat" BO_ 412 14;
BA_ "GenMsgSendType" BO_ 413 0;
BA_ "GenMsgCycleTime" BO_ 413 50;
BA_ "VFrameFormat" BO_ 413 14;
BA_ "GenMsgSendType" BO_ 448 0;
BA_ "GenMsgCycleTime" BO_ 448 50;
BA_ "VFrameFormat" BO_ 448 14;
BA_ "GenMsgSendType" BO_ 449 0;
BA_ "GenMsgCycleTime" BO_ 449 50;
BA_ "VFrameFormat" BO_ 449 14;
BA_ "GenMsgSendType" BO_ 450 0;
BA_ "GenMsgCycleTime" BO_ 450 50;
BA_ "VFrameFormat" BO_ 450 14;
BA_ "GenMsgSendType" BO_ 451 0;
BA_ "GenMsgCycleTime" BO_ 451 50;
BA_ "VFrameFormat" BO_ 451 14;
BA_ "Description" SG_ 400 FLR_CT16_CrcVal "The CRC checking process calculates the CRC over the entire data block, including the CRC result.

- CRC Polynomial (0x1021) , Initial Value : 0xFFFF, XOR value : 0x0000

- The mathematical expression to 16 bit CRC polynomial is given here. G(x) = x16 + ";
BA_ "GenSigStartValue" SG_ 400 FLR_CT16_CrcVal 65535;
BA_ "UserSigValidity" SG_ 400 FLR_CT16_CrcVal 3;
BA_ "Description" SG_ 400 FLR_CT16_AlvCntVal "[Alive counter] For the first transmission request for a data element the counter shall be initialized with 0 and shall be incremented by 1

for every subsequent send request. When the counter reaches the maximum value(0xFF), then it shall restart with â";
BA_ "UserSigValidity" SG_ 400 FLR_CT16_AlvCntVal 3;
BA_ "Description" SG_ 400 FLR_CT16_ListIndex "List index of cluster track";
BA_ "UserSigValidity" SG_ 400 FLR_CT16_ListIndex 3;
BA_ "Description" SG_ 400 FLR_CT16_SequenceCounter "[TimeSync]Sequence counter for checking the validity of message flow sequence";
BA_ "UserSigValidity" SG_ 400 FLR_CT16_SequenceCounter 3;
BA_ "Description" SG_ 400 FLR_CT16_TimeStamp "[TimeSync]System time, synchronized through AUTOSAR TimeSync";
BA_ "UserSigValidity" SG_ 400 FLR_CT16_TimeStamp 3;
BA_ "Description" SG_ 400 FLR_CT16_Latency "[TimeSync]Sensor latency from object capture scene to object transmission";
BA_ "UserSigValidity" SG_ 400 FLR_CT16_Latency 3;
BA_ "Description" SG_ 400 FLR_CT16_ClosestPointX "Kalman filtered closest point

X position ";
BA_ "UserSigValidity" SG_ 400 FLR_CT16_ClosestPointX 3;
BA_ "Description" SG_ 400 FLR_CT16_ClosestPointXStdDev "Standard deviation of X";
BA_ "UserSigValidity" SG_ 400 FLR_CT16_ClosestPointXStdDev 3;
BA_ "Description" SG_ 400 FLR_CT16_ClosestPointY "Kalman filtered closest point

Y position ";
BA_ "UserSigValidity" SG_ 400 FLR_CT16_ClosestPointY 3;
BA_ "Description" SG_ 400 FLR_CT16_ClosestPointYStdDev "Standard deviation of Y";
BA_ "UserSigValidity" SG_ 400 FLR_CT16_ClosestPointYStdDev 3;
BA_ "Description" SG_ 400 FLR_CT16_Confidence "Object confidence used in quality manager to provide 'Objektgate' (i.e. object quality) tracked object confidence is calculated based on the normalized difference of closest detection to the track's calculated closest point, for range, angle and velocity";
BA_ "UserSigValidity" SG_ 400 FLR_CT16_Confidence 3;
BA_ "Description" SG_ 400 FLR_CT16_Elevation "Elevation of the object";
BA_ "UserSigValidity" SG_ 400 FLR_CT16_Elevation 3;
BA_ "Description" SG_ 400 FLR_CT16_ElevationConfidence "Confidence the elevation classification is correct";
BA_ "UserSigValidity" SG_ 400 FLR_CT16_ElevationConfidence 3;
BA_ "Description" SG_ 400 FLR_CT16_ExistanceProbability "Confidence tracked object existence. Currently set to the association rate [0..100] over the last 6 cycles";
BA_ "UserSigValidity" SG_ 400 FLR_CT16_ExistanceProbability 3;
BA_ "Description" SG_ 400 FLR_CT16_Lifetime "Number of cycles the target has been alive. Unknown 0

Tops out at about 6 minutes of continuous tracking.";
BA_ "UserSigValidity" SG_ 400 FLR_CT16_Lifetime 3;
BA_ "Description" SG_ 400 FLR_CT16_ModelBoxHeading "Heading of object

( Box model describing the object )";
BA_ "UserSigValidity" SG_ 400 FLR_CT16_ModelBoxHeading 3;
BA_ "Description" SG_ 400 FLR_CT16_ModelBoxLength "Length of the object

( Box model describing the object )";
BA_ "UserSigValidity" SG_ 400 FLR_CT16_ModelBoxLength 3;
BA_ "Description" SG_ 400 FLR_CT16_ModelBoxWidth "Width of the object

( Box model describing the object )";
BA_ "UserSigValidity" SG_ 400 FLR_CT16_ModelBoxWidth 3;
BA_ "Description" SG_ 400 FLR_CT16_ModelBoxX "X position, center of box

( Box model describing the object )";
BA_ "UserSigValidity" SG_ 400 FLR_CT16_ModelBoxX 3;
BA_ "Description" SG_ 400 FLR_CT16_ModelBoxY "Y position, center of box

( Box model describing the object )";
BA_ "UserSigValidity" SG_ 400 FLR_CT16_ModelBoxY 3;
BA_ "Description" SG_ 400 FLR_CT16_MotionClass "Tracked object motion classification";
BA_ "UserSigValidity" SG_ 400 FLR_CT16_MotionClass 3;
BA_ "Description" SG_ 400 FLR_CT16_ObjectId "A global ID, which is constant as long as the object is tracked. Note! A value of 0 indicates 'no object'";
BA_ "UserSigValidity" SG_ 400 FLR_CT16_ObjectId 3;
BA_ "Description" SG_ 400 FLR_CT16_ObservationHistory "Observation history of tracked object in as 32 bit-field for the last 32 cycles; for each bit: 1 = associated, 0 = not associated; LSB = most recent cycle, MSB = oldest cycle";
BA_ "UserSigValidity" SG_ 400 FLR_CT16_ObservationHistory 3;
BA_ "Description" SG_ 400 FLR_CT16_QualityBits "Bitmask for quality values described by ClusterTrackQualityBits";
BA_ "UserSigValidity" SG_ 400 FLR_CT16_QualityBits 3;
BA_ "Description" SG_ 400 FLR_CT16_StationaryCounter "Counts the cycles during which the object is ground stationary (i.e. absolute velocity over ground = 0)";
BA_ "UserSigValidity" SG_ 400 FLR_CT16_StationaryCounter 3;
BA_ "Description" SG_ 400 FLR_CT16_Type "Tracked object type classification";
BA_ "UserSigValidity" SG_ 400 FLR_CT16_Type 3;
BA_ "Description" SG_ 400 FLR_CT16_X_Acceleration "X acceleration 

( Movement estimation of object ) ";
BA_ "UserSigValidity" SG_ 400 FLR_CT16_X_Acceleration 3;
BA_ "Description" SG_ 400 FLR_CT16_X_Velocity "Absolute X velocity

( Movement estimation of object ) ";
BA_ "UserSigValidity" SG_ 400 FLR_CT16_X_Velocity 3;
BA_ "Description" SG_ 400 FLR_CT16_X_VelocityStdDev "Standard deviation of X velocity

( Movement estimation of object ) ";
BA_ "UserSigValidity" SG_ 400 FLR_CT16_X_VelocityStdDev 3;
BA_ "Description" SG_ 400 FLR_CT16_Y_Acceleration "Y acceleration 

( Movement estimation of object ) ";
BA_ "UserSigValidity" SG_ 400 FLR_CT16_Y_Acceleration 3;
BA_ "Description" SG_ 400 FLR_CT16_Y_Velocity "Absolute Y velocity

( Movement estimation of object ) ";
BA_ "UserSigValidity" SG_ 400 FLR_CT16_Y_Velocity 3;
BA_ "Description" SG_ 400 FLR_CT16_Y_VelocityStdDev "Standard deviation of Y velocity

( Movement estimation of object ) ";
BA_ "UserSigValidity" SG_ 400 FLR_CT16_Y_VelocityStdDev 3;
BA_ "Description" SG_ 401 FLR_CT17_CrcVal "The CRC checking process calculates the CRC over the entire data block, including the CRC result.

- CRC Polynomial (0x1021) , Initial Value : 0xFFFF, XOR value : 0x0000

- The mathematical expression to 16 bit CRC polynomial is given here. G(x) = x16 + ";
BA_ "GenSigStartValue" SG_ 401 FLR_CT17_CrcVal 65535;
BA_ "UserSigValidity" SG_ 401 FLR_CT17_CrcVal 3;
BA_ "Description" SG_ 401 FLR_CT17_AlvCntVal "[Alive counter] For the first transmission request for a data element the counter shall be initialized with 0 and shall be incremented by 1

for every subsequent send request. When the counter reaches the maximum value(0xFF), then it shall restart with â";
BA_ "UserSigValidity" SG_ 401 FLR_CT17_AlvCntVal 3;
BA_ "Description" SG_ 401 FLR_CT17_ListIndex "List index of cluster track";
BA_ "UserSigValidity" SG_ 401 FLR_CT17_ListIndex 3;
BA_ "Description" SG_ 401 FLR_CT17_SequenceCounter "[TimeSync]Sequence counter for checking the validity of message flow sequence";
BA_ "UserSigValidity" SG_ 401 FLR_CT17_SequenceCounter 3;
BA_ "Description" SG_ 401 FLR_CT17_TimeStamp "[TimeSync]System time, synchronized through AUTOSAR TimeSync";
BA_ "UserSigValidity" SG_ 401 FLR_CT17_TimeStamp 3;
BA_ "Description" SG_ 401 FLR_CT17_Latency "[TimeSync]Sensor latency from object capture scene to object transmission";
BA_ "UserSigValidity" SG_ 401 FLR_CT17_Latency 3;
BA_ "Description" SG_ 401 FLR_CT17_ClosestPointX "Kalman filtered closest point

X position ";
BA_ "UserSigValidity" SG_ 401 FLR_CT17_ClosestPointX 3;
BA_ "Description" SG_ 401 FLR_CT17_ClosestPointXStdDev "Standard deviation of X";
BA_ "UserSigValidity" SG_ 401 FLR_CT17_ClosestPointXStdDev 3;
BA_ "Description" SG_ 401 FLR_CT17_ClosestPointY "Kalman filtered closest point

Y position ";
BA_ "UserSigValidity" SG_ 401 FLR_CT17_ClosestPointY 3;
BA_ "Description" SG_ 401 FLR_CT17_ClosestPointYStdDev "Standard deviation of Y";
BA_ "UserSigValidity" SG_ 401 FLR_CT17_ClosestPointYStdDev 3;
BA_ "Description" SG_ 401 FLR_CT17_Confidence "Object confidence used in quality manager to provide 'Objektgate' (i.e. object quality) tracked object confidence is calculated based on the normalized difference of closest detection to the track's calculated closest point, for range, angle and velocity";
BA_ "UserSigValidity" SG_ 401 FLR_CT17_Confidence 3;
BA_ "Description" SG_ 401 FLR_CT17_Elevation "Elevation of the object";
BA_ "UserSigValidity" SG_ 401 FLR_CT17_Elevation 3;
BA_ "Description" SG_ 401 FLR_CT17_ElevationConfidence "Confidence the elevation classification is correct";
BA_ "UserSigValidity" SG_ 401 FLR_CT17_ElevationConfidence 3;
BA_ "Description" SG_ 401 FLR_CT17_ExistanceProbability "Confidence tracked object existence. Currently set to the association rate [0..100] over the last 6 cycles";
BA_ "UserSigValidity" SG_ 401 FLR_CT17_ExistanceProbability 3;
BA_ "Description" SG_ 401 FLR_CT17_Lifetime "Number of cycles the target has been alive. Unknown 0

Tops out at about 6 minutes of continuous tracking.";
BA_ "UserSigValidity" SG_ 401 FLR_CT17_Lifetime 3;
BA_ "Description" SG_ 401 FLR_CT17_ModelBoxHeading "Heading of object

( Box model describing the object )";
BA_ "UserSigValidity" SG_ 401 FLR_CT17_ModelBoxHeading 3;
BA_ "Description" SG_ 401 FLR_CT17_ModelBoxLength "Length of the object

( Box model describing the object )";
BA_ "UserSigValidity" SG_ 401 FLR_CT17_ModelBoxLength 3;
BA_ "Description" SG_ 401 FLR_CT17_ModelBoxWidth "Width of the object

( Box model describing the object )";
BA_ "UserSigValidity" SG_ 401 FLR_CT17_ModelBoxWidth 3;
BA_ "Description" SG_ 401 FLR_CT17_ModelBoxX "X position, center of box

( Box model describing the object )";
BA_ "UserSigValidity" SG_ 401 FLR_CT17_ModelBoxX 3;
BA_ "Description" SG_ 401 FLR_CT17_ModelBoxY "Y position, center of box

( Box model describing the object )";
BA_ "UserSigValidity" SG_ 401 FLR_CT17_ModelBoxY 3;
BA_ "Description" SG_ 401 FLR_CT17_MotionClass "Tracked object motion classification";
BA_ "UserSigValidity" SG_ 401 FLR_CT17_MotionClass 3;
BA_ "Description" SG_ 401 FLR_CT17_ObjectId "A global ID, which is constant as long as the object is tracked. Note! A value of 0 indicates 'no object'";
BA_ "UserSigValidity" SG_ 401 FLR_CT17_ObjectId 3;
BA_ "Description" SG_ 401 FLR_CT17_ObservationHistory "Observation history of tracked object in as 32 bit-field for the last 32 cycles; for each bit: 1 = associated, 0 = not associated; LSB = most recent cycle, MSB = oldest cycle";
BA_ "UserSigValidity" SG_ 401 FLR_CT17_ObservationHistory 3;
BA_ "Description" SG_ 401 FLR_CT17_QualityBits "Bitmask for quality values described by ClusterTrackQualityBits";
BA_ "UserSigValidity" SG_ 401 FLR_CT17_QualityBits 3;
BA_ "Description" SG_ 401 FLR_CT17_StationaryCounter "Counts the cycles during which the object is ground stationary (i.e. absolute velocity over ground = 0)";
BA_ "UserSigValidity" SG_ 401 FLR_CT17_StationaryCounter 3;
BA_ "Description" SG_ 401 FLR_CT17_Type "Tracked object type classification";
BA_ "UserSigValidity" SG_ 401 FLR_CT17_Type 3;
BA_ "Description" SG_ 401 FLR_CT17_X_Acceleration "X acceleration 

( Movement estimation of object ) ";
BA_ "UserSigValidity" SG_ 401 FLR_CT17_X_Acceleration 3;
BA_ "Description" SG_ 401 FLR_CT17_X_Velocity "Absolute X velocity

( Movement estimation of object ) ";
BA_ "UserSigValidity" SG_ 401 FLR_CT17_X_Velocity 3;
BA_ "Description" SG_ 401 FLR_CT17_X_VelocityStdDev "Standard deviation of X velocity

( Movement estimation of object ) ";
BA_ "UserSigValidity" SG_ 401 FLR_CT17_X_VelocityStdDev 3;
BA_ "Description" SG_ 401 FLR_CT17_Y_Acceleration "Y acceleration 

( Movement estimation of object ) ";
BA_ "UserSigValidity" SG_ 401 FLR_CT17_Y_Acceleration 3;
BA_ "Description" SG_ 401 FLR_CT17_Y_Velocity "Absolute Y velocity

( Movement estimation of object ) ";
BA_ "UserSigValidity" SG_ 401 FLR_CT17_Y_Velocity 3;
BA_ "Description" SG_ 401 FLR_CT17_Y_VelocityStdDev "Standard deviation of Y velocity

( Movement estimation of object ) ";
BA_ "UserSigValidity" SG_ 401 FLR_CT17_Y_VelocityStdDev 3;
BA_ "Description" SG_ 402 FLR_CT18_CrcVal "The CRC checking process calculates the CRC over the entire data block, including the CRC result.

- CRC Polynomial (0x1021) , Initial Value : 0xFFFF, XOR value : 0x0000

- The mathematical expression to 16 bit CRC polynomial is given here. G(x) = x16 + ";
BA_ "GenSigStartValue" SG_ 402 FLR_CT18_CrcVal 65535;
BA_ "UserSigValidity" SG_ 402 FLR_CT18_CrcVal 3;
BA_ "Description" SG_ 402 FLR_CT18_AlvCntVal "[Alive counter] For the first transmission request for a data element the counter shall be initialized with 0 and shall be incremented by 1

for every subsequent send request. When the counter reaches the maximum value(0xFF), then it shall restart with â";
BA_ "UserSigValidity" SG_ 402 FLR_CT18_AlvCntVal 3;
BA_ "Description" SG_ 402 FLR_CT18_ListIndex "List index of cluster track";
BA_ "UserSigValidity" SG_ 402 FLR_CT18_ListIndex 3;
BA_ "Description" SG_ 402 FLR_CT18_SequenceCounter "[TimeSync]Sequence counter for checking the validity of message flow sequence";
BA_ "UserSigValidity" SG_ 402 FLR_CT18_SequenceCounter 3;
BA_ "Description" SG_ 402 FLR_CT18_TimeStamp "[TimeSync]System time, synchronized through AUTOSAR TimeSync";
BA_ "UserSigValidity" SG_ 402 FLR_CT18_TimeStamp 3;
BA_ "Description" SG_ 402 FLR_CT18_Latency "[TimeSync]Sensor latency from object capture scene to object transmission";
BA_ "UserSigValidity" SG_ 402 FLR_CT18_Latency 3;
BA_ "Description" SG_ 402 FLR_CT18_ClosestPointX "Kalman filtered closest point

X position ";
BA_ "UserSigValidity" SG_ 402 FLR_CT18_ClosestPointX 3;
BA_ "Description" SG_ 402 FLR_CT18_ClosestPointXStdDev "Standard deviation of X";
BA_ "UserSigValidity" SG_ 402 FLR_CT18_ClosestPointXStdDev 3;
BA_ "Description" SG_ 402 FLR_CT18_ClosestPointY "Kalman filtered closest point

Y position ";
BA_ "UserSigValidity" SG_ 402 FLR_CT18_ClosestPointY 3;
BA_ "Description" SG_ 402 FLR_CT18_ClosestPointYStdDev "Standard deviation of Y";
BA_ "UserSigValidity" SG_ 402 FLR_CT18_ClosestPointYStdDev 3;
BA_ "Description" SG_ 402 FLR_CT18_Confidence "Object confidence used in quality manager to provide 'Objektgate' (i.e. object quality) tracked object confidence is calculated based on the normalized difference of closest detection to the track's calculated closest point, for range, angle and velocity";
BA_ "UserSigValidity" SG_ 402 FLR_CT18_Confidence 3;
BA_ "Description" SG_ 402 FLR_CT18_Elevation "Elevation of the object";
BA_ "UserSigValidity" SG_ 402 FLR_CT18_Elevation 3;
BA_ "Description" SG_ 402 FLR_CT18_ElevationConfidence "Confidence the elevation classification is correct";
BA_ "UserSigValidity" SG_ 402 FLR_CT18_ElevationConfidence 3;
BA_ "Description" SG_ 402 FLR_CT18_ExistanceProbability "Confidence tracked object existence. Currently set to the association rate [0..100] over the last 6 cycles";
BA_ "UserSigValidity" SG_ 402 FLR_CT18_ExistanceProbability 3;
BA_ "Description" SG_ 402 FLR_CT18_Lifetime "Number of cycles the target has been alive. Unknown 0

Tops out at about 6 minutes of continuous tracking.";
BA_ "UserSigValidity" SG_ 402 FLR_CT18_Lifetime 3;
BA_ "Description" SG_ 402 FLR_CT18_ModelBoxHeading "Heading of object

( Box model describing the object )";
BA_ "UserSigValidity" SG_ 402 FLR_CT18_ModelBoxHeading 3;
BA_ "Description" SG_ 402 FLR_CT18_ModelBoxLength "Length of the object

( Box model describing the object )";
BA_ "UserSigValidity" SG_ 402 FLR_CT18_ModelBoxLength 3;
BA_ "Description" SG_ 402 FLR_CT18_ModelBoxWidth "Width of the object

( Box model describing the object )";
BA_ "UserSigValidity" SG_ 402 FLR_CT18_ModelBoxWidth 3;
BA_ "Description" SG_ 402 FLR_CT18_ModelBoxX "X position, center of box

( Box model describing the object )";
BA_ "UserSigValidity" SG_ 402 FLR_CT18_ModelBoxX 3;
BA_ "Description" SG_ 402 FLR_CT18_ModelBoxY "Y position, center of box

( Box model describing the object )";
BA_ "UserSigValidity" SG_ 402 FLR_CT18_ModelBoxY 3;
BA_ "Description" SG_ 402 FLR_CT18_MotionClass "Tracked object motion classification";
BA_ "UserSigValidity" SG_ 402 FLR_CT18_MotionClass 3;
BA_ "Description" SG_ 402 FLR_CT18_ObjectId "A global ID, which is constant as long as the object is tracked. Note! A value of 0 indicates 'no object'";
BA_ "UserSigValidity" SG_ 402 FLR_CT18_ObjectId 3;
BA_ "Description" SG_ 402 FLR_CT18_ObservationHistory "Observation history of tracked object in as 32 bit-field for the last 32 cycles; for each bit: 1 = associated, 0 = not associated; LSB = most recent cycle, MSB = oldest cycle";
BA_ "UserSigValidity" SG_ 402 FLR_CT18_ObservationHistory 3;
BA_ "Description" SG_ 402 FLR_CT18_QualityBits "Bitmask for quality values described by ClusterTrackQualityBits";
BA_ "UserSigValidity" SG_ 402 FLR_CT18_QualityBits 3;
BA_ "Description" SG_ 402 FLR_CT18_StationaryCounter "Counts the cycles during which the object is ground stationary (i.e. absolute velocity over ground = 0)";
BA_ "UserSigValidity" SG_ 402 FLR_CT18_StationaryCounter 3;
BA_ "Description" SG_ 402 FLR_CT18_Type "Tracked object type classification";
BA_ "UserSigValidity" SG_ 402 FLR_CT18_Type 3;
BA_ "Description" SG_ 402 FLR_CT18_X_Acceleration "X acceleration 

( Movement estimation of object ) ";
BA_ "UserSigValidity" SG_ 402 FLR_CT18_X_Acceleration 3;
BA_ "Description" SG_ 402 FLR_CT18_X_Velocity "Absolute X velocity

( Movement estimation of object ) ";
BA_ "UserSigValidity" SG_ 402 FLR_CT18_X_Velocity 3;
BA_ "Description" SG_ 402 FLR_CT18_X_VelocityStdDev "Standard deviation of X velocity

( Movement estimation of object ) ";
BA_ "UserSigValidity" SG_ 402 FLR_CT18_X_VelocityStdDev 3;
BA_ "Description" SG_ 402 FLR_CT18_Y_Acceleration "Y acceleration 

( Movement estimation of object ) ";
BA_ "UserSigValidity" SG_ 402 FLR_CT18_Y_Acceleration 3;
BA_ "Description" SG_ 402 FLR_CT18_Y_Velocity "Absolute Y velocity

( Movement estimation of object ) ";
BA_ "UserSigValidity" SG_ 402 FLR_CT18_Y_Velocity 3;
BA_ "Description" SG_ 402 FLR_CT18_Y_VelocityStdDev "Standard deviation of Y velocity

( Movement estimation of object ) ";
BA_ "UserSigValidity" SG_ 402 FLR_CT18_Y_VelocityStdDev 3;
BA_ "Description" SG_ 403 FLR_CT19_CrcVal "The CRC checking process calculates the CRC over the entire data block, including the CRC result.

- CRC Polynomial (0x1021) , Initial Value : 0xFFFF, XOR value : 0x0000

- The mathematical expression to 16 bit CRC polynomial is given here. G(x) = x16 + ";
BA_ "GenSigStartValue" SG_ 403 FLR_CT19_CrcVal 65535;
BA_ "UserSigValidity" SG_ 403 FLR_CT19_CrcVal 3;
BA_ "Description" SG_ 403 FLR_CT19_AlvCntVal "[Alive counter] For the first transmission request for a data element the counter shall be initialized with 0 and shall be incremented by 1

for every subsequent send request. When the counter reaches the maximum value(0xFF), then it shall restart with â";
BA_ "UserSigValidity" SG_ 403 FLR_CT19_AlvCntVal 3;
BA_ "Description" SG_ 403 FLR_CT19_ListIndex "List index of cluster track";
BA_ "UserSigValidity" SG_ 403 FLR_CT19_ListIndex 3;
BA_ "Description" SG_ 403 FLR_CT19_SequenceCounter "[TimeSync]Sequence counter for checking the validity of message flow sequence";
BA_ "UserSigValidity" SG_ 403 FLR_CT19_SequenceCounter 3;
BA_ "Description" SG_ 403 FLR_CT19_TimeStamp "[TimeSync]System time, synchronized through AUTOSAR TimeSync";
BA_ "UserSigValidity" SG_ 403 FLR_CT19_TimeStamp 3;
BA_ "Description" SG_ 403 FLR_CT19_Latency "[TimeSync]Sensor latency from object capture scene to object transmission";
BA_ "UserSigValidity" SG_ 403 FLR_CT19_Latency 3;
BA_ "Description" SG_ 403 FLR_CT19_ClosestPointX "Kalman filtered closest point

X position ";
BA_ "UserSigValidity" SG_ 403 FLR_CT19_ClosestPointX 3;
BA_ "Description" SG_ 403 FLR_CT19_ClosestPointXStdDev "Standard deviation of X";
BA_ "UserSigValidity" SG_ 403 FLR_CT19_ClosestPointXStdDev 3;
BA_ "Description" SG_ 403 FLR_CT19_ClosestPointY "Kalman filtered closest point

Y position ";
BA_ "UserSigValidity" SG_ 403 FLR_CT19_ClosestPointY 3;
BA_ "Description" SG_ 403 FLR_CT19_ClosestPointYStdDev "Standard deviation of Y";
BA_ "UserSigValidity" SG_ 403 FLR_CT19_ClosestPointYStdDev 3;
BA_ "Description" SG_ 403 FLR_CT19_Confidence "Object confidence used in quality manager to provide 'Objektgate' (i.e. object quality) tracked object confidence is calculated based on the normalized difference of closest detection to the track's calculated closest point, for range, angle and velocity";
BA_ "UserSigValidity" SG_ 403 FLR_CT19_Confidence 3;
BA_ "Description" SG_ 403 FLR_CT19_Elevation "Elevation of the object";
BA_ "UserSigValidity" SG_ 403 FLR_CT19_Elevation 3;
BA_ "Description" SG_ 403 FLR_CT19_ElevationConfidence "Confidence the elevation classification is correct";
BA_ "UserSigValidity" SG_ 403 FLR_CT19_ElevationConfidence 3;
BA_ "Description" SG_ 403 FLR_CT19_ExistanceProbability "Confidence tracked object existence. Currently set to the association rate [0..100] over the last 6 cycles";
BA_ "UserSigValidity" SG_ 403 FLR_CT19_ExistanceProbability 3;
BA_ "Description" SG_ 403 FLR_CT19_Lifetime "Number of cycles the target has been alive. Unknown 0

Tops out at about 6 minutes of continuous tracking.";
BA_ "UserSigValidity" SG_ 403 FLR_CT19_Lifetime 3;
BA_ "Description" SG_ 403 FLR_CT19_ModelBoxHeading "Heading of object

( Box model describing the object )";
BA_ "UserSigValidity" SG_ 403 FLR_CT19_ModelBoxHeading 3;
BA_ "Description" SG_ 403 FLR_CT19_ModelBoxLength "Length of the object

( Box model describing the object )";
BA_ "UserSigValidity" SG_ 403 FLR_CT19_ModelBoxLength 3;
BA_ "Description" SG_ 403 FLR_CT19_ModelBoxWidth "Width of the object

( Box model describing the object )";
BA_ "UserSigValidity" SG_ 403 FLR_CT19_ModelBoxWidth 3;
BA_ "Description" SG_ 403 FLR_CT19_ModelBoxX "X position, center of box

( Box model describing the object )";
BA_ "UserSigValidity" SG_ 403 FLR_CT19_ModelBoxX 3;
BA_ "Description" SG_ 403 FLR_CT19_ModelBoxY "Y position, center of box

( Box model describing the object )";
BA_ "UserSigValidity" SG_ 403 FLR_CT19_ModelBoxY 3;
BA_ "Description" SG_ 403 FLR_CT19_MotionClass "Tracked object motion classification";
BA_ "UserSigValidity" SG_ 403 FLR_CT19_MotionClass 3;
BA_ "Description" SG_ 403 FLR_CT19_ObjectId "A global ID, which is constant as long as the object is tracked. Note! A value of 0 indicates 'no object'";
BA_ "UserSigValidity" SG_ 403 FLR_CT19_ObjectId 3;
BA_ "Description" SG_ 403 FLR_CT19_ObservationHistory "Observation history of tracked object in as 32 bit-field for the last 32 cycles; for each bit: 1 = associated, 0 = not associated; LSB = most recent cycle, MSB = oldest cycle";
BA_ "UserSigValidity" SG_ 403 FLR_CT19_ObservationHistory 3;
BA_ "Description" SG_ 403 FLR_CT19_QualityBits "Bitmask for quality values described by ClusterTrackQualityBits";
BA_ "UserSigValidity" SG_ 403 FLR_CT19_QualityBits 3;
BA_ "Description" SG_ 403 FLR_CT19_StationaryCounter "Counts the cycles during which the object is ground stationary (i.e. absolute velocity over ground = 0)";
BA_ "UserSigValidity" SG_ 403 FLR_CT19_StationaryCounter 3;
BA_ "Description" SG_ 403 FLR_CT19_Type "Tracked object type classification";
BA_ "UserSigValidity" SG_ 403 FLR_CT19_Type 3;
BA_ "Description" SG_ 403 FLR_CT19_X_Acceleration "X acceleration 

( Movement estimation of object ) ";
BA_ "UserSigValidity" SG_ 403 FLR_CT19_X_Acceleration 3;
BA_ "Description" SG_ 403 FLR_CT19_X_Velocity "Absolute X velocity

( Movement estimation of object ) ";
BA_ "UserSigValidity" SG_ 403 FLR_CT19_X_Velocity 3;
BA_ "Description" SG_ 403 FLR_CT19_X_VelocityStdDev "Standard deviation of X velocity

( Movement estimation of object ) ";
BA_ "UserSigValidity" SG_ 403 FLR_CT19_X_VelocityStdDev 3;
BA_ "Description" SG_ 403 FLR_CT19_Y_Acceleration "Y acceleration 

( Movement estimation of object ) ";
BA_ "UserSigValidity" SG_ 403 FLR_CT19_Y_Acceleration 3;
BA_ "Description" SG_ 403 FLR_CT19_Y_Velocity "Absolute Y velocity

( Movement estimation of object ) ";
BA_ "UserSigValidity" SG_ 403 FLR_CT19_Y_Velocity 3;
BA_ "Description" SG_ 403 FLR_CT19_Y_VelocityStdDev "Standard deviation of Y velocity

( Movement estimation of object ) ";
BA_ "UserSigValidity" SG_ 403 FLR_CT19_Y_VelocityStdDev 3;
BA_ "Description" SG_ 404 FLR_CT20_CrcVal "The CRC checking process calculates the CRC over the entire data block, including the CRC result.

- CRC Polynomial (0x1021) , Initial Value : 0xFFFF, XOR value : 0x0000

- The mathematical expression to 16 bit CRC polynomial is given here. G(x) = x16 + ";
BA_ "GenSigStartValue" SG_ 404 FLR_CT20_CrcVal 65535;
BA_ "UserSigValidity" SG_ 404 FLR_CT20_CrcVal 3;
BA_ "Description" SG_ 404 FLR_CT20_AlvCntVal "[Alive counter] For the first transmission request for a data element the counter shall be initialized with 0 and shall be incremented by 1

for every subsequent send request. When the counter reaches the maximum value(0xFF), then it shall restart with â";
BA_ "UserSigValidity" SG_ 404 FLR_CT20_AlvCntVal 3;
BA_ "Description" SG_ 404 FLR_CT20_ListIndex "List index of cluster track";
BA_ "UserSigValidity" SG_ 404 FLR_CT20_ListIndex 3;
BA_ "Description" SG_ 404 FLR_CT20_SequenceCounter "[TimeSync]Sequence counter for checking the validity of message flow sequence";
BA_ "UserSigValidity" SG_ 404 FLR_CT20_SequenceCounter 3;
BA_ "Description" SG_ 404 FLR_CT20_TimeStamp "[TimeSync]System time, synchronized through AUTOSAR TimeSync";
BA_ "UserSigValidity" SG_ 404 FLR_CT20_TimeStamp 3;
BA_ "Description" SG_ 404 FLR_CT20_Latency "[TimeSync]Sensor latency from object capture scene to object transmission";
BA_ "UserSigValidity" SG_ 404 FLR_CT20_Latency 3;
BA_ "Description" SG_ 404 FLR_CT20_ClosestPointX "Kalman filtered closest point

X position ";
BA_ "UserSigValidity" SG_ 404 FLR_CT20_ClosestPointX 3;
BA_ "Description" SG_ 404 FLR_CT20_ClosestPointXStdDev "Standard deviation of X";
BA_ "UserSigValidity" SG_ 404 FLR_CT20_ClosestPointXStdDev 3;
BA_ "Description" SG_ 404 FLR_CT20_ClosestPointY "Kalman filtered closest point

Y position ";
BA_ "UserSigValidity" SG_ 404 FLR_CT20_ClosestPointY 3;
BA_ "Description" SG_ 404 FLR_CT20_ClosestPointYStdDev "Standard deviation of Y";
BA_ "UserSigValidity" SG_ 404 FLR_CT20_ClosestPointYStdDev 3;
BA_ "Description" SG_ 404 FLR_CT20_Confidence "Object confidence used in quality manager to provide 'Objektgate' (i.e. object quality) tracked object confidence is calculated based on the normalized difference of closest detection to the track's calculated closest point, for range, angle and velocity";
BA_ "UserSigValidity" SG_ 404 FLR_CT20_Confidence 3;
BA_ "Description" SG_ 404 FLR_CT20_Elevation "Elevation of the object";
BA_ "UserSigValidity" SG_ 404 FLR_CT20_Elevation 3;
BA_ "Description" SG_ 404 FLR_CT20_ElevationConfidence "Confidence the elevation classification is correct";
BA_ "UserSigValidity" SG_ 404 FLR_CT20_ElevationConfidence 3;
BA_ "Description" SG_ 404 FLR_CT20_ExistanceProbability "Confidence tracked object existence. Currently set to the association rate [0..100] over the last 6 cycles";
BA_ "UserSigValidity" SG_ 404 FLR_CT20_ExistanceProbability 3;
BA_ "Description" SG_ 404 FLR_CT20_Lifetime "Number of cycles the target has been alive. Unknown 0

Tops out at about 6 minutes of continuous tracking.";
BA_ "UserSigValidity" SG_ 404 FLR_CT20_Lifetime 3;
BA_ "Description" SG_ 404 FLR_CT20_ModelBoxHeading "Heading of object

( Box model describing the object )";
BA_ "UserSigValidity" SG_ 404 FLR_CT20_ModelBoxHeading 3;
BA_ "Description" SG_ 404 FLR_CT20_ModelBoxLength "Length of the object

( Box model describing the object )";
BA_ "UserSigValidity" SG_ 404 FLR_CT20_ModelBoxLength 3;
BA_ "Description" SG_ 404 FLR_CT20_ModelBoxWidth "Width of the object

( Box model describing the object )";
BA_ "UserSigValidity" SG_ 404 FLR_CT20_ModelBoxWidth 3;
BA_ "Description" SG_ 404 FLR_CT20_ModelBoxX "X position, center of box

( Box model describing the object )";
BA_ "UserSigValidity" SG_ 404 FLR_CT20_ModelBoxX 3;
BA_ "Description" SG_ 404 FLR_CT20_ModelBoxY "Y position, center of box

( Box model describing the object )";
BA_ "UserSigValidity" SG_ 404 FLR_CT20_ModelBoxY 3;
BA_ "Description" SG_ 404 FLR_CT20_MotionClass "Tracked object motion classification";
BA_ "UserSigValidity" SG_ 404 FLR_CT20_MotionClass 3;
BA_ "Description" SG_ 404 FLR_CT20_ObjectId "A global ID, which is constant as long as the object is tracked. Note! A value of 0 indicates 'no object'";
BA_ "UserSigValidity" SG_ 404 FLR_CT20_ObjectId 3;
BA_ "Description" SG_ 404 FLR_CT20_ObservationHistory "Observation history of tracked object in as 32 bit-field for the last 32 cycles; for each bit: 1 = associated, 0 = not associated; LSB = most recent cycle, MSB = oldest cycle";
BA_ "UserSigValidity" SG_ 404 FLR_CT20_ObservationHistory 3;
BA_ "Description" SG_ 404 FLR_CT20_QualityBits "Bitmask for quality values described by ClusterTrackQualityBits";
BA_ "UserSigValidity" SG_ 404 FLR_CT20_QualityBits 3;
BA_ "Description" SG_ 404 FLR_CT20_StationaryCounter "Counts the cycles during which the object is ground stationary (i.e. absolute velocity over ground = 0)";
BA_ "UserSigValidity" SG_ 404 FLR_CT20_StationaryCounter 3;
BA_ "Description" SG_ 404 FLR_CT20_Type "Tracked object type classification";
BA_ "UserSigValidity" SG_ 404 FLR_CT20_Type 3;
BA_ "Description" SG_ 404 FLR_CT20_X_Acceleration "X acceleration 

( Movement estimation of object ) ";
BA_ "UserSigValidity" SG_ 404 FLR_CT20_X_Acceleration 3;
BA_ "Description" SG_ 404 FLR_CT20_X_Velocity "Absolute X velocity

( Movement estimation of object ) ";
BA_ "UserSigValidity" SG_ 404 FLR_CT20_X_Velocity 3;
BA_ "Description" SG_ 404 FLR_CT20_X_VelocityStdDev "Standard deviation of X velocity

( Movement estimation of object ) ";
BA_ "UserSigValidity" SG_ 404 FLR_CT20_X_VelocityStdDev 3;
BA_ "Description" SG_ 404 FLR_CT20_Y_Acceleration "Y acceleration 

( Movement estimation of object ) ";
BA_ "UserSigValidity" SG_ 404 FLR_CT20_Y_Acceleration 3;
BA_ "Description" SG_ 404 FLR_CT20_Y_Velocity "Absolute Y velocity

( Movement estimation of object ) ";
BA_ "UserSigValidity" SG_ 404 FLR_CT20_Y_Velocity 3;
BA_ "Description" SG_ 404 FLR_CT20_Y_VelocityStdDev "Standard deviation of Y velocity

( Movement estimation of object ) ";
BA_ "UserSigValidity" SG_ 404 FLR_CT20_Y_VelocityStdDev 3;
BA_ "Description" SG_ 405 FLR_CT21_CrcVal "The CRC checking process calculates the CRC over the entire data block, including the CRC result.

- CRC Polynomial (0x1021) , Initial Value : 0xFFFF, XOR value : 0x0000

- The mathematical expression to 16 bit CRC polynomial is given here. G(x) = x16 + ";
BA_ "GenSigStartValue" SG_ 405 FLR_CT21_CrcVal 65535;
BA_ "UserSigValidity" SG_ 405 FLR_CT21_CrcVal 3;
BA_ "Description" SG_ 405 FLR_CT21_AlvCntVal "[Alive counter] For the first transmission request for a data element the counter shall be initialized with 0 and shall be incremented by 1

for every subsequent send request. When the counter reaches the maximum value(0xFF), then it shall restart with â";
BA_ "UserSigValidity" SG_ 405 FLR_CT21_AlvCntVal 3;
BA_ "Description" SG_ 405 FLR_CT21_ListIndex "List index of cluster track";
BA_ "UserSigValidity" SG_ 405 FLR_CT21_ListIndex 3;
BA_ "Description" SG_ 405 FLR_CT21_SequenceCounter "[TimeSync]Sequence counter for checking the validity of message flow sequence";
BA_ "UserSigValidity" SG_ 405 FLR_CT21_SequenceCounter 3;
BA_ "Description" SG_ 405 FLR_CT21_TimeStamp "[TimeSync]System time, synchronized through AUTOSAR TimeSync";
BA_ "UserSigValidity" SG_ 405 FLR_CT21_TimeStamp 3;
BA_ "Description" SG_ 405 FLR_CT21_Latency "[TimeSync]Sensor latency from object capture scene to object transmission";
BA_ "UserSigValidity" SG_ 405 FLR_CT21_Latency 3;
BA_ "Description" SG_ 405 FLR_CT21_ClosestPointX "Kalman filtered closest point

X position ";
BA_ "UserSigValidity" SG_ 405 FLR_CT21_ClosestPointX 3;
BA_ "Description" SG_ 405 FLR_CT21_ClosestPointXStdDev "Standard deviation of X";
BA_ "UserSigValidity" SG_ 405 FLR_CT21_ClosestPointXStdDev 3;
BA_ "Description" SG_ 405 FLR_CT21_ClosestPointY "Kalman filtered closest point

Y position ";
BA_ "UserSigValidity" SG_ 405 FLR_CT21_ClosestPointY 3;
BA_ "Description" SG_ 405 FLR_CT21_ClosestPointYStdDev "Standard deviation of Y";
BA_ "UserSigValidity" SG_ 405 FLR_CT21_ClosestPointYStdDev 3;
BA_ "Description" SG_ 405 FLR_CT21_Confidence "Object confidence used in quality manager to provide 'Objektgate' (i.e. object quality) tracked object confidence is calculated based on the normalized difference of closest detection to the track's calculated closest point, for range, angle and velocity";
BA_ "UserSigValidity" SG_ 405 FLR_CT21_Confidence 3;
BA_ "Description" SG_ 405 FLR_CT21_Elevation "Elevation of the object";
BA_ "UserSigValidity" SG_ 405 FLR_CT21_Elevation 3;
BA_ "Description" SG_ 405 FLR_CT21_ElevationConfidence "Confidence the elevation classification is correct";
BA_ "UserSigValidity" SG_ 405 FLR_CT21_ElevationConfidence 3;
BA_ "Description" SG_ 405 FLR_CT21_ExistanceProbability "Confidence tracked object existence. Currently set to the association rate [0..100] over the last 6 cycles";
BA_ "UserSigValidity" SG_ 405 FLR_CT21_ExistanceProbability 3;
BA_ "Description" SG_ 405 FLR_CT21_Lifetime "Number of cycles the target has been alive. Unknown 0

Tops out at about 6 minutes of continuous tracking.";
BA_ "UserSigValidity" SG_ 405 FLR_CT21_Lifetime 3;
BA_ "Description" SG_ 405 FLR_CT21_ModelBoxHeading "Heading of object

( Box model describing the object )";
BA_ "UserSigValidity" SG_ 405 FLR_CT21_ModelBoxHeading 3;
BA_ "Description" SG_ 405 FLR_CT21_ModelBoxLength "Length of the object

( Box model describing the object )";
BA_ "UserSigValidity" SG_ 405 FLR_CT21_ModelBoxLength 3;
BA_ "Description" SG_ 405 FLR_CT21_ModelBoxWidth "Width of the object

( Box model describing the object )";
BA_ "UserSigValidity" SG_ 405 FLR_CT21_ModelBoxWidth 3;
BA_ "Description" SG_ 405 FLR_CT21_ModelBoxX "X position, center of box

( Box model describing the object )";
BA_ "UserSigValidity" SG_ 405 FLR_CT21_ModelBoxX 3;
BA_ "Description" SG_ 405 FLR_CT21_ModelBoxY "Y position, center of box

( Box model describing the object )";
BA_ "UserSigValidity" SG_ 405 FLR_CT21_ModelBoxY 3;
BA_ "Description" SG_ 405 FLR_CT21_MotionClass "Tracked object motion classification";
BA_ "UserSigValidity" SG_ 405 FLR_CT21_MotionClass 3;
BA_ "Description" SG_ 405 FLR_CT21_ObjectId "A global ID, which is constant as long as the object is tracked. Note! A value of 0 indicates 'no object'";
BA_ "UserSigValidity" SG_ 405 FLR_CT21_ObjectId 3;
BA_ "Description" SG_ 405 FLR_CT21_ObservationHistory "Observation history of tracked object in as 32 bit-field for the last 32 cycles; for each bit: 1 = associated, 0 = not associated; LSB = most recent cycle, MSB = oldest cycle";
BA_ "UserSigValidity" SG_ 405 FLR_CT21_ObservationHistory 3;
BA_ "Description" SG_ 405 FLR_CT21_QualityBits "Bitmask for quality values described by ClusterTrackQualityBits";
BA_ "UserSigValidity" SG_ 405 FLR_CT21_QualityBits 3;
BA_ "Description" SG_ 405 FLR_CT21_StationaryCounter "Counts the cycles during which the object is ground stationary (i.e. absolute velocity over ground = 0)";
BA_ "UserSigValidity" SG_ 405 FLR_CT21_StationaryCounter 3;
BA_ "Description" SG_ 405 FLR_CT21_Type "Tracked object type classification";
BA_ "UserSigValidity" SG_ 405 FLR_CT21_Type 3;
BA_ "Description" SG_ 405 FLR_CT21_X_Acceleration "X acceleration 

( Movement estimation of object ) ";
BA_ "UserSigValidity" SG_ 405 FLR_CT21_X_Acceleration 3;
BA_ "Description" SG_ 405 FLR_CT21_X_Velocity "Absolute X velocity

( Movement estimation of object ) ";
BA_ "UserSigValidity" SG_ 405 FLR_CT21_X_Velocity 3;
BA_ "Description" SG_ 405 FLR_CT21_X_VelocityStdDev "Standard deviation of X velocity

( Movement estimation of object ) ";
BA_ "UserSigValidity" SG_ 405 FLR_CT21_X_VelocityStdDev 3;
BA_ "Description" SG_ 405 FLR_CT21_Y_Acceleration "Y acceleration 

( Movement estimation of object ) ";
BA_ "UserSigValidity" SG_ 405 FLR_CT21_Y_Acceleration 3;
BA_ "Description" SG_ 405 FLR_CT21_Y_Velocity "Absolute Y velocity

( Movement estimation of object ) ";
BA_ "UserSigValidity" SG_ 405 FLR_CT21_Y_Velocity 3;
BA_ "Description" SG_ 405 FLR_CT21_Y_VelocityStdDev "Standard deviation of Y velocity

( Movement estimation of object ) ";
BA_ "UserSigValidity" SG_ 405 FLR_CT21_Y_VelocityStdDev 3;
BA_ "Description" SG_ 406 FLR_CT22_CrcVal "The CRC checking process calculates the CRC over the entire data block, including the CRC result.

- CRC Polynomial (0x1021) , Initial Value : 0xFFFF, XOR value : 0x0000

- The mathematical expression to 16 bit CRC polynomial is given here. G(x) = x16 + ";
BA_ "GenSigStartValue" SG_ 406 FLR_CT22_CrcVal 65535;
BA_ "UserSigValidity" SG_ 406 FLR_CT22_CrcVal 3;
BA_ "Description" SG_ 406 FLR_CT22_AlvCntVal "[Alive counter] For the first transmission request for a data element the counter shall be initialized with 0 and shall be incremented by 1

for every subsequent send request. When the counter reaches the maximum value(0xFF), then it shall restart with â";
BA_ "UserSigValidity" SG_ 406 FLR_CT22_AlvCntVal 3;
BA_ "Description" SG_ 406 FLR_CT22_ListIndex "List index of cluster track";
BA_ "UserSigValidity" SG_ 406 FLR_CT22_ListIndex 3;
BA_ "Description" SG_ 406 FLR_CT22_SequenceCounter "[TimeSync]Sequence counter for checking the validity of message flow sequence";
BA_ "UserSigValidity" SG_ 406 FLR_CT22_SequenceCounter 3;
BA_ "Description" SG_ 406 FLR_CT22_TimeStamp "[TimeSync]System time, synchronized through AUTOSAR TimeSync";
BA_ "UserSigValidity" SG_ 406 FLR_CT22_TimeStamp 3;
BA_ "Description" SG_ 406 FLR_CT22_Latency "[TimeSync]Sensor latency from object capture scene to object transmission";
BA_ "UserSigValidity" SG_ 406 FLR_CT22_Latency 3;
BA_ "Description" SG_ 406 FLR_CT22_ClosestPointX "Kalman filtered closest point

X position ";
BA_ "UserSigValidity" SG_ 406 FLR_CT22_ClosestPointX 3;
BA_ "Description" SG_ 406 FLR_CT22_ClosestPointXStdDev "Standard deviation of X";
BA_ "UserSigValidity" SG_ 406 FLR_CT22_ClosestPointXStdDev 3;
BA_ "Description" SG_ 406 FLR_CT22_ClosestPointY "Kalman filtered closest point

Y position ";
BA_ "UserSigValidity" SG_ 406 FLR_CT22_ClosestPointY 3;
BA_ "Description" SG_ 406 FLR_CT22_ClosestPointYStdDev "Standard deviation of Y";
BA_ "UserSigValidity" SG_ 406 FLR_CT22_ClosestPointYStdDev 3;
BA_ "Description" SG_ 406 FLR_CT22_Confidence "Object confidence used in quality manager to provide 'Objektgate' (i.e. object quality) tracked object confidence is calculated based on the normalized difference of closest detection to the track's calculated closest point, for range, angle and velocity";
BA_ "UserSigValidity" SG_ 406 FLR_CT22_Confidence 3;
BA_ "Description" SG_ 406 FLR_CT22_Elevation "Elevation of the object";
BA_ "UserSigValidity" SG_ 406 FLR_CT22_Elevation 3;
BA_ "Description" SG_ 406 FLR_CT22_ElevationConfidence "Confidence the elevation classification is correct";
BA_ "UserSigValidity" SG_ 406 FLR_CT22_ElevationConfidence 3;
BA_ "Description" SG_ 406 FLR_CT22_ExistanceProbability "Confidence tracked object existence. Currently set to the association rate [0..100] over the last 6 cycles";
BA_ "UserSigValidity" SG_ 406 FLR_CT22_ExistanceProbability 3;
BA_ "Description" SG_ 406 FLR_CT22_Lifetime "Number of cycles the target has been alive. Unknown 0

Tops out at about 6 minutes of continuous tracking.";
BA_ "UserSigValidity" SG_ 406 FLR_CT22_Lifetime 3;
BA_ "Description" SG_ 406 FLR_CT22_ModelBoxHeading "Heading of object

( Box model describing the object )";
BA_ "UserSigValidity" SG_ 406 FLR_CT22_ModelBoxHeading 3;
BA_ "Description" SG_ 406 FLR_CT22_ModelBoxLength "Length of the object

( Box model describing the object )";
BA_ "UserSigValidity" SG_ 406 FLR_CT22_ModelBoxLength 3;
BA_ "Description" SG_ 406 FLR_CT22_ModelBoxWidth "Width of the object

( Box model describing the object )";
BA_ "UserSigValidity" SG_ 406 FLR_CT22_ModelBoxWidth 3;
BA_ "Description" SG_ 406 FLR_CT22_ModelBoxX "X position, center of box

( Box model describing the object )";
BA_ "UserSigValidity" SG_ 406 FLR_CT22_ModelBoxX 3;
BA_ "Description" SG_ 406 FLR_CT22_ModelBoxY "Y position, center of box

( Box model describing the object )";
BA_ "UserSigValidity" SG_ 406 FLR_CT22_ModelBoxY 3;
BA_ "Description" SG_ 406 FLR_CT22_MotionClass "Tracked object motion classification";
BA_ "UserSigValidity" SG_ 406 FLR_CT22_MotionClass 3;
BA_ "Description" SG_ 406 FLR_CT22_ObjectId "A global ID, which is constant as long as the object is tracked. Note! A value of 0 indicates 'no object'";
BA_ "UserSigValidity" SG_ 406 FLR_CT22_ObjectId 3;
BA_ "Description" SG_ 406 FLR_CT22_ObservationHistory "Observation history of tracked object in as 32 bit-field for the last 32 cycles; for each bit: 1 = associated, 0 = not associated; LSB = most recent cycle, MSB = oldest cycle";
BA_ "UserSigValidity" SG_ 406 FLR_CT22_ObservationHistory 3;
BA_ "Description" SG_ 406 FLR_CT22_QualityBits "Bitmask for quality values described by ClusterTrackQualityBits";
BA_ "UserSigValidity" SG_ 406 FLR_CT22_QualityBits 3;
BA_ "Description" SG_ 406 FLR_CT22_StationaryCounter "Counts the cycles during which the object is ground stationary (i.e. absolute velocity over ground = 0)";
BA_ "UserSigValidity" SG_ 406 FLR_CT22_StationaryCounter 3;
BA_ "Description" SG_ 406 FLR_CT22_Type "Tracked object type classification";
BA_ "UserSigValidity" SG_ 406 FLR_CT22_Type 3;
BA_ "Description" SG_ 406 FLR_CT22_X_Acceleration "X acceleration 

( Movement estimation of object ) ";
BA_ "UserSigValidity" SG_ 406 FLR_CT22_X_Acceleration 3;
BA_ "Description" SG_ 406 FLR_CT22_X_Velocity "Absolute X velocity

( Movement estimation of object ) ";
BA_ "UserSigValidity" SG_ 406 FLR_CT22_X_Velocity 3;
BA_ "Description" SG_ 406 FLR_CT22_X_VelocityStdDev "Standard deviation of X velocity

( Movement estimation of object ) ";
BA_ "UserSigValidity" SG_ 406 FLR_CT22_X_VelocityStdDev 3;
BA_ "Description" SG_ 406 FLR_CT22_Y_Acceleration "Y acceleration 

( Movement estimation of object ) ";
BA_ "UserSigValidity" SG_ 406 FLR_CT22_Y_Acceleration 3;
BA_ "Description" SG_ 406 FLR_CT22_Y_Velocity "Absolute Y velocity

( Movement estimation of object ) ";
BA_ "UserSigValidity" SG_ 406 FLR_CT22_Y_Velocity 3;
BA_ "Description" SG_ 406 FLR_CT22_Y_VelocityStdDev "Standard deviation of Y velocity

( Movement estimation of object ) ";
BA_ "UserSigValidity" SG_ 406 FLR_CT22_Y_VelocityStdDev 3;
BA_ "Description" SG_ 407 FLR_CT23_CrcVal "The CRC checking process calculates the CRC over the entire data block, including the CRC result.

- CRC Polynomial (0x1021) , Initial Value : 0xFFFF, XOR value : 0x0000

- The mathematical expression to 16 bit CRC polynomial is given here. G(x) = x16 + ";
BA_ "GenSigStartValue" SG_ 407 FLR_CT23_CrcVal 65535;
BA_ "UserSigValidity" SG_ 407 FLR_CT23_CrcVal 3;
BA_ "Description" SG_ 407 FLR_CT23_AlvCntVal "[Alive counter] For the first transmission request for a data element the counter shall be initialized with 0 and shall be incremented by 1

for every subsequent send request. When the counter reaches the maximum value(0xFF), then it shall restart with â";
BA_ "UserSigValidity" SG_ 407 FLR_CT23_AlvCntVal 3;
BA_ "Description" SG_ 407 FLR_CT23_ListIndex "List index of cluster track";
BA_ "UserSigValidity" SG_ 407 FLR_CT23_ListIndex 3;
BA_ "Description" SG_ 407 FLR_CT23_SequenceCounter "[TimeSync]Sequence counter for checking the validity of message flow sequence";
BA_ "UserSigValidity" SG_ 407 FLR_CT23_SequenceCounter 3;
BA_ "Description" SG_ 407 FLR_CT23_TimeStamp "[TimeSync]System time, synchronized through AUTOSAR TimeSync";
BA_ "UserSigValidity" SG_ 407 FLR_CT23_TimeStamp 3;
BA_ "Description" SG_ 407 FLR_CT23_Latency "[TimeSync]Sensor latency from object capture scene to object transmission";
BA_ "UserSigValidity" SG_ 407 FLR_CT23_Latency 3;
BA_ "Description" SG_ 407 FLR_CT23_ClosestPointX "Kalman filtered closest point

X position ";
BA_ "UserSigValidity" SG_ 407 FLR_CT23_ClosestPointX 3;
BA_ "Description" SG_ 407 FLR_CT23_ClosestPointXStdDev "Standard deviation of X";
BA_ "UserSigValidity" SG_ 407 FLR_CT23_ClosestPointXStdDev 3;
BA_ "Description" SG_ 407 FLR_CT23_ClosestPointY "Kalman filtered closest point

Y position ";
BA_ "UserSigValidity" SG_ 407 FLR_CT23_ClosestPointY 3;
BA_ "Description" SG_ 407 FLR_CT23_ClosestPointYStdDev "Standard deviation of Y";
BA_ "UserSigValidity" SG_ 407 FLR_CT23_ClosestPointYStdDev 3;
BA_ "Description" SG_ 407 FLR_CT23_Confidence "Object confidence used in quality manager to provide 'Objektgate' (i.e. object quality) tracked object confidence is calculated based on the normalized difference of closest detection to the track's calculated closest point, for range, angle and velocity";
BA_ "UserSigValidity" SG_ 407 FLR_CT23_Confidence 3;
BA_ "Description" SG_ 407 FLR_CT23_Elevation "Elevation of the object";
BA_ "UserSigValidity" SG_ 407 FLR_CT23_Elevation 3;
BA_ "Description" SG_ 407 FLR_CT23_ElevationConfidence "Confidence the elevation classification is correct";
BA_ "UserSigValidity" SG_ 407 FLR_CT23_ElevationConfidence 3;
BA_ "Description" SG_ 407 FLR_CT23_ExistanceProbability "Confidence tracked object existence. Currently set to the association rate [0..100] over the last 6 cycles";
BA_ "UserSigValidity" SG_ 407 FLR_CT23_ExistanceProbability 3;
BA_ "Description" SG_ 407 FLR_CT23_Lifetime "Number of cycles the target has been alive. Unknown 0

Tops out at about 6 minutes of continuous tracking.";
BA_ "UserSigValidity" SG_ 407 FLR_CT23_Lifetime 3;
BA_ "Description" SG_ 407 FLR_CT23_ModelBoxHeading "Heading of object

( Box model describing the object )";
BA_ "UserSigValidity" SG_ 407 FLR_CT23_ModelBoxHeading 3;
BA_ "Description" SG_ 407 FLR_CT23_ModelBoxLength "Length of the object

( Box model describing the object )";
BA_ "UserSigValidity" SG_ 407 FLR_CT23_ModelBoxLength 3;
BA_ "Description" SG_ 407 FLR_CT23_ModelBoxWidth "Width of the object

( Box model describing the object )";
BA_ "UserSigValidity" SG_ 407 FLR_CT23_ModelBoxWidth 3;
BA_ "Description" SG_ 407 FLR_CT23_ModelBoxX "X position, center of box

( Box model describing the object )";
BA_ "UserSigValidity" SG_ 407 FLR_CT23_ModelBoxX 3;
BA_ "Description" SG_ 407 FLR_CT23_ModelBoxY "Y position, center of box

( Box model describing the object )";
BA_ "UserSigValidity" SG_ 407 FLR_CT23_ModelBoxY 3;
BA_ "Description" SG_ 407 FLR_CT23_MotionClass "Tracked object motion classification";
BA_ "UserSigValidity" SG_ 407 FLR_CT23_MotionClass 3;
BA_ "Description" SG_ 407 FLR_CT23_ObjectId "A global ID, which is constant as long as the object is tracked. Note! A value of 0 indicates 'no object'";
BA_ "UserSigValidity" SG_ 407 FLR_CT23_ObjectId 3;
BA_ "Description" SG_ 407 FLR_CT23_ObservationHistory "Observation history of tracked object in as 32 bit-field for the last 32 cycles; for each bit: 1 = associated, 0 = not associated; LSB = most recent cycle, MSB = oldest cycle";
BA_ "UserSigValidity" SG_ 407 FLR_CT23_ObservationHistory 3;
BA_ "Description" SG_ 407 FLR_CT23_QualityBits "Bitmask for quality values described by ClusterTrackQualityBits";
BA_ "UserSigValidity" SG_ 407 FLR_CT23_QualityBits 3;
BA_ "Description" SG_ 407 FLR_CT23_StationaryCounter "Counts the cycles during which the object is ground stationary (i.e. absolute velocity over ground = 0)";
BA_ "UserSigValidity" SG_ 407 FLR_CT23_StationaryCounter 3;
BA_ "Description" SG_ 407 FLR_CT23_Type "Tracked object type classification";
BA_ "UserSigValidity" SG_ 407 FLR_CT23_Type 3;
BA_ "Description" SG_ 407 FLR_CT23_X_Acceleration "X acceleration 

( Movement estimation of object ) ";
BA_ "UserSigValidity" SG_ 407 FLR_CT23_X_Acceleration 3;
BA_ "Description" SG_ 407 FLR_CT23_X_Velocity "Absolute X velocity

( Movement estimation of object ) ";
BA_ "UserSigValidity" SG_ 407 FLR_CT23_X_Velocity 3;
BA_ "Description" SG_ 407 FLR_CT23_X_VelocityStdDev "Standard deviation of X velocity

( Movement estimation of object ) ";
BA_ "UserSigValidity" SG_ 407 FLR_CT23_X_VelocityStdDev 3;
BA_ "Description" SG_ 407 FLR_CT23_Y_Acceleration "Y acceleration 

( Movement estimation of object ) ";
BA_ "UserSigValidity" SG_ 407 FLR_CT23_Y_Acceleration 3;
BA_ "Description" SG_ 407 FLR_CT23_Y_Velocity "Absolute Y velocity

( Movement estimation of object ) ";
BA_ "UserSigValidity" SG_ 407 FLR_CT23_Y_Velocity 3;
BA_ "Description" SG_ 407 FLR_CT23_Y_VelocityStdDev "Standard deviation of Y velocity

( Movement estimation of object ) ";
BA_ "UserSigValidity" SG_ 407 FLR_CT23_Y_VelocityStdDev 3;
BA_ "Description" SG_ 408 FLR_CT24_CrcVal "The CRC checking process calculates the CRC over the entire data block, including the CRC result.

- CRC Polynomial (0x1021) , Initial Value : 0xFFFF, XOR value : 0x0000

- The mathematical expression to 16 bit CRC polynomial is given here. G(x) = x16 + ";
BA_ "GenSigStartValue" SG_ 408 FLR_CT24_CrcVal 65535;
BA_ "UserSigValidity" SG_ 408 FLR_CT24_CrcVal 3;
BA_ "Description" SG_ 408 FLR_CT24_AlvCntVal "[Alive counter] For the first transmission request for a data element the counter shall be initialized with 0 and shall be incremented by 1

for every subsequent send request. When the counter reaches the maximum value(0xFF), then it shall restart with â";
BA_ "UserSigValidity" SG_ 408 FLR_CT24_AlvCntVal 3;
BA_ "Description" SG_ 408 FLR_CT24_ListIndex "List index of cluster track";
BA_ "UserSigValidity" SG_ 408 FLR_CT24_ListIndex 3;
BA_ "Description" SG_ 408 FLR_CT24_SequenceCounter "[TimeSync]Sequence counter for checking the validity of message flow sequence";
BA_ "UserSigValidity" SG_ 408 FLR_CT24_SequenceCounter 3;
BA_ "Description" SG_ 408 FLR_CT24_TimeStamp "[TimeSync]System time, synchronized through AUTOSAR TimeSync";
BA_ "UserSigValidity" SG_ 408 FLR_CT24_TimeStamp 3;
BA_ "Description" SG_ 408 FLR_CT24_Latency "[TimeSync]Sensor latency from object capture scene to object transmission";
BA_ "UserSigValidity" SG_ 408 FLR_CT24_Latency 3;
BA_ "Description" SG_ 408 FLR_CT24_ClosestPointX "Kalman filtered closest point

X position ";
BA_ "UserSigValidity" SG_ 408 FLR_CT24_ClosestPointX 3;
BA_ "Description" SG_ 408 FLR_CT24_ClosestPointXStdDev "Standard deviation of X";
BA_ "UserSigValidity" SG_ 408 FLR_CT24_ClosestPointXStdDev 3;
BA_ "Description" SG_ 408 FLR_CT24_ClosestPointY "Kalman filtered closest point

Y position ";
BA_ "UserSigValidity" SG_ 408 FLR_CT24_ClosestPointY 3;
BA_ "Description" SG_ 408 FLR_CT24_ClosestPointYStdDev "Standard deviation of Y";
BA_ "UserSigValidity" SG_ 408 FLR_CT24_ClosestPointYStdDev 3;
BA_ "Description" SG_ 408 FLR_CT24_Confidence "Object confidence used in quality manager to provide 'Objektgate' (i.e. object quality) tracked object confidence is calculated based on the normalized difference of closest detection to the track's calculated closest point, for range, angle and velocity";
BA_ "UserSigValidity" SG_ 408 FLR_CT24_Confidence 3;
BA_ "Description" SG_ 408 FLR_CT24_Elevation "Elevation of the object";
BA_ "UserSigValidity" SG_ 408 FLR_CT24_Elevation 3;
BA_ "Description" SG_ 408 FLR_CT24_ElevationConfidence "Confidence the elevation classification is correct";
BA_ "UserSigValidity" SG_ 408 FLR_CT24_ElevationConfidence 3;
BA_ "Description" SG_ 408 FLR_CT24_ExistanceProbability "Confidence tracked object existence. Currently set to the association rate [0..100] over the last 6 cycles";
BA_ "UserSigValidity" SG_ 408 FLR_CT24_ExistanceProbability 3;
BA_ "Description" SG_ 408 FLR_CT24_Lifetime "Number of cycles the target has been alive. Unknown 0

Tops out at about 6 minutes of continuous tracking.";
BA_ "UserSigValidity" SG_ 408 FLR_CT24_Lifetime 3;
BA_ "Description" SG_ 408 FLR_CT24_ModelBoxHeading "Heading of object

( Box model describing the object )";
BA_ "UserSigValidity" SG_ 408 FLR_CT24_ModelBoxHeading 3;
BA_ "Description" SG_ 408 FLR_CT24_ModelBoxLength "Length of the object

( Box model describing the object )";
BA_ "UserSigValidity" SG_ 408 FLR_CT24_ModelBoxLength 3;
BA_ "Description" SG_ 408 FLR_CT24_ModelBoxWidth "Width of the object

( Box model describing the object )";
BA_ "UserSigValidity" SG_ 408 FLR_CT24_ModelBoxWidth 3;
BA_ "Description" SG_ 408 FLR_CT24_ModelBoxX "X position, center of box

( Box model describing the object )";
BA_ "UserSigValidity" SG_ 408 FLR_CT24_ModelBoxX 3;
BA_ "Description" SG_ 408 FLR_CT24_ModelBoxY "Y position, center of box

( Box model describing the object )";
BA_ "UserSigValidity" SG_ 408 FLR_CT24_ModelBoxY 3;
BA_ "Description" SG_ 408 FLR_CT24_MotionClass "Tracked object motion classification";
BA_ "UserSigValidity" SG_ 408 FLR_CT24_MotionClass 3;
BA_ "Description" SG_ 408 FLR_CT24_ObjectId "A global ID, which is constant as long as the object is tracked. Note! A value of 0 indicates 'no object'";
BA_ "UserSigValidity" SG_ 408 FLR_CT24_ObjectId 3;
BA_ "Description" SG_ 408 FLR_CT24_ObservationHistory "Observation history of tracked object in as 32 bit-field for the last 32 cycles; for each bit: 1 = associated, 0 = not associated; LSB = most recent cycle, MSB = oldest cycle";
BA_ "UserSigValidity" SG_ 408 FLR_CT24_ObservationHistory 3;
BA_ "Description" SG_ 408 FLR_CT24_QualityBits "Bitmask for quality values described by ClusterTrackQualityBits";
BA_ "UserSigValidity" SG_ 408 FLR_CT24_QualityBits 3;
BA_ "Description" SG_ 408 FLR_CT24_StationaryCounter "Counts the cycles during which the object is ground stationary (i.e. absolute velocity over ground = 0)";
BA_ "UserSigValidity" SG_ 408 FLR_CT24_StationaryCounter 3;
BA_ "Description" SG_ 408 FLR_CT24_Type "Tracked object type classification";
BA_ "UserSigValidity" SG_ 408 FLR_CT24_Type 3;
BA_ "Description" SG_ 408 FLR_CT24_X_Acceleration "X acceleration 

( Movement estimation of object ) ";
BA_ "UserSigValidity" SG_ 408 FLR_CT24_X_Acceleration 3;
BA_ "Description" SG_ 408 FLR_CT24_X_Velocity "Absolute X velocity

( Movement estimation of object ) ";
BA_ "UserSigValidity" SG_ 408 FLR_CT24_X_Velocity 3;
BA_ "Description" SG_ 408 FLR_CT24_X_VelocityStdDev "Standard deviation of X velocity

( Movement estimation of object ) ";
BA_ "UserSigValidity" SG_ 408 FLR_CT24_X_VelocityStdDev 3;
BA_ "Description" SG_ 408 FLR_CT24_Y_Acceleration "Y acceleration 

( Movement estimation of object ) ";
BA_ "UserSigValidity" SG_ 408 FLR_CT24_Y_Acceleration 3;
BA_ "Description" SG_ 408 FLR_CT24_Y_Velocity "Absolute Y velocity

( Movement estimation of object ) ";
BA_ "UserSigValidity" SG_ 408 FLR_CT24_Y_Velocity 3;
BA_ "Description" SG_ 408 FLR_CT24_Y_VelocityStdDev "Standard deviation of Y velocity

( Movement estimation of object ) ";
BA_ "UserSigValidity" SG_ 408 FLR_CT24_Y_VelocityStdDev 3;
BA_ "Description" SG_ 409 FLR_CT25_CrcVal "The CRC checking process calculates the CRC over the entire data block, including the CRC result.

- CRC Polynomial (0x1021) , Initial Value : 0xFFFF, XOR value : 0x0000

- The mathematical expression to 16 bit CRC polynomial is given here. G(x) = x16 + ";
BA_ "GenSigStartValue" SG_ 409 FLR_CT25_CrcVal 65535;
BA_ "UserSigValidity" SG_ 409 FLR_CT25_CrcVal 3;
BA_ "Description" SG_ 409 FLR_CT25_AlvCntVal "[Alive counter] For the first transmission request for a data element the counter shall be initialized with 0 and shall be incremented by 1

for every subsequent send request. When the counter reaches the maximum value(0xFF), then it shall restart with â";
BA_ "UserSigValidity" SG_ 409 FLR_CT25_AlvCntVal 3;
BA_ "Description" SG_ 409 FLR_CT25_ListIndex "List index of cluster track";
BA_ "UserSigValidity" SG_ 409 FLR_CT25_ListIndex 3;
BA_ "Description" SG_ 409 FLR_CT25_SequenceCounter "[TimeSync]Sequence counter for checking the validity of message flow sequence";
BA_ "UserSigValidity" SG_ 409 FLR_CT25_SequenceCounter 3;
BA_ "Description" SG_ 409 FLR_CT25_TimeStamp "[TimeSync]System time, synchronized through AUTOSAR TimeSync";
BA_ "UserSigValidity" SG_ 409 FLR_CT25_TimeStamp 3;
BA_ "Description" SG_ 409 FLR_CT25_Latency "[TimeSync]Sensor latency from object capture scene to object transmission";
BA_ "UserSigValidity" SG_ 409 FLR_CT25_Latency 3;
BA_ "Description" SG_ 409 FLR_CT25_ClosestPointX "Kalman filtered closest point

X position ";
BA_ "UserSigValidity" SG_ 409 FLR_CT25_ClosestPointX 3;
BA_ "Description" SG_ 409 FLR_CT25_ClosestPointXStdDev "Standard deviation of X";
BA_ "UserSigValidity" SG_ 409 FLR_CT25_ClosestPointXStdDev 3;
BA_ "Description" SG_ 409 FLR_CT25_ClosestPointY "Kalman filtered closest point

Y position ";
BA_ "UserSigValidity" SG_ 409 FLR_CT25_ClosestPointY 3;
BA_ "Description" SG_ 409 FLR_CT25_ClosestPointYStdDev "Standard deviation of Y";
BA_ "UserSigValidity" SG_ 409 FLR_CT25_ClosestPointYStdDev 3;
BA_ "Description" SG_ 409 FLR_CT25_Confidence "Object confidence used in quality manager to provide 'Objektgate' (i.e. object quality) tracked object confidence is calculated based on the normalized difference of closest detection to the track's calculated closest point, for range, angle and velocity";
BA_ "UserSigValidity" SG_ 409 FLR_CT25_Confidence 3;
BA_ "Description" SG_ 409 FLR_CT25_Elevation "Elevation of the object";
BA_ "UserSigValidity" SG_ 409 FLR_CT25_Elevation 3;
BA_ "Description" SG_ 409 FLR_CT25_ElevationConfidence "Confidence the elevation classification is correct";
BA_ "UserSigValidity" SG_ 409 FLR_CT25_ElevationConfidence 3;
BA_ "Description" SG_ 409 FLR_CT25_ExistanceProbability "Confidence tracked object existence. Currently set to the association rate [0..100] over the last 6 cycles";
BA_ "UserSigValidity" SG_ 409 FLR_CT25_ExistanceProbability 3;
BA_ "Description" SG_ 409 FLR_CT25_Lifetime "Number of cycles the target has been alive. Unknown 0

Tops out at about 6 minutes of continuous tracking.";
BA_ "UserSigValidity" SG_ 409 FLR_CT25_Lifetime 3;
BA_ "Description" SG_ 409 FLR_CT25_ModelBoxHeading "Heading of object

( Box model describing the object )";
BA_ "UserSigValidity" SG_ 409 FLR_CT25_ModelBoxHeading 3;
BA_ "Description" SG_ 409 FLR_CT25_ModelBoxLength "Length of the object

( Box model describing the object )";
BA_ "UserSigValidity" SG_ 409 FLR_CT25_ModelBoxLength 3;
BA_ "Description" SG_ 409 FLR_CT25_ModelBoxWidth "Width of the object

( Box model describing the object )";
BA_ "UserSigValidity" SG_ 409 FLR_CT25_ModelBoxWidth 3;
BA_ "Description" SG_ 409 FLR_CT25_ModelBoxX "X position, center of box

( Box model describing the object )";
BA_ "UserSigValidity" SG_ 409 FLR_CT25_ModelBoxX 3;
BA_ "Description" SG_ 409 FLR_CT25_ModelBoxY "Y position, center of box

( Box model describing the object )";
BA_ "UserSigValidity" SG_ 409 FLR_CT25_ModelBoxY 3;
BA_ "Description" SG_ 409 FLR_CT25_MotionClass "Tracked object motion classification";
BA_ "UserSigValidity" SG_ 409 FLR_CT25_MotionClass 3;
BA_ "Description" SG_ 409 FLR_CT25_ObjectId "A global ID, which is constant as long as the object is tracked. Note! A value of 0 indicates 'no object'";
BA_ "UserSigValidity" SG_ 409 FLR_CT25_ObjectId 3;
BA_ "Description" SG_ 409 FLR_CT25_ObservationHistory "Observation history of tracked object in as 32 bit-field for the last 32 cycles; for each bit: 1 = associated, 0 = not associated; LSB = most recent cycle, MSB = oldest cycle";
BA_ "UserSigValidity" SG_ 409 FLR_CT25_ObservationHistory 3;
BA_ "Description" SG_ 409 FLR_CT25_QualityBits "Bitmask for quality values described by ClusterTrackQualityBits";
BA_ "UserSigValidity" SG_ 409 FLR_CT25_QualityBits 3;
BA_ "Description" SG_ 409 FLR_CT25_StationaryCounter "Counts the cycles during which the object is ground stationary (i.e. absolute velocity over ground = 0)";
BA_ "UserSigValidity" SG_ 409 FLR_CT25_StationaryCounter 3;
BA_ "Description" SG_ 409 FLR_CT25_Type "Tracked object type classification";
BA_ "UserSigValidity" SG_ 409 FLR_CT25_Type 3;
BA_ "Description" SG_ 409 FLR_CT25_X_Acceleration "X acceleration 

( Movement estimation of object ) ";
BA_ "UserSigValidity" SG_ 409 FLR_CT25_X_Acceleration 3;
BA_ "Description" SG_ 409 FLR_CT25_X_Velocity "Absolute X velocity

( Movement estimation of object ) ";
BA_ "UserSigValidity" SG_ 409 FLR_CT25_X_Velocity 3;
BA_ "Description" SG_ 409 FLR_CT25_X_VelocityStdDev "Standard deviation of X velocity

( Movement estimation of object ) ";
BA_ "UserSigValidity" SG_ 409 FLR_CT25_X_VelocityStdDev 3;
BA_ "Description" SG_ 409 FLR_CT25_Y_Acceleration "Y acceleration 

( Movement estimation of object ) ";
BA_ "UserSigValidity" SG_ 409 FLR_CT25_Y_Acceleration 3;
BA_ "Description" SG_ 409 FLR_CT25_Y_Velocity "Absolute Y velocity

( Movement estimation of object ) ";
BA_ "UserSigValidity" SG_ 409 FLR_CT25_Y_Velocity 3;
BA_ "Description" SG_ 409 FLR_CT25_Y_VelocityStdDev "Standard deviation of Y velocity

( Movement estimation of object ) ";
BA_ "UserSigValidity" SG_ 409 FLR_CT25_Y_VelocityStdDev 3;
BA_ "Description" SG_ 410 FLR_CT26_CrcVal "The CRC checking process calculates the CRC over the entire data block, including the CRC result.

- CRC Polynomial (0x1021) , Initial Value : 0xFFFF, XOR value : 0x0000

- The mathematical expression to 16 bit CRC polynomial is given here. G(x) = x16 + ";
BA_ "GenSigStartValue" SG_ 410 FLR_CT26_CrcVal 65535;
BA_ "UserSigValidity" SG_ 410 FLR_CT26_CrcVal 3;
BA_ "Description" SG_ 410 FLR_CT26_AlvCntVal "[Alive counter] For the first transmission request for a data element the counter shall be initialized with 0 and shall be incremented by 1

for every subsequent send request. When the counter reaches the maximum value(0xFF), then it shall restart with â";
BA_ "UserSigValidity" SG_ 410 FLR_CT26_AlvCntVal 3;
BA_ "Description" SG_ 410 FLR_CT26_ListIndex "List index of cluster track";
BA_ "UserSigValidity" SG_ 410 FLR_CT26_ListIndex 3;
BA_ "Description" SG_ 410 FLR_CT26_SequenceCounter "[TimeSync]Sequence counter for checking the validity of message flow sequence";
BA_ "UserSigValidity" SG_ 410 FLR_CT26_SequenceCounter 3;
BA_ "Description" SG_ 410 FLR_CT26_TimeStamp "[TimeSync]System time, synchronized through AUTOSAR TimeSync";
BA_ "UserSigValidity" SG_ 410 FLR_CT26_TimeStamp 3;
BA_ "Description" SG_ 410 FLR_CT26_Latency "[TimeSync]Sensor latency from object capture scene to object transmission";
BA_ "UserSigValidity" SG_ 410 FLR_CT26_Latency 3;
BA_ "Description" SG_ 410 FLR_CT26_ClosestPointX "Kalman filtered closest point

X position ";
BA_ "UserSigValidity" SG_ 410 FLR_CT26_ClosestPointX 3;
BA_ "Description" SG_ 410 FLR_CT26_ClosestPointXStdDev "Standard deviation of X";
BA_ "UserSigValidity" SG_ 410 FLR_CT26_ClosestPointXStdDev 3;
BA_ "Description" SG_ 410 FLR_CT26_ClosestPointY "Kalman filtered closest point

Y position ";
BA_ "UserSigValidity" SG_ 410 FLR_CT26_ClosestPointY 3;
BA_ "Description" SG_ 410 FLR_CT26_ClosestPointYStdDev "Standard deviation of Y";
BA_ "UserSigValidity" SG_ 410 FLR_CT26_ClosestPointYStdDev 3;
BA_ "Description" SG_ 410 FLR_CT26_Confidence "Object confidence used in quality manager to provide 'Objektgate' (i.e. object quality) tracked object confidence is calculated based on the normalized difference of closest detection to the track's calculated closest point, for range, angle and velocity";
BA_ "UserSigValidity" SG_ 410 FLR_CT26_Confidence 3;
BA_ "Description" SG_ 410 FLR_CT26_Elevation "Elevation of the object";
BA_ "UserSigValidity" SG_ 410 FLR_CT26_Elevation 3;
BA_ "Description" SG_ 410 FLR_CT26_ElevationConfidence "Confidence the elevation classification is correct";
BA_ "UserSigValidity" SG_ 410 FLR_CT26_ElevationConfidence 3;
BA_ "Description" SG_ 410 FLR_CT26_ExistanceProbability "Confidence tracked object existence. Currently set to the association rate [0..100] over the last 6 cycles";
BA_ "UserSigValidity" SG_ 410 FLR_CT26_ExistanceProbability 3;
BA_ "Description" SG_ 410 FLR_CT26_Lifetime "Number of cycles the target has been alive. Unknown 0

Tops out at about 6 minutes of continuous tracking.";
BA_ "UserSigValidity" SG_ 410 FLR_CT26_Lifetime 3;
BA_ "Description" SG_ 410 FLR_CT26_ModelBoxHeading "Heading of object

( Box model describing the object )";
BA_ "UserSigValidity" SG_ 410 FLR_CT26_ModelBoxHeading 3;
BA_ "Description" SG_ 410 FLR_CT26_ModelBoxLength "Length of the object

( Box model describing the object )";
BA_ "UserSigValidity" SG_ 410 FLR_CT26_ModelBoxLength 3;
BA_ "Description" SG_ 410 FLR_CT26_ModelBoxWidth "Width of the object

( Box model describing the object )";
BA_ "UserSigValidity" SG_ 410 FLR_CT26_ModelBoxWidth 3;
BA_ "Description" SG_ 410 FLR_CT26_ModelBoxX "X position, center of box

( Box model describing the object )";
BA_ "UserSigValidity" SG_ 410 FLR_CT26_ModelBoxX 3;
BA_ "Description" SG_ 410 FLR_CT26_ModelBoxY "Y position, center of box

( Box model describing the object )";
BA_ "UserSigValidity" SG_ 410 FLR_CT26_ModelBoxY 3;
BA_ "Description" SG_ 410 FLR_CT26_MotionClass "Tracked object motion classification";
BA_ "UserSigValidity" SG_ 410 FLR_CT26_MotionClass 3;
BA_ "Description" SG_ 410 FLR_CT26_ObjectId "A global ID, which is constant as long as the object is tracked. Note! A value of 0 indicates 'no object'";
BA_ "UserSigValidity" SG_ 410 FLR_CT26_ObjectId 3;
BA_ "Description" SG_ 410 FLR_CT26_ObservationHistory "Observation history of tracked object in as 32 bit-field for the last 32 cycles; for each bit: 1 = associated, 0 = not associated; LSB = most recent cycle, MSB = oldest cycle";
BA_ "UserSigValidity" SG_ 410 FLR_CT26_ObservationHistory 3;
BA_ "Description" SG_ 410 FLR_CT26_QualityBits "Bitmask for quality values described by ClusterTrackQualityBits";
BA_ "UserSigValidity" SG_ 410 FLR_CT26_QualityBits 3;
BA_ "Description" SG_ 410 FLR_CT26_StationaryCounter "Counts the cycles during which the object is ground stationary (i.e. absolute velocity over ground = 0)";
BA_ "UserSigValidity" SG_ 410 FLR_CT26_StationaryCounter 3;
BA_ "Description" SG_ 410 FLR_CT26_Type "Tracked object type classification";
BA_ "UserSigValidity" SG_ 410 FLR_CT26_Type 3;
BA_ "Description" SG_ 410 FLR_CT26_X_Acceleration "X acceleration 

( Movement estimation of object ) ";
BA_ "UserSigValidity" SG_ 410 FLR_CT26_X_Acceleration 3;
BA_ "Description" SG_ 410 FLR_CT26_X_Velocity "Absolute X velocity

( Movement estimation of object ) ";
BA_ "UserSigValidity" SG_ 410 FLR_CT26_X_Velocity 3;
BA_ "Description" SG_ 410 FLR_CT26_X_VelocityStdDev "Standard deviation of X velocity

( Movement estimation of object ) ";
BA_ "UserSigValidity" SG_ 410 FLR_CT26_X_VelocityStdDev 3;
BA_ "Description" SG_ 410 FLR_CT26_Y_Acceleration "Y acceleration 

( Movement estimation of object ) ";
BA_ "UserSigValidity" SG_ 410 FLR_CT26_Y_Acceleration 3;
BA_ "Description" SG_ 410 FLR_CT26_Y_Velocity "Absolute Y velocity

( Movement estimation of object ) ";
BA_ "UserSigValidity" SG_ 410 FLR_CT26_Y_Velocity 3;
BA_ "Description" SG_ 410 FLR_CT26_Y_VelocityStdDev "Standard deviation of Y velocity

( Movement estimation of object ) ";
BA_ "UserSigValidity" SG_ 410 FLR_CT26_Y_VelocityStdDev 3;
BA_ "Description" SG_ 411 FLR_CT27_CrcVal "The CRC checking process calculates the CRC over the entire data block, including the CRC result.

- CRC Polynomial (0x1021) , Initial Value : 0xFFFF, XOR value : 0x0000

- The mathematical expression to 16 bit CRC polynomial is given here. G(x) = x16 + ";
BA_ "GenSigStartValue" SG_ 411 FLR_CT27_CrcVal 65535;
BA_ "UserSigValidity" SG_ 411 FLR_CT27_CrcVal 3;
BA_ "Description" SG_ 411 FLR_CT27_AlvCntVal "[Alive counter] For the first transmission request for a data element the counter shall be initialized with 0 and shall be incremented by 1

for every subsequent send request. When the counter reaches the maximum value(0xFF), then it shall restart with â";
BA_ "UserSigValidity" SG_ 411 FLR_CT27_AlvCntVal 3;
BA_ "Description" SG_ 411 FLR_CT27_ListIndex "List index of cluster track";
BA_ "UserSigValidity" SG_ 411 FLR_CT27_ListIndex 3;
BA_ "Description" SG_ 411 FLR_CT27_SequenceCounter "[TimeSync]Sequence counter for checking the validity of message flow sequence";
BA_ "UserSigValidity" SG_ 411 FLR_CT27_SequenceCounter 3;
BA_ "Description" SG_ 411 FLR_CT27_TimeStamp "[TimeSync]System time, synchronized through AUTOSAR TimeSync";
BA_ "UserSigValidity" SG_ 411 FLR_CT27_TimeStamp 3;
BA_ "Description" SG_ 411 FLR_CT27_Latency "[TimeSync]Sensor latency from object capture scene to object transmission";
BA_ "UserSigValidity" SG_ 411 FLR_CT27_Latency 3;
BA_ "Description" SG_ 411 FLR_CT27_ClosestPointX "Kalman filtered closest point

X position ";
BA_ "UserSigValidity" SG_ 411 FLR_CT27_ClosestPointX 3;
BA_ "Description" SG_ 411 FLR_CT27_ClosestPointXStdDev "Standard deviation of X";
BA_ "UserSigValidity" SG_ 411 FLR_CT27_ClosestPointXStdDev 3;
BA_ "Description" SG_ 411 FLR_CT27_ClosestPointY "Kalman filtered closest point

Y position ";
BA_ "UserSigValidity" SG_ 411 FLR_CT27_ClosestPointY 3;
BA_ "Description" SG_ 411 FLR_CT27_ClosestPointYStdDev "Standard deviation of Y";
BA_ "UserSigValidity" SG_ 411 FLR_CT27_ClosestPointYStdDev 3;
BA_ "Description" SG_ 411 FLR_CT27_Confidence "Object confidence used in quality manager to provide 'Objektgate' (i.e. object quality) tracked object confidence is calculated based on the normalized difference of closest detection to the track's calculated closest point, for range, angle and velocity";
BA_ "UserSigValidity" SG_ 411 FLR_CT27_Confidence 3;
BA_ "Description" SG_ 411 FLR_CT27_Elevation "Elevation of the object";
BA_ "UserSigValidity" SG_ 411 FLR_CT27_Elevation 3;
BA_ "Description" SG_ 411 FLR_CT27_ElevationConfidence "Confidence the elevation classification is correct";
BA_ "UserSigValidity" SG_ 411 FLR_CT27_ElevationConfidence 3;
BA_ "Description" SG_ 411 FLR_CT27_ExistanceProbability "Confidence tracked object existence. Currently set to the association rate [0..100] over the last 6 cycles";
BA_ "UserSigValidity" SG_ 411 FLR_CT27_ExistanceProbability 3;
BA_ "Description" SG_ 411 FLR_CT27_Lifetime "Number of cycles the target has been alive. Unknown 0

Tops out at about 6 minutes of continuous tracking.";
BA_ "UserSigValidity" SG_ 411 FLR_CT27_Lifetime 3;
BA_ "Description" SG_ 411 FLR_CT27_ModelBoxHeading "Heading of object

( Box model describing the object )";
BA_ "UserSigValidity" SG_ 411 FLR_CT27_ModelBoxHeading 3;
BA_ "Description" SG_ 411 FLR_CT27_ModelBoxLength "Length of the object

( Box model describing the object )";
BA_ "UserSigValidity" SG_ 411 FLR_CT27_ModelBoxLength 3;
BA_ "Description" SG_ 411 FLR_CT27_ModelBoxWidth "Width of the object

( Box model describing the object )";
BA_ "UserSigValidity" SG_ 411 FLR_CT27_ModelBoxWidth 3;
BA_ "Description" SG_ 411 FLR_CT27_ModelBoxX "X position, center of box

( Box model describing the object )";
BA_ "UserSigValidity" SG_ 411 FLR_CT27_ModelBoxX 3;
BA_ "Description" SG_ 411 FLR_CT27_ModelBoxY "Y position, center of box

( Box model describing the object )";
BA_ "UserSigValidity" SG_ 411 FLR_CT27_ModelBoxY 3;
BA_ "Description" SG_ 411 FLR_CT27_MotionClass "Tracked object motion classification";
BA_ "UserSigValidity" SG_ 411 FLR_CT27_MotionClass 3;
BA_ "Description" SG_ 411 FLR_CT27_ObjectId "A global ID, which is constant as long as the object is tracked. Note! A value of 0 indicates 'no object'";
BA_ "UserSigValidity" SG_ 411 FLR_CT27_ObjectId 3;
BA_ "Description" SG_ 411 FLR_CT27_ObservationHistory "Observation history of tracked object in as 32 bit-field for the last 32 cycles; for each bit: 1 = associated, 0 = not associated; LSB = most recent cycle, MSB = oldest cycle";
BA_ "UserSigValidity" SG_ 411 FLR_CT27_ObservationHistory 3;
BA_ "Description" SG_ 411 FLR_CT27_QualityBits "Bitmask for quality values described by ClusterTrackQualityBits";
BA_ "UserSigValidity" SG_ 411 FLR_CT27_QualityBits 3;
BA_ "Description" SG_ 411 FLR_CT27_StationaryCounter "Counts the cycles during which the object is ground stationary (i.e. absolute velocity over ground = 0)";
BA_ "UserSigValidity" SG_ 411 FLR_CT27_StationaryCounter 3;
BA_ "Description" SG_ 411 FLR_CT27_Type "Tracked object type classification";
BA_ "UserSigValidity" SG_ 411 FLR_CT27_Type 3;
BA_ "Description" SG_ 411 FLR_CT27_X_Acceleration "X acceleration 

( Movement estimation of object ) ";
BA_ "UserSigValidity" SG_ 411 FLR_CT27_X_Acceleration 3;
BA_ "Description" SG_ 411 FLR_CT27_X_Velocity "Absolute X velocity

( Movement estimation of object ) ";
BA_ "UserSigValidity" SG_ 411 FLR_CT27_X_Velocity 3;
BA_ "Description" SG_ 411 FLR_CT27_X_VelocityStdDev "Standard deviation of X velocity

( Movement estimation of object ) ";
BA_ "UserSigValidity" SG_ 411 FLR_CT27_X_VelocityStdDev 3;
BA_ "Description" SG_ 411 FLR_CT27_Y_Acceleration "Y acceleration 

( Movement estimation of object ) ";
BA_ "UserSigValidity" SG_ 411 FLR_CT27_Y_Acceleration 3;
BA_ "Description" SG_ 411 FLR_CT27_Y_Velocity "Absolute Y velocity

( Movement estimation of object ) ";
BA_ "UserSigValidity" SG_ 411 FLR_CT27_Y_Velocity 3;
BA_ "Description" SG_ 411 FLR_CT27_Y_VelocityStdDev "Standard deviation of Y velocity

( Movement estimation of object ) ";
BA_ "UserSigValidity" SG_ 411 FLR_CT27_Y_VelocityStdDev 3;
BA_ "Description" SG_ 412 FLR_CT28_CrcVal "The CRC checking process calculates the CRC over the entire data block, including the CRC result.

- CRC Polynomial (0x1021) , Initial Value : 0xFFFF, XOR value : 0x0000

- The mathematical expression to 16 bit CRC polynomial is given here. G(x) = x16 + ";
BA_ "GenSigStartValue" SG_ 412 FLR_CT28_CrcVal 65535;
BA_ "UserSigValidity" SG_ 412 FLR_CT28_CrcVal 3;
BA_ "Description" SG_ 412 FLR_CT28_AlvCntVal "[Alive counter] For the first transmission request for a data element the counter shall be initialized with 0 and shall be incremented by 1

for every subsequent send request. When the counter reaches the maximum value(0xFF), then it shall restart with â";
BA_ "UserSigValidity" SG_ 412 FLR_CT28_AlvCntVal 3;
BA_ "Description" SG_ 412 FLR_CT28_ListIndex "List index of cluster track";
BA_ "UserSigValidity" SG_ 412 FLR_CT28_ListIndex 3;
BA_ "Description" SG_ 412 FLR_CT28_SequenceCounter "[TimeSync]Sequence counter for checking the validity of message flow sequence";
BA_ "UserSigValidity" SG_ 412 FLR_CT28_SequenceCounter 3;
BA_ "Description" SG_ 412 FLR_CT28_TimeStamp "[TimeSync]System time, synchronized through AUTOSAR TimeSync";
BA_ "UserSigValidity" SG_ 412 FLR_CT28_TimeStamp 3;
BA_ "Description" SG_ 412 FLR_CT28_Latency "[TimeSync]Sensor latency from object capture scene to object transmission";
BA_ "UserSigValidity" SG_ 412 FLR_CT28_Latency 3;
BA_ "Description" SG_ 412 FLR_CT28_ClosestPointX "Kalman filtered closest point

X position ";
BA_ "UserSigValidity" SG_ 412 FLR_CT28_ClosestPointX 3;
BA_ "Description" SG_ 412 FLR_CT28_ClosestPointXStdDev "Standard deviation of X";
BA_ "UserSigValidity" SG_ 412 FLR_CT28_ClosestPointXStdDev 3;
BA_ "Description" SG_ 412 FLR_CT28_ClosestPointY "Kalman filtered closest point

Y position ";
BA_ "UserSigValidity" SG_ 412 FLR_CT28_ClosestPointY 3;
BA_ "Description" SG_ 412 FLR_CT28_ClosestPointYStdDev "Standard deviation of Y";
BA_ "UserSigValidity" SG_ 412 FLR_CT28_ClosestPointYStdDev 3;
BA_ "Description" SG_ 412 FLR_CT28_Confidence "Object confidence used in quality manager to provide 'Objektgate' (i.e. object quality) tracked object confidence is calculated based on the normalized difference of closest detection to the track's calculated closest point, for range, angle and velocity";
BA_ "UserSigValidity" SG_ 412 FLR_CT28_Confidence 3;
BA_ "Description" SG_ 412 FLR_CT28_Elevation "Elevation of the object";
BA_ "UserSigValidity" SG_ 412 FLR_CT28_Elevation 3;
BA_ "Description" SG_ 412 FLR_CT28_ElevationConfidence "Confidence the elevation classification is correct";
BA_ "UserSigValidity" SG_ 412 FLR_CT28_ElevationConfidence 3;
BA_ "Description" SG_ 412 FLR_CT28_ExistanceProbability "Confidence tracked object existence. Currently set to the association rate [0..100] over the last 6 cycles";
BA_ "UserSigValidity" SG_ 412 FLR_CT28_ExistanceProbability 3;
BA_ "Description" SG_ 412 FLR_CT28_Lifetime "Number of cycles the target has been alive. Unknown 0

Tops out at about 6 minutes of continuous tracking.";
BA_ "UserSigValidity" SG_ 412 FLR_CT28_Lifetime 3;
BA_ "Description" SG_ 412 FLR_CT28_ModelBoxHeading "Heading of object

( Box model describing the object )";
BA_ "UserSigValidity" SG_ 412 FLR_CT28_ModelBoxHeading 3;
BA_ "Description" SG_ 412 FLR_CT28_ModelBoxLength "Length of the object

( Box model describing the object )";
BA_ "UserSigValidity" SG_ 412 FLR_CT28_ModelBoxLength 3;
BA_ "Description" SG_ 412 FLR_CT28_ModelBoxWidth "Width of the object

( Box model describing the object )";
BA_ "UserSigValidity" SG_ 412 FLR_CT28_ModelBoxWidth 3;
BA_ "Description" SG_ 412 FLR_CT28_ModelBoxX "X position, center of box

( Box model describing the object )";
BA_ "UserSigValidity" SG_ 412 FLR_CT28_ModelBoxX 3;
BA_ "Description" SG_ 412 FLR_CT28_ModelBoxY "Y position, center of box

( Box model describing the object )";
BA_ "UserSigValidity" SG_ 412 FLR_CT28_ModelBoxY 3;
BA_ "Description" SG_ 412 FLR_CT28_MotionClass "Tracked object motion classification";
BA_ "UserSigValidity" SG_ 412 FLR_CT28_MotionClass 3;
BA_ "Description" SG_ 412 FLR_CT28_ObjectId "A global ID, which is constant as long as the object is tracked. Note! A value of 0 indicates 'no object'";
BA_ "UserSigValidity" SG_ 412 FLR_CT28_ObjectId 3;
BA_ "Description" SG_ 412 FLR_CT28_ObservationHistory "Observation history of tracked object in as 32 bit-field for the last 32 cycles; for each bit: 1 = associated, 0 = not associated; LSB = most recent cycle, MSB = oldest cycle";
BA_ "UserSigValidity" SG_ 412 FLR_CT28_ObservationHistory 3;
BA_ "Description" SG_ 412 FLR_CT28_QualityBits "Bitmask for quality values described by ClusterTrackQualityBits";
BA_ "UserSigValidity" SG_ 412 FLR_CT28_QualityBits 3;
BA_ "Description" SG_ 412 FLR_CT28_StationaryCounter "Counts the cycles during which the object is ground stationary (i.e. absolute velocity over ground = 0)";
BA_ "UserSigValidity" SG_ 412 FLR_CT28_StationaryCounter 3;
BA_ "Description" SG_ 412 FLR_CT28_Type "Tracked object type classification";
BA_ "UserSigValidity" SG_ 412 FLR_CT28_Type 3;
BA_ "Description" SG_ 412 FLR_CT28_X_Acceleration "X acceleration 

( Movement estimation of object ) ";
BA_ "UserSigValidity" SG_ 412 FLR_CT28_X_Acceleration 3;
BA_ "Description" SG_ 412 FLR_CT28_X_Velocity "Absolute X velocity

( Movement estimation of object ) ";
BA_ "UserSigValidity" SG_ 412 FLR_CT28_X_Velocity 3;
BA_ "Description" SG_ 412 FLR_CT28_X_VelocityStdDev "Standard deviation of X velocity

( Movement estimation of object ) ";
BA_ "UserSigValidity" SG_ 412 FLR_CT28_X_VelocityStdDev 3;
BA_ "Description" SG_ 412 FLR_CT28_Y_Acceleration "Y acceleration 

( Movement estimation of object ) ";
BA_ "UserSigValidity" SG_ 412 FLR_CT28_Y_Acceleration 3;
BA_ "Description" SG_ 412 FLR_CT28_Y_Velocity "Absolute Y velocity

( Movement estimation of object ) ";
BA_ "UserSigValidity" SG_ 412 FLR_CT28_Y_Velocity 3;
BA_ "Description" SG_ 412 FLR_CT28_Y_VelocityStdDev "Standard deviation of Y velocity

( Movement estimation of object ) ";
BA_ "UserSigValidity" SG_ 412 FLR_CT28_Y_VelocityStdDev 3;
BA_ "Description" SG_ 413 FLR_CT29_CrcVal "The CRC checking process calculates the CRC over the entire data block, including the CRC result.

- CRC Polynomial (0x1021) , Initial Value : 0xFFFF, XOR value : 0x0000

- The mathematical expression to 16 bit CRC polynomial is given here. G(x) = x16 + ";
BA_ "GenSigStartValue" SG_ 413 FLR_CT29_CrcVal 65535;
BA_ "UserSigValidity" SG_ 413 FLR_CT29_CrcVal 3;
BA_ "Description" SG_ 413 FLR_CT29_AlvCntVal "[Alive counter] For the first transmission request for a data element the counter shall be initialized with 0 and shall be incremented by 1

for every subsequent send request. When the counter reaches the maximum value(0xFF), then it shall restart with â";
BA_ "UserSigValidity" SG_ 413 FLR_CT29_AlvCntVal 3;
BA_ "Description" SG_ 413 FLR_CT29_ListIndex "List index of cluster track";
BA_ "UserSigValidity" SG_ 413 FLR_CT29_ListIndex 3;
BA_ "Description" SG_ 413 FLR_CT29_SequenceCounter "[TimeSync]Sequence counter for checking the validity of message flow sequence";
BA_ "UserSigValidity" SG_ 413 FLR_CT29_SequenceCounter 3;
BA_ "Description" SG_ 413 FLR_CT29_TimeStamp "[TimeSync]System time, synchronized through AUTOSAR TimeSync";
BA_ "UserSigValidity" SG_ 413 FLR_CT29_TimeStamp 3;
BA_ "Description" SG_ 413 FLR_CT29_Latency "[TimeSync]Sensor latency from object capture scene to object transmission";
BA_ "UserSigValidity" SG_ 413 FLR_CT29_Latency 3;
BA_ "Description" SG_ 413 FLR_CT29_ClosestPointX "Kalman filtered closest point

X position ";
BA_ "UserSigValidity" SG_ 413 FLR_CT29_ClosestPointX 3;
BA_ "Description" SG_ 413 FLR_CT29_ClosestPointXStdDev "Standard deviation of X";
BA_ "UserSigValidity" SG_ 413 FLR_CT29_ClosestPointXStdDev 3;
BA_ "Description" SG_ 413 FLR_CT29_ClosestPointY "Kalman filtered closest point

Y position ";
BA_ "UserSigValidity" SG_ 413 FLR_CT29_ClosestPointY 3;
BA_ "Description" SG_ 413 FLR_CT29_ClosestPointYStdDev "Standard deviation of Y";
BA_ "UserSigValidity" SG_ 413 FLR_CT29_ClosestPointYStdDev 3;
BA_ "Description" SG_ 413 FLR_CT29_Confidence "Object confidence used in quality manager to provide 'Objektgate' (i.e. object quality) tracked object confidence is calculated based on the normalized difference of closest detection to the track's calculated closest point, for range, angle and velocity";
BA_ "UserSigValidity" SG_ 413 FLR_CT29_Confidence 3;
BA_ "Description" SG_ 413 FLR_CT29_Elevation "Elevation of the object";
BA_ "UserSigValidity" SG_ 413 FLR_CT29_Elevation 3;
BA_ "Description" SG_ 413 FLR_CT29_ElevationConfidence "Confidence the elevation classification is correct";
BA_ "UserSigValidity" SG_ 413 FLR_CT29_ElevationConfidence 3;
BA_ "Description" SG_ 413 FLR_CT29_ExistanceProbability "Confidence tracked object existence. Currently set to the association rate [0..100] over the last 6 cycles";
BA_ "UserSigValidity" SG_ 413 FLR_CT29_ExistanceProbability 3;
BA_ "Description" SG_ 413 FLR_CT29_Lifetime "Number of cycles the target has been alive. Unknown 0

Tops out at about 6 minutes of continuous tracking.";
BA_ "UserSigValidity" SG_ 413 FLR_CT29_Lifetime 3;
BA_ "Description" SG_ 413 FLR_CT29_ModelBoxHeading "Heading of object

( Box model describing the object )";
BA_ "UserSigValidity" SG_ 413 FLR_CT29_ModelBoxHeading 3;
BA_ "Description" SG_ 413 FLR_CT29_ModelBoxLength "Length of the object

( Box model describing the object )";
BA_ "UserSigValidity" SG_ 413 FLR_CT29_ModelBoxLength 3;
BA_ "Description" SG_ 413 FLR_CT29_ModelBoxWidth "Width of the object

( Box model describing the object )";
BA_ "UserSigValidity" SG_ 413 FLR_CT29_ModelBoxWidth 3;
BA_ "Description" SG_ 413 FLR_CT29_ModelBoxX "X position, center of box

( Box model describing the object )";
BA_ "UserSigValidity" SG_ 413 FLR_CT29_ModelBoxX 3;
BA_ "Description" SG_ 413 FLR_CT29_ModelBoxY "Y position, center of box

( Box model describing the object )";
BA_ "UserSigValidity" SG_ 413 FLR_CT29_ModelBoxY 3;
BA_ "Description" SG_ 413 FLR_CT29_MotionClass "Tracked object motion classification";
BA_ "UserSigValidity" SG_ 413 FLR_CT29_MotionClass 3;
BA_ "Description" SG_ 413 FLR_CT29_ObjectId "A global ID, which is constant as long as the object is tracked. Note! A value of 0 indicates 'no object'";
BA_ "UserSigValidity" SG_ 413 FLR_CT29_ObjectId 3;
BA_ "Description" SG_ 413 FLR_CT29_ObservationHistory "Observation history of tracked object in as 32 bit-field for the last 32 cycles; for each bit: 1 = associated, 0 = not associated; LSB = most recent cycle, MSB = oldest cycle";
BA_ "UserSigValidity" SG_ 413 FLR_CT29_ObservationHistory 3;
BA_ "Description" SG_ 413 FLR_CT29_QualityBits "Bitmask for quality values described by ClusterTrackQualityBits";
BA_ "UserSigValidity" SG_ 413 FLR_CT29_QualityBits 3;
BA_ "Description" SG_ 413 FLR_CT29_StationaryCounter "Counts the cycles during which the object is ground stationary (i.e. absolute velocity over ground = 0)";
BA_ "UserSigValidity" SG_ 413 FLR_CT29_StationaryCounter 3;
BA_ "Description" SG_ 413 FLR_CT29_Type "Tracked object type classification";
BA_ "UserSigValidity" SG_ 413 FLR_CT29_Type 3;
BA_ "Description" SG_ 413 FLR_CT29_X_Acceleration "X acceleration 

( Movement estimation of object ) ";
BA_ "UserSigValidity" SG_ 413 FLR_CT29_X_Acceleration 3;
BA_ "Description" SG_ 413 FLR_CT29_X_Velocity "Absolute X velocity

( Movement estimation of object ) ";
BA_ "UserSigValidity" SG_ 413 FLR_CT29_X_Velocity 3;
BA_ "Description" SG_ 413 FLR_CT29_X_VelocityStdDev "Standard deviation of X velocity

( Movement estimation of object ) ";
BA_ "UserSigValidity" SG_ 413 FLR_CT29_X_VelocityStdDev 3;
BA_ "Description" SG_ 413 FLR_CT29_Y_Acceleration "Y acceleration 

( Movement estimation of object ) ";
BA_ "UserSigValidity" SG_ 413 FLR_CT29_Y_Acceleration 3;
BA_ "Description" SG_ 413 FLR_CT29_Y_Velocity "Absolute Y velocity

( Movement estimation of object ) ";
BA_ "UserSigValidity" SG_ 413 FLR_CT29_Y_Velocity 3;
BA_ "Description" SG_ 413 FLR_CT29_Y_VelocityStdDev "Standard deviation of Y velocity

( Movement estimation of object ) ";
BA_ "UserSigValidity" SG_ 413 FLR_CT29_Y_VelocityStdDev 3;
BA_ "Description" SG_ 448 FLR_ST0_CrcVal "The CRC checking process calculates the CRC over the entire data block, including the CRC result.

- CRC Polynomial (0x1021) , Initial Value : 0xFFFF, XOR value : 0x0000

- The mathematical expression to 16 bit CRC polynomial is given here. G(x) = x16 + ";
BA_ "GenSigStartValue" SG_ 448 FLR_ST0_CrcVal 65535;
BA_ "UserSigValidity" SG_ 448 FLR_ST0_CrcVal 3;
BA_ "Description" SG_ 448 FLR_ST0_AlvCntVal "[Alive counter] For the first transmission request for a data element the counter shall be initialized with 0 and shall be incremented by 1

for every subsequent send request. When the counter reaches the maximum value(0xFF), then it shall restart with â";
BA_ "UserSigValidity" SG_ 448 FLR_ST0_AlvCntVal 3;
BA_ "Description" SG_ 448 FLR_ST0_Elevation "Elevation Classification from Core Elevation Library";
BA_ "UserSigValidity" SG_ 448 FLR_ST0_Elevation 3;
BA_ "Description" SG_ 448 FLR_ST0_ElevationConfidence "	Elevation Classification Confidence Level from Core Elevation Library";
BA_ "UserSigValidity" SG_ 448 FLR_ST0_ElevationConfidence 3;
BA_ "Description" SG_ 448 FLR_ST0_Lifetime "Number of cycles the target has been alive. Unknown 0";
BA_ "UserSigValidity" SG_ 448 FLR_ST0_Lifetime 3;
BA_ "Description" SG_ 448 FLR_ST0_ObjectId "A global ID, which is constant as long as the object is tracked. Note! A value of 0 indicates 'no object'";
BA_ "UserSigValidity" SG_ 448 FLR_ST0_ObjectId 3;
BA_ "Description" SG_ 448 FLR_ST0_PositionX "Filtered X position";
BA_ "UserSigValidity" SG_ 448 FLR_ST0_PositionX 3;
BA_ "Description" SG_ 448 FLR_ST0_PositionY "Filtered Y position";
BA_ "UserSigValidity" SG_ 448 FLR_ST0_PositionY 3;
BA_ "Description" SG_ 448 FLR_ST0_PredictionCounter "Number of cycles the target has been predicted";
BA_ "UserSigValidity" SG_ 448 FLR_ST0_PredictionCounter 3;
BA_ "Description" SG_ 448 FLR_ST0_PropertyBits "Bitmask for property values described by StationaryTrackPropertyBits";
BA_ "UserSigValidity" SG_ 448 FLR_ST0_PropertyBits 3;
BA_ "Description" SG_ 448 FLR_ST0_Quality "Track quality";
BA_ "UserSigValidity" SG_ 448 FLR_ST0_Quality 3;
BA_ "Description" SG_ 448 FLR_ST0_X_Velocity "Filtered absolute longitudinal velocity";
BA_ "UserSigValidity" SG_ 448 FLR_ST0_X_Velocity 3;
BA_ "Description" SG_ 448 FLR_ST0_Y_Velocity "Filtered absolute lateral velocity";
BA_ "UserSigValidity" SG_ 448 FLR_ST0_Y_Velocity 3;
BA_ "Description" SG_ 449 FLR_ST1_CrcVal "The CRC checking process calculates the CRC over the entire data block, including the CRC result.

- CRC Polynomial (0x1021) , Initial Value : 0xFFFF, XOR value : 0x0000

- The mathematical expression to 16 bit CRC polynomial is given here. G(x) = x16 + ";
BA_ "GenSigStartValue" SG_ 449 FLR_ST1_CrcVal 65535;
BA_ "UserSigValidity" SG_ 449 FLR_ST1_CrcVal 3;
BA_ "Description" SG_ 449 FLR_ST1_AlvCntVal "[Alive counter] For the first transmission request for a data element the counter shall be initialized with 0 and shall be incremented by 1

for every subsequent send request. When the counter reaches the maximum value(0xFF), then it shall restart with â";
BA_ "UserSigValidity" SG_ 449 FLR_ST1_AlvCntVal 3;
BA_ "Description" SG_ 449 FLR_ST1_Elevation "Elevation Classification from Core Elevation Library";
BA_ "UserSigValidity" SG_ 449 FLR_ST1_Elevation 3;
BA_ "Description" SG_ 449 FLR_ST1_ElevationConfidence "	Elevation Classification Confidence Level from Core Elevation Library";
BA_ "UserSigValidity" SG_ 449 FLR_ST1_ElevationConfidence 3;
BA_ "Description" SG_ 449 FLR_ST1_Lifetime "Number of cycles the target has been alive. Unknown 0";
BA_ "UserSigValidity" SG_ 449 FLR_ST1_Lifetime 3;
BA_ "Description" SG_ 449 FLR_ST1_ObjectId "A global ID, which is constant as long as the object is tracked. Note! A value of 0 indicates 'no object'";
BA_ "UserSigValidity" SG_ 449 FLR_ST1_ObjectId 3;
BA_ "Description" SG_ 449 FLR_ST1_PositionX "Filtered X position";
BA_ "UserSigValidity" SG_ 449 FLR_ST1_PositionX 3;
BA_ "Description" SG_ 449 FLR_ST1_PositionY "Filtered Y position";
BA_ "UserSigValidity" SG_ 449 FLR_ST1_PositionY 3;
BA_ "Description" SG_ 449 FLR_ST1_PredictionCounter "Number of cycles the target has been predicted";
BA_ "UserSigValidity" SG_ 449 FLR_ST1_PredictionCounter 3;
BA_ "Description" SG_ 449 FLR_ST1_PropertyBits "Bitmask for property values described by StationaryTrackPropertyBits";
BA_ "UserSigValidity" SG_ 449 FLR_ST1_PropertyBits 3;
BA_ "Description" SG_ 449 FLR_ST1_Quality "Track quality";
BA_ "UserSigValidity" SG_ 449 FLR_ST1_Quality 3;
BA_ "Description" SG_ 449 FLR_ST1_X_Velocity "Filtered absolute longitudinal velocity";
BA_ "UserSigValidity" SG_ 449 FLR_ST1_X_Velocity 3;
BA_ "Description" SG_ 449 FLR_ST1_Y_Velocity "Filtered absolute lateral velocity";
BA_ "UserSigValidity" SG_ 449 FLR_ST1_Y_Velocity 3;
BA_ "Description" SG_ 450 FLR_ST2_CrcVal "The CRC checking process calculates the CRC over the entire data block, including the CRC result.

- CRC Polynomial (0x1021) , Initial Value : 0xFFFF, XOR value : 0x0000

- The mathematical expression to 16 bit CRC polynomial is given here. G(x) = x16 + ";
BA_ "GenSigStartValue" SG_ 450 FLR_ST2_CrcVal 65535;
BA_ "UserSigValidity" SG_ 450 FLR_ST2_CrcVal 3;
BA_ "Description" SG_ 450 FLR_ST2_AlvCntVal "[Alive counter] For the first transmission request for a data element the counter shall be initialized with 0 and shall be incremented by 1

for every subsequent send request. When the counter reaches the maximum value(0xFF), then it shall restart with â";
BA_ "UserSigValidity" SG_ 450 FLR_ST2_AlvCntVal 3;
BA_ "Description" SG_ 450 FLR_ST2_Elevation "Elevation Classification from Core Elevation Library";
BA_ "UserSigValidity" SG_ 450 FLR_ST2_Elevation 3;
BA_ "Description" SG_ 450 FLR_ST2_ElevationConfidence "	Elevation Classification Confidence Level from Core Elevation Library";
BA_ "UserSigValidity" SG_ 450 FLR_ST2_ElevationConfidence 3;
BA_ "Description" SG_ 450 FLR_ST2_Lifetime "Number of cycles the target has been alive. Unknown 0";
BA_ "UserSigValidity" SG_ 450 FLR_ST2_Lifetime 3;
BA_ "Description" SG_ 450 FLR_ST2_ObjectId "A global ID, which is constant as long as the object is tracked. Note! A value of 0 indicates 'no object'";
BA_ "UserSigValidity" SG_ 450 FLR_ST2_ObjectId 3;
BA_ "Description" SG_ 450 FLR_ST2_PositionX "Filtered X position";
BA_ "UserSigValidity" SG_ 450 FLR_ST2_PositionX 3;
BA_ "Description" SG_ 450 FLR_ST2_PositionY "Filtered Y position";
BA_ "UserSigValidity" SG_ 450 FLR_ST2_PositionY 3;
BA_ "Description" SG_ 450 FLR_ST2_PredictionCounter "Number of cycles the target has been predicted";
BA_ "UserSigValidity" SG_ 450 FLR_ST2_PredictionCounter 3;
BA_ "Description" SG_ 450 FLR_ST2_PropertyBits "Bitmask for property values described by StationaryTrackPropertyBits";
BA_ "UserSigValidity" SG_ 450 FLR_ST2_PropertyBits 3;
BA_ "Description" SG_ 450 FLR_ST2_Quality "Track quality";
BA_ "UserSigValidity" SG_ 450 FLR_ST2_Quality 3;
BA_ "Description" SG_ 450 FLR_ST2_X_Velocity "Filtered absolute longitudinal velocity";
BA_ "UserSigValidity" SG_ 450 FLR_ST2_X_Velocity 3;
BA_ "Description" SG_ 450 FLR_ST2_Y_Velocity "Filtered absolute lateral velocity";
BA_ "UserSigValidity" SG_ 450 FLR_ST2_Y_Velocity 3;
BA_ "Description" SG_ 451 FLR_ST3_CrcVal "The CRC checking process calculates the CRC over the entire data block, including the CRC result.

- CRC Polynomial (0x1021) , Initial Value : 0xFFFF, XOR value : 0x0000

- The mathematical expression to 16 bit CRC polynomial is given here. G(x) = x16 + ";
BA_ "GenSigStartValue" SG_ 451 FLR_ST3_CrcVal 65535;
BA_ "UserSigValidity" SG_ 451 FLR_ST3_CrcVal 3;
BA_ "Description" SG_ 451 FLR_ST3_AlvCntVal "[Alive counter] For the first transmission request for a data element the counter shall be initialized with 0 and shall be incremented by 1

for every subsequent send request. When the counter reaches the maximum value(0xFF), then it shall restart with â";
BA_ "UserSigValidity" SG_ 451 FLR_ST3_AlvCntVal 3;
BA_ "Description" SG_ 451 FLR_ST3_Elevation "Elevation Classification from Core Elevation Library";
BA_ "UserSigValidity" SG_ 451 FLR_ST3_Elevation 3;
BA_ "Description" SG_ 451 FLR_ST3_ElevationConfidence "	Elevation Classification Confidence Level from Core Elevation Library";
BA_ "UserSigValidity" SG_ 451 FLR_ST3_ElevationConfidence 3;
BA_ "Description" SG_ 451 FLR_ST3_Lifetime "Number of cycles the target has been alive. Unknown 0";
BA_ "UserSigValidity" SG_ 451 FLR_ST3_Lifetime 3;
BA_ "Description" SG_ 451 FLR_ST3_ObjectId "A global ID, which is constant as long as the object is tracked. Note! A value of 0 indicates 'no object'";
BA_ "UserSigValidity" SG_ 451 FLR_ST3_ObjectId 3;
BA_ "Description" SG_ 451 FLR_ST3_PositionX "Filtered X position";
BA_ "UserSigValidity" SG_ 451 FLR_ST3_PositionX 3;
BA_ "Description" SG_ 451 FLR_ST3_PositionY "Filtered Y position";
BA_ "UserSigValidity" SG_ 451 FLR_ST3_PositionY 3;
BA_ "Description" SG_ 451 FLR_ST3_PredictionCounter "Number of cycles the target has been predicted";
BA_ "UserSigValidity" SG_ 451 FLR_ST3_PredictionCounter 3;
BA_ "Description" SG_ 451 FLR_ST3_PropertyBits "Bitmask for property values described by StationaryTrackPropertyBits";
BA_ "UserSigValidity" SG_ 451 FLR_ST3_PropertyBits 3;
BA_ "Description" SG_ 451 FLR_ST3_Quality "Track quality";
BA_ "UserSigValidity" SG_ 451 FLR_ST3_Quality 3;
BA_ "Description" SG_ 451 FLR_ST3_X_Velocity "Filtered absolute longitudinal velocity";
BA_ "UserSigValidity" SG_ 451 FLR_ST3_X_Velocity 3;
BA_ "Description" SG_ 451 FLR_ST3_Y_Velocity "Filtered absolute lateral velocity";
BA_ "UserSigValidity" SG_ 451 FLR_ST3_Y_Velocity 3;
VAL_ 400 FLR_CT16_Confidence 0 " Unknown" 1 " LoConfidence" 2 " MedConfidence" 3 " HiConfidence" ;
VAL_ 400 FLR_CT16_Elevation 0 " Unknown" 1 " Overridable" 2 " Relevant" 3 " Underridable" ;
VAL_ 400 FLR_CT16_ElevationConfidence 0 " Unknown" 1 " LoConfidence" 2 " MedConfidence" 3 " HiConfidence" ;
VAL_ 400 FLR_CT16_MotionClass 0 " Unknown" 1 " Stationary" 2 " Moving" 3 " Stopped" ;
VAL_ 400 FLR_CT16_QualityBits 0 " Sliding" 1 " Fused" 2 " ConfirmedByRspTracker" 3 " InsideFreespace" 4 " OutsideStationaryCloud" 5 " InsideRearBorder" 6 " AssociatedWithGoodDetection" 7 " Ghost" 8 " MirrorGhost" 9 " EgoMirrorGhost" 10 " GhostFromTrackGuardrail" 11 " OutsideFreespaceGhost" 12 " RoofGhost" 13 " TunnelMirrorGhost" 14 " CompanionGhost" 15 " AngleJumpCoasting" 16 " Occluded" 17 " GoodQuality" ;
VAL_ 400 FLR_CT16_Type 0 " Unknown" 1 " Car" 2 " Bicycle" 3 " Pedestrian" 4 " Motorcycle" 5 " Truck" 6 " Animal" 7 " Group2Pedestrians" 8 " GroupMultiplePedestrians" ;
VAL_ 401 FLR_CT17_Confidence 0 " Unknown" 1 " LoConfidence" 2 " MedConfidence" 3 " HiConfidence" ;
VAL_ 401 FLR_CT17_Elevation 0 " Unknown" 1 " Overridable" 2 " Relevant" 3 " Underridable" ;
VAL_ 401 FLR_CT17_ElevationConfidence 0 " Unknown" 1 " LoConfidence" 2 " MedConfidence" 3 " HiConfidence" ;
VAL_ 401 FLR_CT17_MotionClass 0 " Unknown" 1 " Stationary" 2 " Moving" 3 " Stopped" ;
VAL_ 401 FLR_CT17_QualityBits 0 " Sliding" 1 " Fused" 2 " ConfirmedByRspTracker" 3 " InsideFreespace" 4 " OutsideStationaryCloud" 5 " InsideRearBorder" 6 " AssociatedWithGoodDetection" 7 " Ghost" 8 " MirrorGhost" 9 " EgoMirrorGhost" 10 " GhostFromTrackGuardrail" 11 " OutsideFreespaceGhost" 12 " RoofGhost" 13 " TunnelMirrorGhost" 14 " CompanionGhost" 15 " AngleJumpCoasting" 16 " Occluded" 17 " GoodQuality" ;
VAL_ 401 FLR_CT17_Type 0 " Unknown" 1 " Car" 2 " Bicycle" 3 " Pedestrian" 4 " Motorcycle" 5 " Truck" 6 " Animal" 7 " Group2Pedestrians" 8 " GroupMultiplePedestrians" ;
VAL_ 402 FLR_CT18_Confidence 0 " Unknown" 1 " LoConfidence" 2 " MedConfidence" 3 " HiConfidence" ;
VAL_ 402 FLR_CT18_Elevation 0 " Unknown" 1 " Overridable" 2 " Relevant" 3 " Underridable" ;
VAL_ 402 FLR_CT18_ElevationConfidence 0 " Unknown" 1 " LoConfidence" 2 " MedConfidence" 3 " HiConfidence" ;
VAL_ 402 FLR_CT18_MotionClass 0 " Unknown" 1 " Stationary" 2 " Moving" 3 " Stopped" ;
VAL_ 402 FLR_CT18_QualityBits 0 " Sliding" 1 " Fused" 2 " ConfirmedByRspTracker" 3 " InsideFreespace" 4 " OutsideStationaryCloud" 5 " InsideRearBorder" 6 " AssociatedWithGoodDetection" 7 " Ghost" 8 " MirrorGhost" 9 " EgoMirrorGhost" 10 " GhostFromTrackGuardrail" 11 " OutsideFreespaceGhost" 12 " RoofGhost" 13 " TunnelMirrorGhost" 14 " CompanionGhost" 15 " AngleJumpCoasting" 16 " Occluded" 17 " GoodQuality" ;
VAL_ 402 FLR_CT18_Type 0 " Unknown" 1 " Car" 2 " Bicycle" 3 " Pedestrian" 4 " Motorcycle" 5 " Truck" 6 " Animal" 7 " Group2Pedestrians" 8 " GroupMultiplePedestrians" ;
VAL_ 403 FLR_CT19_Confidence 0 " Unknown" 1 " LoConfidence" 2 " MedConfidence" 3 " HiConfidence" ;
VAL_ 403 FLR_CT19_Elevation 0 " Unknown" 1 " Overridable" 2 " Relevant" 3 " Underridable" ;
VAL_ 403 FLR_CT19_ElevationConfidence 0 " Unknown" 1 " LoConfidence" 2 " MedConfidence" 3 " HiConfidence" ;
VAL_ 403 FLR_CT19_MotionClass 0 " Unknown" 1 " Stationary" 2 " Moving" 3 " Stopped" ;
VAL_ 403 FLR_CT19_QualityBits 0 " Sliding" 1 " Fused" 2 " ConfirmedByRspTracker" 3 " InsideFreespace" 4 " OutsideStationaryCloud" 5 " InsideRearBorder" 6 " AssociatedWithGoodDetection" 7 " Ghost" 8 " MirrorGhost" 9 " EgoMirrorGhost" 10 " GhostFromTrackGuardrail" 11 " OutsideFreespaceGhost" 12 " RoofGhost" 13 " TunnelMirrorGhost" 14 " CompanionGhost" 15 " AngleJumpCoasting" 16 " Occluded" 17 " GoodQuality" ;
VAL_ 403 FLR_CT19_Type 0 " Unknown" 1 " Car" 2 " Bicycle" 3 " Pedestrian" 4 " Motorcycle" 5 " Truck" 6 " Animal" 7 " Group2Pedestrians" 8 " GroupMultiplePedestrians" ;
VAL_ 404 FLR_CT20_Confidence 0 " Unknown" 1 " LoConfidence" 2 " MedConfidence" 3 " HiConfidence" ;
VAL_ 404 FLR_CT20_Elevation 0 " Unknown" 1 " Overridable" 2 " Relevant" 3 " Underridable" ;
VAL_ 404 FLR_CT20_ElevationConfidence 0 " Unknown" 1 " LoConfidence" 2 " MedConfidence" 3 " HiConfidence" ;
VAL_ 404 FLR_CT20_MotionClass 0 " Unknown" 1 " Stationary" 2 " Moving" 3 " Stopped" ;
VAL_ 404 FLR_CT20_QualityBits 0 " Sliding" 1 " Fused" 2 " ConfirmedByRspTracker" 3 " InsideFreespace" 4 " OutsideStationaryCloud" 5 " InsideRearBorder" 6 " AssociatedWithGoodDetection" 7 " Ghost" 8 " MirrorGhost" 9 " EgoMirrorGhost" 10 " GhostFromTrackGuardrail" 11 " OutsideFreespaceGhost" 12 " RoofGhost" 13 " TunnelMirrorGhost" 14 " CompanionGhost" 15 " AngleJumpCoasting" 16 " Occluded" 17 " GoodQuality" ;
VAL_ 404 FLR_CT20_Type 0 " Unknown" 1 " Car" 2 " Bicycle" 3 " Pedestrian" 4 " Motorcycle" 5 " Truck" 6 " Animal" 7 " Group2Pedestrians" 8 " GroupMultiplePedestrians" ;
VAL_ 405 FLR_CT21_Confidence 0 " Unknown" 1 " LoConfidence" 2 " MedConfidence" 3 " HiConfidence" ;
VAL_ 405 FLR_CT21_Elevation 0 " Unknown" 1 " Overridable" 2 " Relevant" 3 " Underridable" ;
VAL_ 405 FLR_CT21_ElevationConfidence 0 " Unknown" 1 " LoConfidence" 2 " MedConfidence" 3 " HiConfidence" ;
VAL_ 405 FLR_CT21_MotionClass 0 " Unknown" 1 " Stationary" 2 " Moving" 3 " Stopped" ;
VAL_ 405 FLR_CT21_QualityBits 0 " Sliding" 1 " Fused" 2 " ConfirmedByRspTracker" 3 " InsideFreespace" 4 " OutsideStationaryCloud" 5 " InsideRearBorder" 6 " AssociatedWithGoodDetection" 7 " Ghost" 8 " MirrorGhost" 9 " EgoMirrorGhost" 10 " GhostFromTrackGuardrail" 11 " OutsideFreespaceGhost" 12 " RoofGhost" 13 " TunnelMirrorGhost" 14 " CompanionGhost" 15 " AngleJumpCoasting" 16 " Occluded" 17 " GoodQuality" ;
VAL_ 405 FLR_CT21_Type 0 " Unknown" 1 " Car" 2 " Bicycle" 3 " Pedestrian" 4 " Motorcycle" 5 " Truck" 6 " Animal" 7 " Group2Pedestrians" 8 " GroupMultiplePedestrians" ;
VAL_ 406 FLR_CT22_Confidence 0 " Unknown" 1 " LoConfidence" 2 " MedConfidence" 3 " HiConfidence" ;
VAL_ 406 FLR_CT22_Elevation 0 " Unknown" 1 " Overridable" 2 " Relevant" 3 " Underridable" ;
VAL_ 406 FLR_CT22_ElevationConfidence 0 " Unknown" 1 " LoConfidence" 2 " MedConfidence" 3 " HiConfidence" ;
VAL_ 406 FLR_CT22_MotionClass 0 " Unknown" 1 " Stationary" 2 " Moving" 3 " Stopped" ;
VAL_ 406 FLR_CT22_QualityBits 0 " Sliding" 1 " Fused" 2 " ConfirmedByRspTracker" 3 " InsideFreespace" 4 " OutsideStationaryCloud" 5 " InsideRearBorder" 6 " AssociatedWithGoodDetection" 7 " Ghost" 8 " MirrorGhost" 9 " EgoMirrorGhost" 10 " GhostFromTrackGuardrail" 11 " OutsideFreespaceGhost" 12 " RoofGhost" 13 " TunnelMirrorGhost" 14 " CompanionGhost" 15 " AngleJumpCoasting" 16 " Occluded" 17 " GoodQuality" ;
VAL_ 406 FLR_CT22_Type 0 " Unknown" 1 " Car" 2 " Bicycle" 3 " Pedestrian" 4 " Motorcycle" 5 " Truck" 6 " Animal" 7 " Group2Pedestrians" 8 " GroupMultiplePedestrians" ;
VAL_ 407 FLR_CT23_Confidence 0 " Unknown" 1 " LoConfidence" 2 " MedConfidence" 3 " HiConfidence" ;
VAL_ 407 FLR_CT23_Elevation 0 " Unknown" 1 " Overridable" 2 " Relevant" 3 " Underridable" ;
VAL_ 407 FLR_CT23_ElevationConfidence 0 " Unknown" 1 " LoConfidence" 2 " MedConfidence" 3 " HiConfidence" ;
VAL_ 407 FLR_CT23_MotionClass 0 " Unknown" 1 " Stationary" 2 " Moving" 3 " Stopped" ;
VAL_ 407 FLR_CT23_QualityBits 0 " Sliding" 1 " Fused" 2 " ConfirmedByRspTracker" 3 " InsideFreespace" 4 " OutsideStationaryCloud" 5 " InsideRearBorder" 6 " AssociatedWithGoodDetection" 7 " Ghost" 8 " MirrorGhost" 9 " EgoMirrorGhost" 10 " GhostFromTrackGuardrail" 11 " OutsideFreespaceGhost" 12 " RoofGhost" 13 " TunnelMirrorGhost" 14 " CompanionGhost" 15 " AngleJumpCoasting" 16 " Occluded" 17 " GoodQuality" ;
VAL_ 407 FLR_CT23_Type 0 " Unknown" 1 " Car" 2 " Bicycle" 3 " Pedestrian" 4 " Motorcycle" 5 " Truck" 6 " Animal" 7 " Group2Pedestrians" 8 " GroupMultiplePedestrians" ;
VAL_ 408 FLR_CT24_Confidence 0 " Unknown" 1 " LoConfidence" 2 " MedConfidence" 3 " HiConfidence" ;
VAL_ 408 FLR_CT24_Elevation 0 " Unknown" 1 " Overridable" 2 " Relevant" 3 " Underridable" ;
VAL_ 408 FLR_CT24_ElevationConfidence 0 " Unknown" 1 " LoConfidence" 2 " MedConfidence" 3 " HiConfidence" ;
VAL_ 408 FLR_CT24_MotionClass 0 " Unknown" 1 " Stationary" 2 " Moving" 3 " Stopped" ;
VAL_ 408 FLR_CT24_QualityBits 0 " Sliding" 1 " Fused" 2 " ConfirmedByRspTracker" 3 " InsideFreespace" 4 " OutsideStationaryCloud" 5 " InsideRearBorder" 6 " AssociatedWithGoodDetection" 7 " Ghost" 8 " MirrorGhost" 9 " EgoMirrorGhost" 10 " GhostFromTrackGuardrail" 11 " OutsideFreespaceGhost" 12 " RoofGhost" 13 " TunnelMirrorGhost" 14 " CompanionGhost" 15 " AngleJumpCoasting" 16 " Occluded" 17 " GoodQuality" ;
VAL_ 408 FLR_CT24_Type 0 " Unknown" 1 " Car" 2 " Bicycle" 3 " Pedestrian" 4 " Motorcycle" 5 " Truck" 6 " Animal" 7 " Group2Pedestrians" 8 " GroupMultiplePedestrians" ;
VAL_ 409 FLR_CT25_Confidence 0 " Unknown" 1 " LoConfidence" 2 " MedConfidence" 3 " HiConfidence" ;
VAL_ 409 FLR_CT25_Elevation 0 " Unknown" 1 " Overridable" 2 " Relevant" 3 " Underridable" ;
VAL_ 409 FLR_CT25_ElevationConfidence 0 " Unknown" 1 " LoConfidence" 2 " MedConfidence" 3 " HiConfidence" ;
VAL_ 409 FLR_CT25_MotionClass 0 " Unknown" 1 " Stationary" 2 " Moving" 3 " Stopped" ;
VAL_ 409 FLR_CT25_QualityBits 0 " Sliding" 1 " Fused" 2 " ConfirmedByRspTracker" 3 " InsideFreespace" 4 " OutsideStationaryCloud" 5 " InsideRearBorder" 6 " AssociatedWithGoodDetection" 7 " Ghost" 8 " MirrorGhost" 9 " EgoMirrorGhost" 10 " GhostFromTrackGuardrail" 11 " OutsideFreespaceGhost" 12 " RoofGhost" 13 " TunnelMirrorGhost" 14 " CompanionGhost" 15 " AngleJumpCoasting" 16 " Occluded" 17 " GoodQuality" ;
VAL_ 409 FLR_CT25_Type 0 " Unknown" 1 " Car" 2 " Bicycle" 3 " Pedestrian" 4 " Motorcycle" 5 " Truck" 6 " Animal" 7 " Group2Pedestrians" 8 " GroupMultiplePedestrians" ;
VAL_ 410 FLR_CT26_Confidence 0 " Unknown" 1 " LoConfidence" 2 " MedConfidence" 3 " HiConfidence" ;
VAL_ 410 FLR_CT26_Elevation 0 " Unknown" 1 " Overridable" 2 " Relevant" 3 " Underridable" ;
VAL_ 410 FLR_CT26_ElevationConfidence 0 " Unknown" 1 " LoConfidence" 2 " MedConfidence" 3 " HiConfidence" ;
VAL_ 410 FLR_CT26_MotionClass 0 " Unknown" 1 " Stationary" 2 " Moving" 3 " Stopped" ;
VAL_ 410 FLR_CT26_QualityBits 0 " Sliding" 1 " Fused" 2 " ConfirmedByRspTracker" 3 " InsideFreespace" 4 " OutsideStationaryCloud" 5 " InsideRearBorder" 6 " AssociatedWithGoodDetection" 7 " Ghost" 8 " MirrorGhost" 9 " EgoMirrorGhost" 10 " GhostFromTrackGuardrail" 11 " OutsideFreespaceGhost" 12 " RoofGhost" 13 " TunnelMirrorGhost" 14 " CompanionGhost" 15 " AngleJumpCoasting" 16 " Occluded" 17 " GoodQuality" ;
VAL_ 410 FLR_CT26_Type 0 " Unknown" 1 " Car" 2 " Bicycle" 3 " Pedestrian" 4 " Motorcycle" 5 " Truck" 6 " Animal" 7 " Group2Pedestrians" 8 " GroupMultiplePedestrians" ;
VAL_ 411 FLR_CT27_Confidence 0 " Unknown" 1 " LoConfidence" 2 " MedConfidence" 3 " HiConfidence" ;
VAL_ 411 FLR_CT27_Elevation 0 " Unknown" 1 " Overridable" 2 " Relevant" 3 " Underridable" ;
VAL_ 411 FLR_CT27_ElevationConfidence 0 " Unknown" 1 " LoConfidence" 2 " MedConfidence" 3 " HiConfidence" ;
VAL_ 411 FLR_CT27_MotionClass 0 " Unknown" 1 " Stationary" 2 " Moving" 3 " Stopped" ;
VAL_ 411 FLR_CT27_QualityBits 0 " Sliding" 1 " Fused" 2 " ConfirmedByRspTracker" 3 " InsideFreespace" 4 " OutsideStationaryCloud" 5 " InsideRearBorder" 6 " AssociatedWithGoodDetection" 7 " Ghost" 8 " MirrorGhost" 9 " EgoMirrorGhost" 10 " GhostFromTrackGuardrail" 11 " OutsideFreespaceGhost" 12 " RoofGhost" 13 " TunnelMirrorGhost" 14 " CompanionGhost" 15 " AngleJumpCoasting" 16 " Occluded" 17 " GoodQuality" ;
VAL_ 411 FLR_CT27_Type 0 " Unknown" 1 " Car" 2 " Bicycle" 3 " Pedestrian" 4 " Motorcycle" 5 " Truck" 6 " Animal" 7 " Group2Pedestrians" 8 " GroupMultiplePedestrians" ;
VAL_ 412 FLR_CT28_Confidence 0 " Unknown" 1 " LoConfidence" 2 " MedConfidence" 3 " HiConfidence" ;
VAL_ 412 FLR_CT28_Elevation 0 " Unknown" 1 " Overridable" 2 " Relevant" 3 " Underridable" ;
VAL_ 412 FLR_CT28_ElevationConfidence 0 " Unknown" 1 " LoConfidence" 2 " MedConfidence" 3 " HiConfidence" ;
VAL_ 412 FLR_CT28_MotionClass 0 " Unknown" 1 " Stationary" 2 " Moving" 3 " Stopped" ;
VAL_ 412 FLR_CT28_QualityBits 0 " Sliding" 1 " Fused" 2 " ConfirmedByRspTracker" 3 " InsideFreespace" 4 " OutsideStationaryCloud" 5 " InsideRearBorder" 6 " AssociatedWithGoodDetection" 7 " Ghost" 8 " MirrorGhost" 9 " EgoMirrorGhost" 10 " GhostFromTrackGuardrail" 11 " OutsideFreespaceGhost" 12 " RoofGhost" 13 " TunnelMirrorGhost" 14 " CompanionGhost" 15 " AngleJumpCoasting" 16 " Occluded" 17 " GoodQuality" ;
VAL_ 412 FLR_CT28_Type 0 " Unknown" 1 " Car" 2 " Bicycle" 3 " Pedestrian" 4 " Motorcycle" 5 " Truck" 6 " Animal" 7 " Group2Pedestrians" 8 " GroupMultiplePedestrians" ;
VAL_ 413 FLR_CT29_Confidence 0 " Unknown" 1 " LoConfidence" 2 " MedConfidence" 3 " HiConfidence" ;
VAL_ 413 FLR_CT29_Elevation 0 " Unknown" 1 " Overridable" 2 " Relevant" 3 " Underridable" ;
VAL_ 413 FLR_CT29_ElevationConfidence 0 " Unknown" 1 " LoConfidence" 2 " MedConfidence" 3 " HiConfidence" ;
VAL_ 413 FLR_CT29_MotionClass 0 " Unknown" 1 " Stationary" 2 " Moving" 3 " Stopped" ;
VAL_ 413 FLR_CT29_QualityBits 0 " Sliding" 1 " Fused" 2 " ConfirmedByRspTracker" 3 " InsideFreespace" 4 " OutsideStationaryCloud" 5 " InsideRearBorder" 6 " AssociatedWithGoodDetection" 7 " Ghost" 8 " MirrorGhost" 9 " EgoMirrorGhost" 10 " GhostFromTrackGuardrail" 11 " OutsideFreespaceGhost" 12 " RoofGhost" 13 " TunnelMirrorGhost" 14 " CompanionGhost" 15 " AngleJumpCoasting" 16 " Occluded" 17 " GoodQuality" ;
VAL_ 413 FLR_CT29_Type 0 " Unknown" 1 " Car" 2 " Bicycle" 3 " Pedestrian" 4 " Motorcycle" 5 " Truck" 6 " Animal" 7 " Group2Pedestrians" 8 " GroupMultiplePedestrians" ;
VAL_ 448 FLR_ST0_Elevation 0 " Unknown" 1 " NotReady" 2 " Overridable" 3 " Relevant" 4 " Underridable" 5 " NoDecision" ;
VAL_ 448 FLR_ST0_PropertyBits 0 " None" 1 " Active" 2 " Zombie" 3 " ActiveAndZombie" 4 " SlowMoving" 5 " ActiveAndSlowMoving" 6 " ZombieAndSlowMoving" 7 " ActiveZombieAndSlowMoving" ;
VAL_ 448 FLR_ST0_Quality 0 " Unknown" 1 " Low" 2 " Medium" 3 " High" ;
VAL_ 449 FLR_ST1_Elevation 0 " Unknown" 1 " NotReady" 2 " Overridable" 3 " Relevant" 4 " Underridable" 5 " NoDecision" ;
VAL_ 449 FLR_ST1_PropertyBits 0 " None" 1 " Active" 2 " Zombie" 3 " ActiveAndZombie" 4 " SlowMoving" 5 " ActiveAndSlowMoving" 6 " ZombieAndSlowMoving" 7 " ActiveZombieAndSlowMoving" ;
VAL_ 449 FLR_ST1_Quality 0 " Unknown" 1 " Low" 2 " Medium" 3 " High" ;
VAL_ 450 FLR_ST2_Elevation 0 " Unknown" 1 " NotReady" 2 " Overridable" 3 " Relevant" 4 " Underridable" 5 " NoDecision" ;
VAL_ 450 FLR_ST2_PropertyBits 0 " None" 1 " Active" 2 " Zombie" 3 " ActiveAndZombie" 4 " SlowMoving" 5 " ActiveAndSlowMoving" 6 " ZombieAndSlowMoving" 7 " ActiveZombieAndSlowMoving" ;
VAL_ 450 FLR_ST2_Quality 0 " Unknown" 1 " Low" 2 " Medium" 3 " High" ;
VAL_ 451 FLR_ST3_Elevation 0 " Unknown" 1 " NotReady" 2 " Overridable" 3 " Relevant" 4 " Underridable" 5 " NoDecision" ;
VAL_ 451 FLR_ST3_PropertyBits 0 " None" 1 " Active" 2 " Zombie" 3 " ActiveAndZombie" 4 " SlowMoving" 5 " ActiveAndSlowMoving" 6 " ZombieAndSlowMoving" 7 " ActiveZombieAndSlowMoving" ;
VAL_ 451 FLR_ST3_Quality 0 " Unknown" 1 " Low" 2 " Medium" 3 " High" ;
SIG_GROUP_ 400 L_FR_RDR_ClusterTrack16_50ms 1 : FLR_CT16_CrcVal FLR_CT16_AlvCntVal FLR_CT16_ListIndex FLR_CT16_SequenceCounter FLR_CT16_TimeStamp FLR_CT16_Latency FLR_CT16_ClosestPointX FLR_CT16_ClosestPointXStdDev FLR_CT16_ClosestPointY FLR_CT16_ClosestPointYStdDev FLR_CT16_Confidence FLR_CT16_Elevation FLR_CT16_ElevationConfidence FLR_CT16_ExistanceProbability FLR_CT16_Lifetime FLR_CT16_ModelBoxHeading FLR_CT16_ModelBoxLength FLR_CT16_ModelBoxWidth FLR_CT16_ModelBoxX FLR_CT16_ModelBoxY FLR_CT16_MotionClass FLR_CT16_ObjectId FLR_CT16_ObservationHistory FLR_CT16_QualityBits FLR_CT16_StationaryCounter FLR_CT16_Type FLR_CT16_X_Acceleration FLR_CT16_X_Velocity FLR_CT16_X_VelocityStdDev FLR_CT16_Y_Acceleration FLR_CT16_Y_Velocity FLR_CT16_Y_VelocityStdDev;
SIG_GROUP_ 401 L_FR_RDR_ClusterTrack17_50ms 1 : FLR_CT17_CrcVal FLR_CT17_AlvCntVal FLR_CT17_ListIndex FLR_CT17_SequenceCounter FLR_CT17_TimeStamp FLR_CT17_Latency FLR_CT17_ClosestPointX FLR_CT17_ClosestPointXStdDev FLR_CT17_ClosestPointY FLR_CT17_ClosestPointYStdDev FLR_CT17_Confidence FLR_CT17_Elevation FLR_CT17_ElevationConfidence FLR_CT17_ExistanceProbability FLR_CT17_Lifetime FLR_CT17_ModelBoxHeading FLR_CT17_ModelBoxLength FLR_CT17_ModelBoxWidth FLR_CT17_ModelBoxX FLR_CT17_ModelBoxY FLR_CT17_MotionClass FLR_CT17_ObjectId FLR_CT17_ObservationHistory FLR_CT17_QualityBits FLR_CT17_StationaryCounter FLR_CT17_Type FLR_CT17_X_Acceleration FLR_CT17_X_Velocity FLR_CT17_X_VelocityStdDev FLR_CT17_Y_Acceleration FLR_CT17_Y_Velocity FLR_CT17_Y_VelocityStdDev;
SIG_GROUP_ 402 L_FR_RDR_ClusterTrack18_50ms 1 : FLR_CT18_CrcVal FLR_CT18_AlvCntVal FLR_CT18_ListIndex FLR_CT18_SequenceCounter FLR_CT18_TimeStamp FLR_CT18_Latency FLR_CT18_ClosestPointX FLR_CT18_ClosestPointXStdDev FLR_CT18_ClosestPointY FLR_CT18_ClosestPointYStdDev FLR_CT18_Confidence FLR_CT18_Elevation FLR_CT18_ElevationConfidence FLR_CT18_ExistanceProbability FLR_CT18_Lifetime FLR_CT18_ModelBoxHeading FLR_CT18_ModelBoxLength FLR_CT18_ModelBoxWidth FLR_CT18_ModelBoxX FLR_CT18_ModelBoxY FLR_CT18_MotionClass FLR_CT18_ObjectId FLR_CT18_ObservationHistory FLR_CT18_QualityBits FLR_CT18_StationaryCounter FLR_CT18_Type FLR_CT18_X_Acceleration FLR_CT18_X_Velocity FLR_CT18_X_VelocityStdDev FLR_CT18_Y_Acceleration FLR_CT18_Y_Velocity FLR_CT18_Y_VelocityStdDev;
SIG_GROUP_ 403 L_FR_RDR_ClusterTrack19_50ms 1 : FLR_CT19_CrcVal FLR_CT19_AlvCntVal FLR_CT19_ListIndex FLR_CT19_SequenceCounter FLR_CT19_TimeStamp FLR_CT19_Latency FLR_CT19_ClosestPointX FLR_CT19_ClosestPointXStdDev FLR_CT19_ClosestPointY FLR_CT19_ClosestPointYStdDev FLR_CT19_Confidence FLR_CT19_Elevation FLR_CT19_ElevationConfidence FLR_CT19_ExistanceProbability FLR_CT19_Lifetime FLR_CT19_ModelBoxHeading FLR_CT19_ModelBoxLength FLR_CT19_ModelBoxWidth FLR_CT19_ModelBoxX FLR_CT19_ModelBoxY FLR_CT19_MotionClass FLR_CT19_ObjectId FLR_CT19_ObservationHistory FLR_CT19_QualityBits FLR_CT19_StationaryCounter FLR_CT19_Type FLR_CT19_X_Acceleration FLR_CT19_X_Velocity FLR_CT19_X_VelocityStdDev FLR_CT19_Y_Acceleration FLR_CT19_Y_Velocity FLR_CT19_Y_VelocityStdDev;
SIG_GROUP_ 404 L_FR_RDR_ClusterTrack20_50ms 1 : FLR_CT20_CrcVal FLR_CT20_AlvCntVal FLR_CT20_ListIndex FLR_CT20_SequenceCounter FLR_CT20_TimeStamp FLR_CT20_Latency FLR_CT20_ClosestPointX FLR_CT20_ClosestPointXStdDev FLR_CT20_ClosestPointY FLR_CT20_ClosestPointYStdDev FLR_CT20_Confidence FLR_CT20_Elevation FLR_CT20_ElevationConfidence FLR_CT20_ExistanceProbability FLR_CT20_Lifetime FLR_CT20_ModelBoxHeading FLR_CT20_ModelBoxLength FLR_CT20_ModelBoxWidth FLR_CT20_ModelBoxX FLR_CT20_ModelBoxY FLR_CT20_MotionClass FLR_CT20_ObjectId FLR_CT20_ObservationHistory FLR_CT20_QualityBits FLR_CT20_StationaryCounter FLR_CT20_Type FLR_CT20_X_Acceleration FLR_CT20_X_Velocity FLR_CT20_X_VelocityStdDev FLR_CT20_Y_Acceleration FLR_CT20_Y_Velocity FLR_CT20_Y_VelocityStdDev;
SIG_GROUP_ 405 L_FR_RDR_ClusterTrack21_50ms 1 : FLR_CT21_CrcVal FLR_CT21_AlvCntVal FLR_CT21_ListIndex FLR_CT21_SequenceCounter FLR_CT21_TimeStamp FLR_CT21_Latency FLR_CT21_ClosestPointX FLR_CT21_ClosestPointXStdDev FLR_CT21_ClosestPointY FLR_CT21_ClosestPointYStdDev FLR_CT21_Confidence FLR_CT21_Elevation FLR_CT21_ElevationConfidence FLR_CT21_ExistanceProbability FLR_CT21_Lifetime FLR_CT21_ModelBoxHeading FLR_CT21_ModelBoxLength FLR_CT21_ModelBoxWidth FLR_CT21_ModelBoxX FLR_CT21_ModelBoxY FLR_CT21_MotionClass FLR_CT21_ObjectId FLR_CT21_ObservationHistory FLR_CT21_QualityBits FLR_CT21_StationaryCounter FLR_CT21_Type FLR_CT21_X_Acceleration FLR_CT21_X_Velocity FLR_CT21_X_VelocityStdDev FLR_CT21_Y_Acceleration FLR_CT21_Y_Velocity FLR_CT21_Y_VelocityStdDev;
SIG_GROUP_ 406 L_FR_RDR_ClusterTrack22_50ms 1 : FLR_CT22_CrcVal FLR_CT22_AlvCntVal FLR_CT22_ListIndex FLR_CT22_SequenceCounter FLR_CT22_TimeStamp FLR_CT22_Latency FLR_CT22_ClosestPointX FLR_CT22_ClosestPointXStdDev FLR_CT22_ClosestPointY FLR_CT22_ClosestPointYStdDev FLR_CT22_Confidence FLR_CT22_Elevation FLR_CT22_ElevationConfidence FLR_CT22_ExistanceProbability FLR_CT22_Lifetime FLR_CT22_ModelBoxHeading FLR_CT22_ModelBoxLength FLR_CT22_ModelBoxWidth FLR_CT22_ModelBoxX FLR_CT22_ModelBoxY FLR_CT22_MotionClass FLR_CT22_ObjectId FLR_CT22_ObservationHistory FLR_CT22_QualityBits FLR_CT22_StationaryCounter FLR_CT22_Type FLR_CT22_X_Acceleration FLR_CT22_X_Velocity FLR_CT22_X_VelocityStdDev FLR_CT22_Y_Acceleration FLR_CT22_Y_Velocity FLR_CT22_Y_VelocityStdDev;
SIG_GROUP_ 407 L_FR_RDR_ClusterTrack23_50ms 1 : FLR_CT23_CrcVal FLR_CT23_AlvCntVal FLR_CT23_ListIndex FLR_CT23_SequenceCounter FLR_CT23_TimeStamp FLR_CT23_Latency FLR_CT23_ClosestPointX FLR_CT23_ClosestPointXStdDev FLR_CT23_ClosestPointY FLR_CT23_ClosestPointYStdDev FLR_CT23_Confidence FLR_CT23_Elevation FLR_CT23_ElevationConfidence FLR_CT23_ExistanceProbability FLR_CT23_Lifetime FLR_CT23_ModelBoxHeading FLR_CT23_ModelBoxLength FLR_CT23_ModelBoxWidth FLR_CT23_ModelBoxX FLR_CT23_ModelBoxY FLR_CT23_MotionClass FLR_CT23_ObjectId FLR_CT23_ObservationHistory FLR_CT23_QualityBits FLR_CT23_StationaryCounter FLR_CT23_Type FLR_CT23_X_Acceleration FLR_CT23_X_Velocity FLR_CT23_X_VelocityStdDev FLR_CT23_Y_Acceleration FLR_CT23_Y_Velocity FLR_CT23_Y_VelocityStdDev;
SIG_GROUP_ 408 L_FR_RDR_ClusterTrack24_50ms 1 : FLR_CT24_CrcVal FLR_CT24_AlvCntVal FLR_CT24_ListIndex FLR_CT24_SequenceCounter FLR_CT24_TimeStamp FLR_CT24_Latency FLR_CT24_ClosestPointX FLR_CT24_ClosestPointXStdDev FLR_CT24_ClosestPointY FLR_CT24_ClosestPointYStdDev FLR_CT24_Confidence FLR_CT24_Elevation FLR_CT24_ElevationConfidence FLR_CT24_ExistanceProbability FLR_CT24_Lifetime FLR_CT24_ModelBoxHeading FLR_CT24_ModelBoxLength FLR_CT24_ModelBoxWidth FLR_CT24_ModelBoxX FLR_CT24_ModelBoxY FLR_CT24_MotionClass FLR_CT24_ObjectId FLR_CT24_ObservationHistory FLR_CT24_QualityBits FLR_CT24_StationaryCounter FLR_CT24_Type FLR_CT24_X_Acceleration FLR_CT24_X_Velocity FLR_CT24_X_VelocityStdDev FLR_CT24_Y_Acceleration FLR_CT24_Y_Velocity FLR_CT24_Y_VelocityStdDev;
SIG_GROUP_ 409 L_FR_RDR_ClusterTrack25_50ms 1 : FLR_CT25_CrcVal FLR_CT25_AlvCntVal FLR_CT25_ListIndex FLR_CT25_SequenceCounter FLR_CT25_TimeStamp FLR_CT25_Latency FLR_CT25_ClosestPointX FLR_CT25_ClosestPointXStdDev FLR_CT25_ClosestPointY FLR_CT25_ClosestPointYStdDev FLR_CT25_Confidence FLR_CT25_Elevation FLR_CT25_ElevationConfidence FLR_CT25_ExistanceProbability FLR_CT25_Lifetime FLR_CT25_ModelBoxHeading FLR_CT25_ModelBoxLength FLR_CT25_ModelBoxWidth FLR_CT25_ModelBoxX FLR_CT25_ModelBoxY FLR_CT25_MotionClass FLR_CT25_ObjectId FLR_CT25_ObservationHistory FLR_CT25_QualityBits FLR_CT25_StationaryCounter FLR_CT25_Type FLR_CT25_X_Acceleration FLR_CT25_X_Velocity FLR_CT25_X_VelocityStdDev FLR_CT25_Y_Acceleration FLR_CT25_Y_Velocity FLR_CT25_Y_VelocityStdDev;
SIG_GROUP_ 410 L_FR_RDR_ClusterTrack26_50ms 1 : FLR_CT26_CrcVal FLR_CT26_AlvCntVal FLR_CT26_ListIndex FLR_CT26_SequenceCounter FLR_CT26_TimeStamp FLR_CT26_Latency FLR_CT26_ClosestPointX FLR_CT26_ClosestPointXStdDev FLR_CT26_ClosestPointY FLR_CT26_ClosestPointYStdDev FLR_CT26_Confidence FLR_CT26_Elevation FLR_CT26_ElevationConfidence FLR_CT26_ExistanceProbability FLR_CT26_Lifetime FLR_CT26_ModelBoxHeading FLR_CT26_ModelBoxLength FLR_CT26_ModelBoxWidth FLR_CT26_ModelBoxX FLR_CT26_ModelBoxY FLR_CT26_MotionClass FLR_CT26_ObjectId FLR_CT26_ObservationHistory FLR_CT26_QualityBits FLR_CT26_StationaryCounter FLR_CT26_Type FLR_CT26_X_Acceleration FLR_CT26_X_Velocity FLR_CT26_X_VelocityStdDev FLR_CT26_Y_Acceleration FLR_CT26_Y_Velocity FLR_CT26_Y_VelocityStdDev;
SIG_GROUP_ 411 L_FR_RDR_ClusterTrack27_50ms 1 : FLR_CT27_CrcVal FLR_CT27_AlvCntVal FLR_CT27_ListIndex FLR_CT27_SequenceCounter FLR_CT27_TimeStamp FLR_CT27_Latency FLR_CT27_ClosestPointX FLR_CT27_ClosestPointXStdDev FLR_CT27_ClosestPointY FLR_CT27_ClosestPointYStdDev FLR_CT27_Confidence FLR_CT27_Elevation FLR_CT27_ElevationConfidence FLR_CT27_ExistanceProbability FLR_CT27_Lifetime FLR_CT27_ModelBoxHeading FLR_CT27_ModelBoxLength FLR_CT27_ModelBoxWidth FLR_CT27_ModelBoxX FLR_CT27_ModelBoxY FLR_CT27_MotionClass FLR_CT27_ObjectId FLR_CT27_ObservationHistory FLR_CT27_QualityBits FLR_CT27_StationaryCounter FLR_CT27_Type FLR_CT27_X_Acceleration FLR_CT27_X_Velocity FLR_CT27_X_VelocityStdDev FLR_CT27_Y_Acceleration FLR_CT27_Y_Velocity FLR_CT27_Y_VelocityStdDev;
SIG_GROUP_ 412 L_FR_RDR_ClusterTrack28_50ms 1 : FLR_CT28_CrcVal FLR_CT28_AlvCntVal FLR_CT28_ListIndex FLR_CT28_SequenceCounter FLR_CT28_TimeStamp FLR_CT28_Latency FLR_CT28_ClosestPointX FLR_CT28_ClosestPointXStdDev FLR_CT28_ClosestPointY FLR_CT28_ClosestPointYStdDev FLR_CT28_Confidence FLR_CT28_Elevation FLR_CT28_ElevationConfidence FLR_CT28_ExistanceProbability FLR_CT28_Lifetime FLR_CT28_ModelBoxHeading FLR_CT28_ModelBoxLength FLR_CT28_ModelBoxWidth FLR_CT28_ModelBoxX FLR_CT28_ModelBoxY FLR_CT28_MotionClass FLR_CT28_ObjectId FLR_CT28_ObservationHistory FLR_CT28_QualityBits FLR_CT28_StationaryCounter FLR_CT28_Type FLR_CT28_X_Acceleration FLR_CT28_X_Velocity FLR_CT28_X_VelocityStdDev FLR_CT28_Y_Acceleration FLR_CT28_Y_Velocity FLR_CT28_Y_VelocityStdDev;
SIG_GROUP_ 413 L_FR_RDR_ClusterTrack29_50ms 1 : FLR_CT29_CrcVal FLR_CT29_AlvCntVal FLR_CT29_ListIndex FLR_CT29_SequenceCounter FLR_CT29_TimeStamp FLR_CT29_Latency FLR_CT29_ClosestPointX FLR_CT29_ClosestPointXStdDev FLR_CT29_ClosestPointY FLR_CT29_ClosestPointYStdDev FLR_CT29_Confidence FLR_CT29_Elevation FLR_CT29_ElevationConfidence FLR_CT29_ExistanceProbability FLR_CT29_Lifetime FLR_CT29_ModelBoxHeading FLR_CT29_ModelBoxLength FLR_CT29_ModelBoxWidth FLR_CT29_ModelBoxX FLR_CT29_ModelBoxY FLR_CT29_MotionClass FLR_CT29_ObjectId FLR_CT29_ObservationHistory FLR_CT29_QualityBits FLR_CT29_StationaryCounter FLR_CT29_Type FLR_CT29_X_Acceleration FLR_CT29_X_Velocity FLR_CT29_X_VelocityStdDev FLR_CT29_Y_Acceleration FLR_CT29_Y_Velocity FLR_CT29_Y_VelocityStdDev;
SIG_GROUP_ 448 L_FR_RDR_StationaryTrack0_50ms 1 : FLR_ST0_CrcVal FLR_ST0_AlvCntVal FLR_ST0_Elevation FLR_ST0_ElevationConfidence FLR_ST0_Lifetime FLR_ST0_ObjectId FLR_ST0_PositionX FLR_ST0_PositionY FLR_ST0_PredictionCounter FLR_ST0_PropertyBits FLR_ST0_Quality FLR_ST0_X_Velocity FLR_ST0_Y_Velocity;
SIG_GROUP_ 449 L_FR_RDR_StationaryTrack1_50ms 1 : FLR_ST1_CrcVal FLR_ST1_AlvCntVal FLR_ST1_Elevation FLR_ST1_ElevationConfidence FLR_ST1_Lifetime FLR_ST1_ObjectId FLR_ST1_PositionX FLR_ST1_PositionY FLR_ST1_PredictionCounter FLR_ST1_PropertyBits FLR_ST1_Quality FLR_ST1_X_Velocity FLR_ST1_Y_Velocity;
SIG_GROUP_ 450 L_FR_RDR_StationaryTrack2_50ms 1 : FLR_ST2_CrcVal FLR_ST2_AlvCntVal FLR_ST2_Elevation FLR_ST2_ElevationConfidence FLR_ST2_Lifetime FLR_ST2_ObjectId FLR_ST2_PositionX FLR_ST2_PositionY FLR_ST2_PredictionCounter FLR_ST2_PropertyBits FLR_ST2_Quality FLR_ST2_X_Velocity FLR_ST2_Y_Velocity;
SIG_GROUP_ 451 L_FR_RDR_StationaryTrack3_50ms 1 : FLR_ST3_CrcVal FLR_ST3_AlvCntVal FLR_ST3_Elevation FLR_ST3_ElevationConfidence FLR_ST3_Lifetime FLR_ST3_ObjectId FLR_ST3_PositionX FLR_ST3_PositionY FLR_ST3_PredictionCounter FLR_ST3_PropertyBits FLR_ST3_Quality FLR_ST3_X_Velocity FLR_ST3_Y_Velocity;
