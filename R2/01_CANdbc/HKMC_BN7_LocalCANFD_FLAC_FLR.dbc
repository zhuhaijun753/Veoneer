VERSION ""

NS_ :

BS_:

BU_: FR_CMR FR_RDR

BO_ 257 L_FR_CMR_VehicleData_10ms: 32 FR_CMR
 SG_ FR_CMR_VD_CrcVal : 0|16@1+ (1,0) [0|65535] ""  FR_RDR
 SG_ FR_CMR_VD_AlvCntVal : 16|8@1+ (1,0) [0|255] ""  FR_RDR
 SG_ FR_CMR_VD_SAS_AnglVal : 24|16@1- (0.1,0) [-3276|3276] "deg"  FR_RDR
 SG_ FR_CMR_VD_YRS_YawRtVal : 40|16@1+ (0.005,-163.84) [-16|15.875] "deg/s
(Deg/s)"  FR_RDR
 SG_ FR_CMR_VD_YRS_LatAccelVal : 56|16@1+ (0.000127465,-4.17677312) [-4.17677312|4.176645655] "g"  FR_RDR
 SG_ FR_CMR_VD_YRS_LongAccelVal : 72|16@1+ (0.000127465,-4.17677312) [-4.17677312|4.176645655] "g"  FR_RDR
 SG_ FR_CMR_VD_EstVehSpdVal : 88|16@1+ (0.01,0) [0|128] "m/s"  FR_RDR
 SG_ FR_CMR_VD_EstVehSpdFailure : 104|3@1+ (1,0) [0|8] ""  FR_RDR
 SG_ FR_CMR_VD_EstVehDirection : 107|3@1+ (1,0) [0|4] ""  FR_RDR
 SG_ FR_CMR_VD_ENG_EngSta : 122|3@1+ (1,0) [0|7] ""  FR_RDR
 SG_ FR_CMR_HCU_HevRdySta : 125|2@1+ (1,0) [0|3] ""  FR_RDR

BO_ 336 L_FR_RDR_Status_10ms: 32 FR_RDR
 SG_ FR_RDR_S_CrcVal : 0|16@1+ (1,0) [0|65535] ""  FR_CMR
 SG_ FR_RDR_S_AlvCntVal : 16|8@1+ (1,0) [0|255] ""  FR_CMR

CM_ BO_ 257 "[P] Periodic";
CM_ SG_ 257 FR_CMR_VD_CrcVal "CyclicRedundancyCheckValue";
CM_ SG_ 257 FR_CMR_VD_AlvCntVal "AliveCounterValue";
CM_ SG_ 257 FR_CMR_VD_SAS_AnglVal "SAS_AngleValue";
CM_ SG_ 257 FR_CMR_VD_YRS_YawRtVal "YawRateValue";
CM_ SG_ 257 FR_CMR_VD_YRS_LatAccelVal "LateralAccelerationValue";
CM_ SG_ 257 FR_CMR_VD_YRS_LongAccelVal "LongitudinalAccelerationValue";
CM_ SG_ 257 FR_CMR_VD_EstVehSpdVal "EstimationVehicleSpeedVal";
CM_ SG_ 257 FR_CMR_VD_EstVehSpdFailure "EstVehSpdFailure";
CM_ SG_ 257 FR_CMR_VD_EstVehDirection "Vehicle direction";
CM_ SG_ 257 FR_CMR_VD_ENG_EngSta "ENG_EngineStatus";
CM_ SG_ 257 FR_CMR_HCU_HevRdySta "HCU_HybridVehicleReadyStatus ##2G##HCU - HCU1 - CF_Hcu_HevRdy";
CM_ BO_ 336 "[P] Periodic";
CM_ SG_ 336 FR_RDR_S_CrcVal "CyclicRedundancyCheckValue";
CM_ SG_ 336 FR_RDR_S_AlvCntVal "AliveCounter";
BA_DEF_ BO_  "GenMsgILSupport" ENUM  "No","Yes","vector_leerstring";
BA_DEF_ BO_  "DiagState" ENUM  "No","Yes","vector_leerstring";
BA_DEF_ BO_  "DiagRequest" ENUM  "No","Yes","vector_leerstring";
BA_DEF_  "BusType" STRING ;
BA_DEF_ BO_  "VFrameFormat" ENUM  "StandardCAN","ExtendedCAN","reserved","reserved","reserved","reserved","reserved","reserved","reserved","reserved","reserved","reserved","reserved","reserved","StandardCAN_FD","ExtendedCAN_FD";
BA_DEF_ BO_  "GenMsgSendType" ENUM  "Cyclic","NoMsgSendType";
BA_DEF_ SG_  "UserSigValidity" ENUM  "B+","ACC","IG","IG1","IG2","IG3","IG1 or IG2","IG1 or IG3","Undef";
BA_DEF_ SG_  "RoutingFactor" INT 1 1215752192;
BA_DEF_ SG_  "Description" STRING ;
BA_DEF_ SG_  "Version" STRING ;
BA_DEF_ BO_  "GenMsgCycleTime" INT 0 2000;
BA_DEF_ BO_  "GenMsgStartDelayTime" INT 0 2000;
BA_DEF_ BU_  "NmNode" ENUM  "No","Yes";
BA_DEF_ SG_  "UsrSigPurpose" ENUM  "Undef","FN","DIAG","DEV","NM";
BA_DEF_ SG_  "GenSigStartValue" INT 0 0;
BA_DEF_DEF_  "GenMsgILSupport" "Yes";
BA_DEF_DEF_  "DiagState" "No";
BA_DEF_DEF_  "DiagRequest" "No";
BA_DEF_DEF_  "BusType" "CAN FD";
BA_DEF_DEF_  "VFrameFormat" "";
BA_DEF_DEF_  "GenMsgSendType" "NoMsgSendType";
BA_DEF_DEF_  "UserSigValidity" "IG";
BA_DEF_DEF_  "RoutingFactor" 1;
BA_DEF_DEF_  "Description" "";
BA_DEF_DEF_  "Version" "";
BA_DEF_DEF_  "GenMsgCycleTime" 0;
BA_DEF_DEF_  "GenMsgStartDelayTime" 0;
BA_DEF_DEF_  "NmNode" "Yes";
BA_DEF_DEF_  "UsrSigPurpose" "FN";
BA_DEF_DEF_  "GenSigStartValue" 0;
BA_ "NmNode" BU_ FR_CMR 0;
BA_ "NmNode" BU_ FR_RDR 0;
BA_ "GenMsgSendType" BO_ 257 0;
BA_ "GenMsgCycleTime" BO_ 257 10;
BA_ "VFrameFormat" BO_ 257 14;
BA_ "GenMsgSendType" BO_ 336 0;
BA_ "GenMsgCycleTime" BO_ 336 10;
BA_ "VFrameFormat" BO_ 336 14;
BA_ "Description" SG_ 257 FR_CMR_VD_CrcVal "The CRC checking process calculates the CRC over the entire data block, including the CRC result.

- CRC Polynomial (0x1021) , Initial Value : 0xFFFF, XOR value : 0x0000

- The mathematical expression to 16 bit CRC polynomial is given here. G(x) = x16 + ";
BA_ "GenSigStartValue" SG_ 257 FR_CMR_VD_CrcVal 65535;
BA_ "UserSigValidity" SG_ 257 FR_CMR_VD_CrcVal 3;
BA_ "Description" SG_ 257 FR_CMR_VD_AlvCntVal "For the first transmission request for a data element the counter shall be initialized with 0 and shall be incremented by 1

for every subsequent send request. When the counter reaches the maximum value(0xFF), then it shall restart with â€“ for the next ";
BA_ "UserSigValidity" SG_ 257 FR_CMR_VD_AlvCntVal 3;
BA_ "Description" SG_ 257 FR_CMR_VD_SAS_AnglVal "Information regarding the steering wheel angle.  (PH) = (HEX) * 0.1 (0 <  HEX < 7FFFH) or (PH) = (HEX - 65536) * 0.1 (HEX > 7FFFH)";
BA_ "UserSigValidity" SG_ 257 FR_CMR_VD_SAS_AnglVal 3;
BA_ "Description" SG_ 257 FR_CMR_VD_YRS_YawRtVal "This signal indicates Information regarding yaw rate.



physical range : -163.84..163.83 Ëš/s = 0000H..FFFEh



Conversion : (PH) = ((HEX)-8000H)*0.005[Ëš/s/digit]



                            = (HEX)*0.005[Ëš/s/digit] - 163.84[Ëš/s]



              ";
BA_ "GenSigStartValue" SG_ 257 FR_CMR_VD_YRS_YawRtVal 32768;
BA_ "UserSigValidity" SG_ 257 FR_CMR_VD_YRS_YawRtVal 3;
BA_ "Description" SG_ 257 FR_CMR_VD_YRS_LatAccelVal "This signal indicates Information regarding lateral acceleration.



physical range : -4.1768g..4.1765g = 0000H..FFFEh



Conversion : (PH) = ((HEX)-8000H)*0.000127465[g/digit]



                            = (HEX)*0.000127465[g/digit] - 4.17677312[g]

";
BA_ "GenSigStartValue" SG_ 257 FR_CMR_VD_YRS_LatAccelVal 32768;
BA_ "UserSigValidity" SG_ 257 FR_CMR_VD_YRS_LatAccelVal 3;
BA_ "Description" SG_ 257 FR_CMR_VD_YRS_LongAccelVal "This signal indicates information regarding longitudinal acceleration.



physical range : -4.1768g..4.1765g = 0000H..FFFEh



Conversion : (PH) = ((HEX)-8000H)*0.000127465[g/digit]



                            = (HEX)*0.000127465[g/digit] - 4.17677312";
BA_ "GenSigStartValue" SG_ 257 FR_CMR_VD_YRS_LongAccelVal 32768;
BA_ "UserSigValidity" SG_ 257 FR_CMR_VD_YRS_LongAccelVal 3;
BA_ "Description" SG_ 257 FR_CMR_VD_EstVehSpdVal "Estimated vehicle speed (Value range : 0 ~ 655.35)



Vehicle speed is estimated by four wheels' rotation value.

Nominal wheel radius shall come from Static calibration in Camera.";
BA_ "UserSigValidity" SG_ 257 FR_CMR_VD_EstVehSpdVal 3;
BA_ "Description" SG_ 257 FR_CMR_VD_EstVehSpdFailure "0x0 Normal

0x1 Failure

0x2~7 Reserved";
BA_ "UserSigValidity" SG_ 257 FR_CMR_VD_EstVehSpdFailure 3;
BA_ "Description" SG_ 257 FR_CMR_VD_EstVehDirection "<Wheel sensor can support > 

Refer 

ESC::WHL_DirFLVal

ESC::WHL_DirFRVal

ESC::WHL_DirRLVal

ESC::WHL_DirRRVal from Chassis CAN,



0x0: if at least one among 4 signal is 0x0 from Chassis CAN) 

0x1: if all are 0x1

0x2: if are all 0x2

0x3: if at leas";
BA_ "UserSigValidity" SG_ 257 FR_CMR_VD_EstVehDirection 3;
BA_ "Description" SG_ 257 FR_CMR_VD_ENG_EngSta "This signal indicates that a status of engine.";
BA_ "UserSigValidity" SG_ 257 FR_CMR_VD_ENG_EngSta 3;
BA_ "Description" SG_ 257 FR_CMR_HCU_HevRdySta "Hybrid Vehicle Drivable ready";
BA_ "UserSigValidity" SG_ 257 FR_CMR_HCU_HevRdySta 3;
BA_ "Description" SG_ 336 FR_RDR_S_CrcVal "The CRC checking process calculates the CRC over the entire data block, including the CRC result.

- CRC Polynomial (0x1021) , Initial Value : 0xFFFF, XOR value : 0x0000

- The mathematical expression to 16 bit CRC polynomial is given here. G(x) = x16 + ";
BA_ "GenSigStartValue" SG_ 336 FR_RDR_S_CrcVal 65535;
BA_ "UserSigValidity" SG_ 336 FR_RDR_S_CrcVal 3;
BA_ "Description" SG_ 336 FR_RDR_S_AlvCntVal "[Alive counter] For the first transmission request for a data element the counter shall be initialized with 0 and shall be incremented by 1

for every subsequent send request. When the counter reaches the maximum value(0xFF), then it shall restart with â";
BA_ "UserSigValidity" SG_ 336 FR_RDR_S_AlvCntVal 3;
VAL_ 257 FR_CMR_VD_SAS_AnglVal 32767 " Error Indicator" ;
VAL_ 257 FR_CMR_VD_YRS_YawRtVal 65535 " Error" ;
VAL_ 257 FR_CMR_VD_YRS_LatAccelVal 65535 " Error" ;
VAL_ 257 FR_CMR_VD_YRS_LongAccelVal 65535 " Error" ;
VAL_ 257 FR_CMR_VD_EstVehSpdFailure 0 " Normal" 1 " Failure" 2 " Reserved" 3 " Reserved" 4 " Reserved" 5 " Reserved" 6 " Reserved" 7 " Reserved" ;
VAL_ 257 FR_CMR_VD_EstVehDirection 0 " Unknown (Wheel moving stop state)" 1 " Forward direction" 2 " Backward direction" 3 " Error identifier" 4 " Not applied wheel sensor for direction" ;
VAL_ 257 FR_CMR_VD_ENG_EngSta 0 " Engine Stop" 1 " Cranking" 2 " Stalled" 3 " Running" 4 " Reserved" 5 " Reserved" 6 " Reserved" 7 " Fault" ;
VAL_ 257 FR_CMR_HCU_HevRdySta 0 "HEV not ready" 1 "HEV Drivable" 2 "Not used" 3 "Error Indicator" ;
SIG_GROUP_ 257 L_FR_CMR_VehicleData_10ms 1 : FR_CMR_VD_CrcVal FR_CMR_VD_AlvCntVal FR_CMR_VD_SAS_AnglVal FR_CMR_VD_YRS_YawRtVal FR_CMR_VD_YRS_LatAccelVal FR_CMR_VD_YRS_LongAccelVal FR_CMR_VD_EstVehSpdVal FR_CMR_VD_EstVehSpdFailure FR_CMR_VD_EstVehDirection FR_CMR_VD_ENG_EngSta FR_CMR_HCU_HevRdySta;
SIG_GROUP_ 336 L_FR_RDR_Status_10ms 1 : FR_RDR_S_CrcVal FR_RDR_S_AlvCntVal FR_RDR_S_GenFailInfo;
